/*@!Encoding:1252*/
//includes
//{
//	#include "voltagetest_serial_toellner.can"
//}

variables
{  
  int env_SW_Set;
    //Security levels
    byte SeednKeyTypeOne[2] = {0x27,0x01};
    byte SeednKeyTypeFour[2] = {0x27,0x41};
    byte SeednKeyTypeFive[2] = {0x27,0x07};
    
    byte      emptyString[4098];
    //byte    TesterPresentOnOff=0;
    byte      DiagSession=0;
    int flag;
   	//Transmit
    const int txSize = 8192;
	byte 	  TxDataBuffer[txSize];
   	int       TxLength;
    byte      TxDataBuffer_temp[3]={22,22,22};
   
   
    //Receive
    const int rxSize = 8192;
	byte 	  RxDataBuffer[rxSize];
   	int  	  RxBufferIndex;
   	int  	  RxLength_CAN;        
    char      hexaStr[6];
    byte    RqTxData[8192];//1023
    int     ByteSize;
    char    RqTxStringData[8192];
    int     SID;
    	
    int Radar_start;
    int seq;
    int seq1;
    msTimer Tm_Env_RADAR_Info;
  //  msTimer Tm_Env_RADAR_Start;
        
    // Variables for Requests
	int 	  DirectTxDataLen  = 0;
   	int   	  CurrentDiagServ  = 0;
	int		  SId              = 0;
   	float 	  RespTime         = 0.0;


    //Constants for Diag Switch
    const int TESTER_PRESENT_ON = 0;
    const int TESTER_PRESENT_OFF= 1;
	const int DIS_NOR_MSG_TX 	= 2;
	const int EN_NOR_MSG_TX		= 3;
	const int ECU_ID			= 4;
	const int ECU_DEV_ST    	= 5;
	const int READ_DTC_BY_ST    = 6;
	const int READ_DTC_PASS     = 99; //old value 13
	const int CLEAR_DTC			= 7;
	const int RD_CAMERA_LEFT    = 8;
	const int RD_CAMERA_RIGHT   = 9;
	const int RD_SW_VER         = 10;
	const int TEST				= 94; //old value 11
	const int DIRECT_RQ			= 95; //old value 12
	const int RD_SERIAL_NR      = 14;
	const int RESET             = 96;  //old value 15
	const int START_IR_TEST     = 97;  //old value 16
	const int STOP_IR_TEST      = 98;  //old value 17
	const int START_IMG_TEST    = 18;
	const int STOP_IMG_TEST     = 19;
	const int GET_SYS_RUNTIME	= 20;
	const int RESET_RUNTIME		= 21;
	const int SHOW_ENG_INFO		= 22;
	const int ENV_DATA			= 23;
	const int RD_CAN_SIG		= 24;
	const int RD_TEMP    		= 25;
	const int RD_CALIB_DATA     = 26;
	const int RD_ECU_ST			= 27;
	const int RD_TEMP_PROF		= 28;
    const int SKIP_CALIB		= 29;
	const int CALIB_SHIFT_UP	= 30;
	const int CALIB_SHIFT_DOWN	= 31;
	const int CALIB_SHIFT_LEFT	= 32;
	const int CALIB_SHIFT_RIGHT = 33;
	const int CALIB_DATA_SAVE   = 34;
	const int RD_MAX_CALIB_DATA = 35;
	const int CALIB_AUTO        = 36;
	const int CALIB_DATA_DEL    = 37;
	const int READ_HIST_DTC    =  38;
	const int CLEAR_HIST_DTC	= 39;
	const int HIST_ENV_DATA		= 40;
	const int START_CAM_ON		= 41;
	const int START_CAM_OFF		= 42;
	const int RQ_RES_CALIB_AUTO	= 43;
	const int RQ_RES_SELFTEST	= 44;
	const int RQ_RES_CHECKSUM	= 45;
	const int DIAG_SESSION_ON	= 46;
    const int READ_HIST_DTC_BY_ST    = 47;
    const int FINGERPRINT       = 48;
    const int PROGDATE          = 49;
    //const int SEEDNKEYREQUEST   = 50;
    const int SEEDNKEYRESP          = 51;    
   // const int SEEDRBEOLREQUEST   = 52; it will be implemented after Release X055
    const int SEEDNKEYREPROGREQUEST = 53;
    //const int SEEDNKEYRBEOLREQUEST = 80;//M.I.
    const int SEEDNKEYRBOLREQUESTWRITEKEY = 81;//M.I.
    const int P_MODE_ACT_P1 = 82;
    const int P_MODE_ACT_P2 = 83;

    const int  READ_EWB_ACT =54;
    const int  READ_DEACT_FUNC =55;
    const int  PRE_WRITE =56;
    const int  DEACT_FUNC_FLA =57;
    const int  DEACT_FUNC_CCP =58;
    const int  DEACT_FUNC_VZE =59;
    const int  ACT_EWB_VZE =60;
    const int  ACT_EWB_VZF =61;
    const int  ACT_EWB_EHR =62;
    const int  ACT_EWB_FLA =63;
    const int  ACT_EWB_MOD =64;
    const int  ACT_EWB_HCA =65;
    const int  ACT_EWBs = 79; //MI
    const int  ACT_XCP =84;//MI 

    const int  READ_MASK_FAULT_CLASS =66; 
    const int  WRITE_MASK_FAULT_CLASS =67; 
    const int  READ_MASK_ERR_RCTN =68; 
    const int  WRITE_MASK_ERR_RCTN =69; 

    const int  READ_BAP_PERS =70; 
    const int  WRITE_BAP_PERS =71; 

    const int  READ_V_THRESHOLD_MAINBEAM_ON =72; 
    const int  WRITE_V_THRESHOLD_MAINBEAM_ON =73; 
    const int  READ_V_THRESHOLD_MAINBEAM_OFF =74; 
    const int  WRITE_V_THRESHOLD_MAINBEAM_OFF =75; 

    const int MINICODEREQUEST = 76;
    const int PRE_WRITE_MINICODE = 77;
    const int SEEDNKEYREPROGREQUESTWRITEKEY = 78;

    //Honda security choose macro's
    const int SEEDNKEYREQUESTUNLOCKONE = 85;
    const int SEEDNKEYREQUESTUNLOCKFOUR = 86;
    const int SEEDNKEYREQUESTUNLOCKFIVE = 87;
    const int SEEDNKEYRESP_TYPE4 = 88;
    const int SEEDNKEYRESP_TYPE1 = 92;   //older valu 89
    const int SEEDNKEYRESP_TYPE5 = 90;
    const int ENGINEERING_SESSION_ON = 91;
   



     long copiedBytes ;

//Anpassung Identifiers  all starting with 0x05
const int EWB_VZE_ID=0x32;
const int EWB_VZF_ID=0x33;
const int EWB_EHR_ID=0x34;
const int EWB_HCA_ID=0x35;
const int EWB_MOD_ID=0x36;
const int EWB_FLA_ID=0x37;
const int DEACT_CCP_ID= 0x30;
const int DEACT_FLA_ID= 0x19;
const int DEACT_VZE_ID= 0x18;
const int MASK_FAULT_CLASS_ID= 0x3C;
const int MASK_ERR_RCTN_ID= 0x3B;
const int BAP_PERS_ID= 0xA4;
const int XCP_ID=0x30;//MI

//Anpassung Identifiers  all starting with 0x3B
const int V_THRESHOLD_MAINBEAM_OFF_ID= 0x23;
const int V_THRESHOLD_MAINBEAM_ON_ID= 0x24;

//Anpassung Identifiers  all starting with 0x09 //MI
const int EWBs_ID=0x02; //MI


    //Stringbuffer
    char 	  Stringbuffer[8192];
   	char	  StringAux[8192];	


    //read dtc variables
   	dword 	  errorDTC[256];
   	dword 	  errorStatus[256]; 
   	int  	  CurrentDTC = 0;
   	int  	  NrOfReadDTC ;   
	
	dword 	  errorHistDTC[256];
   	byte 	  errorHistStatus[256]; 
   	int  	  CurrentHistDTC = 0;
   	int  	  NrOfHistDTC;  
   	int  	  NrOfReadHistDTC;   


  
	// Tester Present Handling
   	msTimer   TesterPresentTimer;
    mstimer waitTimeForResponse;
   	const int TesterPresentTime = 4500;
   	const int FirstTesterPresentTime = 20;
   	const int WaitTime = 3000;
  	   
   	message   Honda_Diag_FCAN_Phy_F1_Req msgDiagRequest = {
   				dword(0) = 0xffffffff,
   				dword(4) = 0xffffffff}; 

    
    message   Honda_Diag_FCAN_Phy_F1_Req ReqDiagMsgGlobal1 = {
   				dword(0) = 0xffffffff,
   				dword(4) = 0xffffffff}; 
    message   Honda_Diag_FCAN_Phy_F2_Req ReqDiagMsgGlobal2 = {
   				dword(0) = 0xffffffff,
   				dword(4) = 0xffffffff}; 
    message   Honda_Diag_FCAN_Phy_F3_Req ReqDiagMsgGlobal3 = {
   				dword(0) = 0xffffffff,
   				dword(4) = 0xffffffff}; 
    message   Honda_Diag_FCAN_Phy_F4_Req ReqDiagMsgGlobal4 = {
   				dword(0) = 0xffffffff,
   				dword(4) = 0xffffffff}; 
    message   Honda_Diag_FCAN_Phy_F5_Req ReqDiagMsgGlobal5 = {
   				dword(0) = 0xffffffff,
   				dword(4) = 0xffffffff}; 
//    message   Honda_Diag_FCAN_Func_F1_Req ReqDiagMsgGlobalFun1 = {
//   				dword(0) = 0xffffffff,
//   				dword(4) = 0xffffffff}; 
     message   0x18DBEFF1x ReqDiagMsgGlobalFun1 = {
   				dword(0) = 0xffffffff,
   				dword(4) = 0xffffffff}; 
     message   Honda_Diag_FCAN_Func_F2_Req ReqDiagMsgGlobalFun2 = {
   				dword(0) = 0xffffffff,
   				dword(4) = 0xffffffff}; 
     message   Honda_Diag_FCAN_Func_F3_Req ReqDiagMsgGlobalFun3 = {
   				dword(0) = 0xffffffff,
   				dword(4) = 0xffffffff};
     message   Honda_Diag_FCAN_Func_F4_Req ReqDiagMsgGlobalFun4 = {
   				dword(0) = 0xffffffff,
   				dword(4) = 0xffffffff};
     message   Honda_Diag_FCAN_Func_F5_Req ReqDiagMsgGlobalFun5 = {
   				dword(0) = 0xffffffff,
   				dword(4) = 0xffffffff};
//     message   Honda_Diag_FCAN_Func_F6_Req ReqDiagMsgGlobalFun6 = {
//   				dword(0) = 0xffffffff,
//   				dword(4) = 0xffffffff};
//     message   Honda_Diag_FCAN_Func_F7_Req ReqDiagMsgGlobalFun7 = {
//   				dword(0) = 0xffffffff,
//   				dword(4) = 0xffffffff}; 
//     message   Honda_Diag_FCAN_Func_F8_Req ReqDiagMsgGlobalFun8 = {
//   				dword(0) = 0xffffffff,
//   				dword(4) = 0xffffffff};
//     message   Honda_Diag_FCAN_Func_F9_Req ReqDiagMsgGlobalFun9 = {
//   				dword(0) = 0xffffffff,
//   				dword(4) = 0xffffffff};
//     message   Honda_Diag_FCAN_Func_FA_Req ReqDiagMsgGlobalFunA = {
//   				dword(0) = 0xffffffff,
//   				dword(4) = 0xffffffff};
//     message   Honda_Diag_FCAN_Func_FB_Req ReqDiagMsgGlobalFunB = {
//   				dword(0) = 0xffffffff,
//   				dword(4) = 0xffffffff};
//     message   Honda_Diag_FCAN_Func_FC_Req ReqDiagMsgGlobalFunC = {
//   				dword(0) = 0xffffffff,
//   				dword(4) = 0xffffffff};
//     message   Honda_Diag_FCAN_Func_FD_Req ReqDiagMsgGlobalFunD = {
//   				dword(0) = 0xffffffff,
//   				dword(4) = 0xffffffff}; 
   	   
   	mstimer   TesterPresentTimeOutTimer;
   	const int TesterPresentTimeOutTime = 4000;
  	 
   	int 	  DiagActive = 0;       
  

    
    msTimer   UpdateRuntime;
	const int UpdateCycle = 1000;




     //to doors-automate-tests

    int readTimeValue;          //elapsed time counter (ms)
    char DTCValue [255];        //internal container for error codes  
    msTimer readDtcTimer;       //for repeat the reading process
    int CNTR_VALUE=200;         //default timer resolution (ms)
    char readString[255];       //to store the read DTC command
    byte readRequest[255];      //to store the read DTC command
    int requestSize;            //
    char msString[30];          //for the information string
    byte ErrValue [8192];       //the representation of RxDataBuffer
    char ErrString [8192];      //the characteric representation of RxDataBuffer
    char tempString [8192];     //for internal use
    int WaitValue=0;
    int count_value=1;

    

	 
    //Seed&key
    msTimer     FingerPrint;
    msTimer     ProgDate;
    msTimer     SeednKeyReq;
    msTimer     MinicodeReq;
    msTimer     ActPMode;
    mstimer     ActPMode_SP;
    mstimer     Wait;
    msTimer     code_variant;
    msTimer     Wait_diag;
    msTimer     Wait_on;
    msTimer     Wait_off;
    int         igResetEventCount = 1;
    int         igResetIndex = 0;
    float       igOffDelayMs[64] = {50871.431};
    float       igOnDelayMs[64] = {5132.077};
// IG_RESET_PROFILE_SOURCE: Diag_customer_MPC_#5_1_N1 - Copy.asc (1 event(s))
   
    
    //
    char Service_ID[152];
    char Coding_Variant[11];
    char Zeros_Reserve[102];

    byte Fingerprint[9]={0x2e,0xf1,0x98,0x01,0x02,0x03,0x04,0x05,0x06};
    byte ProgrammingDate[6]={0x2e,0xf1,0x99,0x19,0x01,0x09};
    byte SeednKeyRequest[2]={0x27,0x03};
    byte SeednKeyReprogRequest[2]={0x27,0x11};
    //byte SeednKeyRBEOLRequest[2]={0x27,0x61}; //M.I.
    byte MinicodeRequest[2]= {0x27,0x21};
    dword seedReprogValue,  keyLowReprogValue, keyUpperReprogValue;
    dword keyReprogValue;
    dword authKey;
    byte     pufferEOL[10]={0,0,0,0,0,0,0,0,0,0};
    dword keyMaxReprogValue = 0xFFFFFFFF;
    dword WLA, WLAaktiv, WLApassiv; 

    byte whichlogin=0;
    dword result=0; 
    byte resultarray[6]={0x27,0,0,0,0,0};

    byte sec_key[4], byte_buf[2];
    dword SK1;
    dword SK2;
    dword SK3;
    long SeedInInit = 0x00;
    long KeyInInt = 0x00;
    
    byte KeyInByte[2];
    byte resultarrayTypeOne[4]={0x27,0,0,0};
    byte resultarrayTypeFour[7]={0x27,0,0,0,0,0,0};
    byte resultarrayTypeFive[6]={0x27,0,0,0,0,0};
    int SFC1[4] = {0xAE, 0xFC, 0x2A, 0x98};
    int SFC2[4] = {0x41, 0x43, 0x43, 0x2F};
    int SFC3[4] = {0x43, 0x4D, 0x42, 0x53};
    const long SFS1 = 0x01;
    const int SFS2 = 0x03;
    const int SC4 = 0xD9;
    int byte_buf1[4] = {0, 0, 0, 0};
    int sum_res[5];
    int sum_carry;
    int Keywk1[5] = {0, 0, 0, 0, 0};
    int Keywk2[5] = {0, 0, 0, 0, 0};
    int Keywk3[5] = {0, 0, 0, 0, 0};
    long KC4;
    int phase;
    char Series_Package[3];
    char SP_EOLcode[16]="3d2200110001";
    
    
//////////////////////////////////////////////////////////////////////////////////////////////    
    
    //Security Unlock GEN 3 - RBEOL(Static & COnventional) & HONDA - Variables used
    
    	int 	DirectCounter;
  //Constants for Diag Switch
  //const int DIRECT_RQ			        =0;// Request const variable for Diag service function 
  //const int READ_DTC_BY_ST        =1;//Request const variable for Read DTC service function
 // const int TESTER_PRESENT_ON     =2;
 // const int TESTER_PRESENT_OFF    =3;
 // const int DIAG_SESSION_ON        =4;
 // const int CLEAR_DTC              =5;      
 // const int READ_DTC_PASS          =6; 
  const int ACT_PLANT_MODE_1       =7;
  const int ACT_PLANT_MODE_2       =8;
  const int SEEDNKEYREQUEST        =9;
 // const int SEEDNKEYRESP           =10; 
  const int SEEDNKEYFBLREQUEST     =11;
  const int SEEDNKEYHONDAEOLREQUEST  =12;
  const int SEEDNKEYHONDARESP        =13;
  const int SEEDNKEYRBEOLREQUEST = 80;//M.I..
  const int SEEDNKEYFBLDYNAMICREQUEST = 15;
  const int SEEDNKEYHONDADYNAMICREQUEST = 16;
  const int SEEDNKEYHONDAREQUEST    = 17;  
  const int SEEDNKEYRBEOLRESP = 18;
    char DTC_File_Path[250];
  char absPathsecurity[256];
 //mstimer 
   msTimer sectimer1;
      msTimer sectimer2;
    //Container
   // byte SeednKeyRequest[2]={0x27,0x03};
    byte SeednKeyFBLRequest[2] = {0x27,0x61};
    byte SeednKeyHONDAEOLRequest[2] = {0x27,0x01};
   // byte SeednKeyReprogRequest[2]={0x27,0x10};
    byte SeednKeyRBEOLRequest[2]={0x27,0x61}; //M.I.
  //  byte MinicodeRequest[2]= {0x27,0x21};
   // dword seedReprogValue,  keyLowReprogValue, keyUpperReprogValue;
  //  dword authKey;//M.I.
   // byte  pufferEOL[10]={0,0,0,0,0,0,0,0,0,0};//M.I.
  //  dword keyReprogValue;
  //  dword keyMaxReprogValue = 0xFFFFFFFF; 
    byte sendKey[1024];
    int DynamicFlag = 0;
    char DynamicKey[2052];
    char temp1[5];
    char seedList[600][600];
    char keyList[2048][2048];
    char seedListHONDA[600][600];
    char keyListHONDA[2048][2048];
     	//Rx related variable 
	const dword gRxSize = 65000;
	byte 	  gRxDataBuffer[gRxSize];
	int  	  gRxBufferIndex;
	int  	  gRxLength;        
	//char     hexaStr[6];
    char  gstring_displaybuffer[65000];
    //**********************************Constants for RBEOL and Customer EOL*****************************************************
  	const int READ_DTC_BY_ST_RBEOL = 89;
    const int DOIP_Read_DTC_CustomerEOL = 19;
    char	MVbufferDTC[8192] ;
    char MVbufferDTC1[8192];
    byte DTC_dataBuffer_Send[4096];
      dword RBEOL_size;
    //msTimer ActPMode;
   // msTimer Send_DTC_Req;
    dword DTC_FILE; //****************DTC_FILE***********************
    char DTC_ID_Buffer[8192];
    byte 	  gRxDataBuffer2[gRxSize];
    
    byte defaultsec[1]; 
    int dynamicKeyLen;
    int securityType = SEEDNKEYREQUEST;
    int securityTypeHONDA = SEEDNKEYHONDAREQUEST;

    //byte whichlogin=0;
   // dword result=0; 
    int k=0;
    // Variables for Requests
  //  int   	  CurrentDiagServ  = 0;
    //read dtc variables
	dword 	  gerrorDTC[256];
	dword 	  gerrorStatus[256]; 
	int  	  gCurrentDTC = 0;
	int  	  gNrOfReadDTC ;
	dword 	  gerrorHistDTC[256];
	byte 	  gerrorHistStatus[256]; 
	int  	  gCurrentHistDTC = 0;
	int  	  gNrOfHistDTC;  
	int  	  gNrOfReadHistDTC;   
	//int readTimeValue;          //elapsed time counter (ms)
	//char DTCValue [255];        //internal container for error codes  
    // Variables for Requests
int 	ReceiveBufferLength;
   // status 
  byte 	TransmitBuffer[65000];
  byte 	ReceiveBuffer[65000];
      int i, j, c_index, bin;
    int challenge[64], position_one[24], position_two[24];
    int init_array[24] = {1,0,0,1,0,1,0,1,1,0,0,0,0,0,1,0,1,0,1,0,0,0,1,1};
    byte input[8];
   // byte resultarray[6] = {0x27,0,0,0,0,0};
    byte resultarra[5] = {0x27,0,0,0,0};
    byte securityresponse[128];
      char	MVbuffer[200000] = "";
  char	MVbuffer2[200000] = "0x"; 
      byte SecurityBuffer[1];
    
     //TX related variables 
   const dword gTxsize=65000;
    int gTxlength;
	Byte gTxdatabuffer_temp[3]={22,22,22};
	byte gDiaTxdatabuffer[gTxsize];
    
    
    
    
    //Security Timer
  //  msTimer WaitForUnlock;
  
  
      //For NA RBS
  msTimer WaitForextendedsession;
  msTimer WaitForunlock;

    byte SWbuildversion[9];
  byte VariantName[5];
  byte SeriesPKG[1];
  
  
}







//SEC UNLOCK GEN 3 :
on envvar Env_Honda_EOL_unlock             //EOL unlock
{
     securityType = 11;
  if(getValue(EnvRBEOL_Seed_Key_Switch)==2)
   {
    getAbsFilePath("\\vs_models\\ECU_Unlock_Security_Before_FV0240.xml", absPathsecurity, 256);
    write("ECU_Unlock_Security_old.xml=%s (OLD Platform)",absPathsecurity);
   }
  else if(getValue(EnvRBEOL_Seed_Key_Switch)==1)
  {
    getAbsFilePath("\\vs_models\\ECU_Unlock_Security_FV0240_Onwards.xml", absPathsecurity, 256);
    write("ECU_Unlock_Security.xml=%s",absPathsecurity);
  }
  else if(getValue(EnvRBEOL_Seed_Key_Switch)==0) 
  {
    getAbsFilePath("\\vs_models\\ECU_Unlock_Security_FV0242_Onwards.xml", absPathsecurity, 256);
    write("ECU_Unlock_Security.xml=%s",absPathsecurity);
  }
  ParseSecurityXML(absPathsecurity);
 Write("LoopBack");
  write("In Env_Honda_EOL_unlock = %d",getValue (this));
   if ( getValue (this) )
    {
      write("Inside loop....");
      getValue(Env_Security_SubFunction,SecurityBuffer);
      SeednKeyFBLRequest[1] = SecurityBuffer[0];
      write("Prog_Unl securityType = %x", securityType);
      write("SeednKeyFBLRequest = %x", SeednKeyFBLRequest[1]);
      
      if(securityType == SEEDNKEYFBLDYNAMICREQUEST)
      { 
        write("In IF _ securityType = %d", securityType);
        putValue(Env_SecurityMode_Output,"Dynamic Security Mode");
        StartDiagService( SEEDNKEYFBLDYNAMICREQUEST );
      }
      else if(securityType == SEEDNKEYFBLREQUEST)
      {
        
        putValue(Env_SecurityMode_Output,"Static Security Mode");
        StartDiagService( SEEDNKEYFBLREQUEST );
      }
      else
      {
          Write("In Else ME ");
        putValue(Env_SecurityMode_Output,"Conventional Security Mode");
        StartDiagService( SEEDNKEYREQUEST );
      }
    }
    write("Exit--Ooops");
    putvalue(Env_Honda_EOL_unlock,0);
    //absPathsecurity[] = "";
}
on envvar Env_Honda_EOL_unlock_Non_Secure             //Non Secure EOL unlock
{
     securityType = 11;
   getAbsFilePath("\\vs_models\\ECU_Unlock_Security_Non_Secure.xml", absPathsecurity, 256);
  write("ECU_Unlock_Security_Non_Secure.xml=%s",absPathsecurity);
  ParseSecurityXML(absPathsecurity);
 Write("LoopBack");
  write("In Env_Honda_EOL_unlock_Non_Secure = %d",getValue (this));
   if ( getValue (this) )
    {
      write("Inside loop....");
      getValue(Env_Security_SubFunction,SecurityBuffer);
      SeednKeyFBLRequest[1] = SecurityBuffer[0];
      write("Prog_Unl securityType = %x", securityType);
      write("SeednKeyFBLRequest = %x", SeednKeyFBLRequest[1]);
      
      if(securityType == SEEDNKEYFBLDYNAMICREQUEST)
      { 
        write("In IF _ securityType = %d", securityType);
        putValue(Env_SecurityMode_Output,"Dynamic Security Mode");
        StartDiagService( SEEDNKEYFBLDYNAMICREQUEST );
      }
      else if(securityType == SEEDNKEYFBLREQUEST)
      {
        
        putValue(Env_SecurityMode_Output,"Static Security Mode");
        StartDiagService( SEEDNKEYFBLREQUEST );
      }
      else
      {
          Write("In Else ME ");
        putValue(Env_SecurityMode_Output,"Conventional Security Mode");
        StartDiagService( SEEDNKEYREQUEST );
      }
    }
    write("Exit--Ooops");
    putvalue(Env_Honda_EOL_unlock_Non_Secure,0);
}



/////////////////////////////////////////////////////////////////////////////////


on envVar Env_VariantCodingPreconditions
{
    phase = 0;
    setTimer(waitTimeForResponse, 1000);  
}

on timer waitTimeForResponse
{
  switch (phase)
  {
    case 0:
    
    StartDiagService( DIAG_SESSION_ON );
    putvalue(EnvTesterPresentOnOff,1);
    setTimer(waitTimeForResponse, 300);
    break;
    
    case 1:
    
    whichlogin=4;
    StartDiagService( SEEDNKEYREQUESTUNLOCKFOUR );
    //putvalue(EnvLogInUnlockTypeFour,1);
    setTimer(waitTimeForResponse, 400);
    break;
  
    case 2:
   
    StartDiagService( ENGINEERING_SESSION_ON );
    setTimer(waitTimeForResponse, 300);
    break;
    case 3:
     putvalue(EnvDirectSend,"2e48f50030303030300000000000000000000000000000000000000000000000000000000000000000000000000000000000000000000000000000"); 
      putvalue(EnvTesterPresentOnOff,0);
   // putValue(Env_VariantCodingPreconditions,0);
      default:
     write("Invalid phase!!!");
    break;
    
  }

//putValue(Env_VariantCodingPreconditions,0);
  phase++;
}
on envVar Env_RADAR_Info
{
  seq=0;
  setTimer(Tm_Env_RADAR_Info,10);
}
on timer Tm_Env_RADAR_Info
{
   switch (seq)
	{
		case 0:
			putvalue(EnvDirectSend,"1001");
			setTimer(Tm_Env_RADAR_Info,100); 
			seq++;
		break;
		case 1:
			putvalue(EnvDirectSend,"80FA31033005");
			setTimer(Tm_Env_RADAR_Info,300); 
			seq++;
		break;
		case 2:
			putvalue(EnvDirectSend,"80FA1108");
			setTimer(Tm_Env_RADAR_Info,300); 
			seq++;
		break;
		case 3:
			putvalue(EnvRBEOL,1);
			setTimer(Tm_Env_RADAR_Info,400); 
			seq++;
		break;
		case 4:
			putvalue(EnvDirectSend,"232200ed0038");
      //setTimer(Tm_Env_RADAR_Info,900); 
		break;
	}
}
on envVar Env_Mismatch_DTC
{
        //      putValue(EnvDirectSend,"2e48F501544c4141300000000000000000000000000000000000000000000000000000000000000000000000000000000000000000000000000000");
//              putvalue(E_pric_Bosch_Radar_RADAR_VARIANT_INFO_VARIANT_INFO_1_Rv,0x22);
//              putvalue(E_pric_Bosch_Radar_RADAR_VARIANT_INFO_VARIANT_INFO_2_Rv,0x22);
//              putvalue(E_pric_Bosch_Radar_RADAR_VARIANT_INFO_VARIANT_INFO_3_Rv,0x22);
//              putvalue(E_pric_Bosch_Radar_RADAR_VARIANT_INFO_VARIANT_INFO_4_Rv,0x22);
//              putvalue(E_pric_Bosch_Radar_RADAR_VARIANT_INFO_VARIANT_INFO_5_Rv,0x22);
}

on envVar Env_MY22_3T0AExecute
{
strncpy(Zeros_Reserve,"0000000000000000000000000000000000000000000000000000000000000000000000000000000000000000000000000000",elcount(Zeros_Reserve));
  seq1=0;
  switch(getvalue(EnvHonda3T0AVariantSelect))
  {
      case 0x0:
               strncpy(Coding_Variant,"3354304A30",elcount(Coding_Variant));
               setTimer(code_variant,100); 
      
      break;
      
      case 0x1:
               strncpy(Coding_Variant,"3354304A31",elcount(Coding_Variant));
               setTimer(code_variant,100); 
      break;
    
      
      case 0x2:
               strncpy(Coding_Variant,"3354304A32",elcount(Coding_Variant));
               setTimer(code_variant,100); 
      break;
    
      
      case 0x3:
               strncpy(Coding_Variant,"3354314A30",elcount(Coding_Variant));
               setTimer(code_variant,100); 
      break;
      
      case 0x4:
               strncpy(Coding_Variant,"3354314A31",elcount(Coding_Variant));
               setTimer(code_variant,100); 
      break;
       case 0x5:
               strncpy(Coding_Variant,"3354314A32",elcount(Coding_Variant));
               setTimer(code_variant,100); 
      break;
       case 0x6:
               strncpy(Coding_Variant,"3354324A30",elcount(Coding_Variant));
               setTimer(code_variant,100); 
      break;
       case 0x7:
               strncpy(Coding_Variant,"3354324A31",elcount(Coding_Variant));
               setTimer(code_variant,100); 
      break;
       case 0x8:
               strncpy(Coding_Variant,"3354324A32",elcount(Coding_Variant));
               setTimer(code_variant,100); 
      break;
        case 0x9:
               strncpy(Coding_Variant,"3354305530",elcount(Coding_Variant));
               setTimer(code_variant,100); 
      break;
        case 0xA:
               strncpy(Coding_Variant,"3354305531",elcount(Coding_Variant));
               setTimer(code_variant,100); 
      break;
        case 0xB:
               strncpy(Coding_Variant,"3354305532",elcount(Coding_Variant));
               setTimer(code_variant,100); 
      break;
//        case 0xC:
//               strncpy(Coding_Variant,"3354325530",elcount(Coding_Variant));
//               setTimer(code_variant,100); 
//      break;
        case 0xD:
               strncpy(Coding_Variant,"3354325531",elcount(Coding_Variant));
               setTimer(code_variant,100); 
      break;
        case 0xE:
               strncpy(Coding_Variant,"3354304A33",elcount(Coding_Variant));
               setTimer(code_variant,100); 
      break;
        case 0xF:
               strncpy(Coding_Variant,"3354314A33",elcount(Coding_Variant));
               setTimer(code_variant,100); 
      break;
        case 0x10:
               strncpy(Coding_Variant,"3354305533",elcount(Coding_Variant));
               setTimer(code_variant,100); 
      break;
    

      break;
      case 0x11:
               phase=0;
               setTimer(waitTimeForResponse,100);
      break;
      default:
       write("Invalid phase!!!");
      break;
  }
}


on envVar Env_MY22T90AExecute
{
strncpy(Zeros_Reserve,"0000000000000000000000000000000000000000000000000000000000000000000000000000000000000000000000000000",elcount(Zeros_Reserve));
  seq1=0;
  switch(getvalue(EnvHondaT90AVariantSelect))
  {
      case 0x0:
               strncpy(Coding_Variant,"5439305930",elcount(Coding_Variant));
               setTimer(code_variant,100); 
      
      break;
      
      case 0x1:
               strncpy(Coding_Variant,"5439305931",elcount(Coding_Variant));
               setTimer(code_variant,100); 
      break;
    
      
      case 0x2:
               strncpy(Coding_Variant,"5439304430",elcount(Coding_Variant));
               setTimer(code_variant,100); 
      break;
    
      
      case 0x3:
               strncpy(Coding_Variant,"5439305932",elcount(Coding_Variant));
               setTimer(code_variant,100); 
      break;
      
//      case 0x4:
//               strncpy(Coding_Variant,"5439305830",elcount(Coding_Variant));
//               setTimer(code_variant,100); 
//      break;
//       case 0x5:
//               strncpy(Coding_Variant,"5439305933",elcount(Coding_Variant));
//               setTimer(code_variant,100); 
//      break;
       case 0x6:
               strncpy(Coding_Variant,"5439304B30",elcount(Coding_Variant));
               setTimer(code_variant,100); 
      break;
       case 0x7:
               strncpy(Coding_Variant,"5439304B31",elcount(Coding_Variant));
               setTimer(code_variant,100); 
      break;
//       case 0x8:
//               strncpy(Coding_Variant,"5439304B32",elcount(Coding_Variant));
//               setTimer(code_variant,100); 
//      break;
        case 0x9:
               strncpy(Coding_Variant,"5439304130",elcount(Coding_Variant));
               setTimer(code_variant,100); 
      break;
        case 0xA:
               strncpy(Coding_Variant,"5439304131",elcount(Coding_Variant));
               setTimer(code_variant,100); 
      break;
        case 0xB:
               strncpy(Coding_Variant,"5439304132",elcount(Coding_Variant));
               setTimer(code_variant,100); 
      break;
        case 0xC:
               strncpy(Coding_Variant,"5439304133",elcount(Coding_Variant));
               setTimer(code_variant,100); 
      break;
        case 0xD:
               strncpy(Coding_Variant,"5439304134",elcount(Coding_Variant));
               setTimer(code_variant,100); 
      break;
        case 0xE:
               strncpy(Coding_Variant,"5439304135",elcount(Coding_Variant));
               setTimer(code_variant,100); 
      break;
        case 0xF:
               strncpy(Coding_Variant,"5439314130",elcount(Coding_Variant));
               setTimer(code_variant,100); 
      break;
        case 0x10:
               strncpy(Coding_Variant,"5439314131",elcount(Coding_Variant));
               setTimer(code_variant,100); 
      break;
        case 0x11:
               strncpy(Coding_Variant,"5439314132",elcount(Coding_Variant));
               setTimer(code_variant,100); 
      break;
        case 0x12:
               strncpy(Coding_Variant,"5439314133",elcount(Coding_Variant));
               setTimer(code_variant,100); 
      break;
  
           
      case 0x14:
               strncpy(Coding_Variant,"5439315830",elcount(Coding_Variant));
               setTimer(code_variant,100); 
      break;
      
      case 0x15:
               strncpy(Coding_Variant,"5439315930",elcount(Coding_Variant));
               setTimer(code_variant,100); 
      break;
     
      case 0x16:
               strncpy(Coding_Variant,"5439314B30",elcount(Coding_Variant));
               setTimer(code_variant,100); 
      break;
      
      case 0x17:
               phase=0;
               setTimer(waitTimeForResponse,100);
      break;
      default:
       write("Invalid phase!!!");
      break;
  }
}
on envVar Env_MY23_31VAExecute
{
strncpy(Zeros_Reserve,"0000000000000000000000000000000000000000000000000000000000000000000000000000000000000000000000000000",elcount(Zeros_Reserve));
  seq1=0;
  switch(getvalue(EnvHonda31VAVariantSelect))
  {
      case 0x0:
               strncpy(Coding_Variant,"3331564830",elcount(Coding_Variant));
               setTimer(code_variant,100); 
      
      break;
      
//      case 0x1:
//               strncpy(Coding_Variant,"3331574830",elcount(Coding_Variant));
//               setTimer(code_variant,100); 
//      break;      
      
      case 0x2:
               strncpy(Coding_Variant,"3331564831",elcount(Coding_Variant));
               setTimer(code_variant,100); 
      break;  
      
      case 0x3:
               strncpy(Coding_Variant,"3331574831",elcount(Coding_Variant));
               setTimer(code_variant,100); 
      break;  
      
      case 0x4:
               phase=0;
               setTimer(waitTimeForResponse,100);
      break;
      default:
       write("Invalid phase!!!");
      break;
  }
}
on envVar Env_MY22FB6LExecute
{
strncpy(Zeros_Reserve,"0000000000000000000000000000000000000000000000000000000000000000000000000000000000000000000000000000",elcount(Zeros_Reserve));
  seq1=0;
  switch(getvalue(EnvHondaFB6LVariantSelect))
  {
      case 0x0:
               strncpy(Coding_Variant,"4642364C30",elcount(Coding_Variant));
               setTimer(code_variant,100); 
      
      break;
      
      case 0x1:
               strncpy(Coding_Variant,"4642364c31",elcount(Coding_Variant));
               setTimer(code_variant,100); 
      break;
    
      
      case 0x2:
               strncpy(Coding_Variant,"4642364c32",elcount(Coding_Variant));
               setTimer(code_variant,100); 
      break;
    
      
      case 0x3:
               strncpy(Coding_Variant,"4642364c34",elcount(Coding_Variant));
               setTimer(code_variant,100); 
      break;
      
      case 0x4:
               strncpy(Coding_Variant,"4642364c35",elcount(Coding_Variant));
               setTimer(code_variant,100); 
      break;
       case 0x5:
               strncpy(Coding_Variant,"4642364130",elcount(Coding_Variant));
               setTimer(code_variant,100); 
      break;
       case 0x6:
               strncpy(Coding_Variant,"4642364131",elcount(Coding_Variant));
               setTimer(code_variant,100); 
      break;
       case 0x7:
               strncpy(Coding_Variant,"4642364132",elcount(Coding_Variant));
               setTimer(code_variant,100); 
      break;
       case 0x8:
               strncpy(Coding_Variant,"4642364a30",elcount(Coding_Variant));
               setTimer(code_variant,100); 
      break;
      
      case 0x9:
               phase=0;
               setTimer(waitTimeForResponse,100);
      break;
      default:
       write("Invalid phase!!!");
      break;
  }
}
on envVar Env_MY22_CRV_Execute
{
strncpy(Zeros_Reserve,"0000000000000000000000000000000000000000000000000000000000000000000000000000000000000000000000000000",elcount(Zeros_Reserve));
  seq1=0;
  switch(getvalue(EnvHonda_MY22_CRV_VariantSelect))
  {
//      case 0x0:																						
//               strncpy(Coding_Variant,"3341384A30",elcount(Coding_Variant));                        
//               setTimer(code_variant,100);                                                          
//                                                                                                    
//      break;                                                                                        
//                                                                                                    
////      case 0x1:                                                                                     
////               strncpy(Coding_Variant,"3341384A31",elcount(Coding_Variant));                        
////               setTimer(code_variant,100);                                                          
////      break;                                                                                        
//                                                                                                    
//                                                                                                    
//      case 0x2:                                                                                     
//               strncpy(Coding_Variant,"3341394A30",elcount(Coding_Variant));                        
//               setTimer(code_variant,100);                                                          
//      break;                                                                                        
//                                                                                                    
//                                                                                                    
////      case 0x3:                                                                                     
////               strncpy(Coding_Variant,"3341394A31",elcount(Coding_Variant));                        
////               setTimer(code_variant,100);                                                          
////      break;                                                                                        
                                                                                                    
      case 0x4:                                                                                     
               strncpy(Coding_Variant,"3341325030",elcount(Coding_Variant));                        
               setTimer(code_variant,100);                                                          
      break;                                                                                        
                                                                                                    
      case 0x5:                                                                                     
               strncpy(Coding_Variant,"3341304130",elcount(Coding_Variant));                        
               setTimer(code_variant,100);                                                          
      break;                                                                                        
                                                                                                    
      case 0x6:                                                                                     
               strncpy(Coding_Variant,"3341304131",elcount(Coding_Variant));                        
               setTimer(code_variant,100);                                                          
      break;                                                                                        
                                                                                                    
//      case 0x7:                                                                                     
//               strncpy(Coding_Variant,"3341304132",elcount(Coding_Variant));                        
//               setTimer(code_variant,100);                                                          
//      break;                                                                                        
//      case 0x8:                                                                                     
//               strncpy(Coding_Variant,"3341304133",elcount(Coding_Variant));                        
//               setTimer(code_variant,100);                                                          
//      break;                                                                                        
      case 0x9:                                                                                     
               strncpy(Coding_Variant,"3341335030",elcount(Coding_Variant));                        
               setTimer(code_variant,100);                                                          
      break;                                                                                        
      case 0xA:                                                                                     
               strncpy(Coding_Variant,"3341335033",elcount(Coding_Variant));                        
               setTimer(code_variant,100);                                                          
      break;                                                                                        
        case 0xB:                                                                                   
               strncpy(Coding_Variant,"3341314130",elcount(Coding_Variant));                        
               setTimer(code_variant,100);                                                          
      break;                                                                                        
                                                                                                    
                                                                                                    
           case 0xC:                                                                                
               strncpy(Coding_Variant,"3341314131",elcount(Coding_Variant));                        
               setTimer(code_variant,100);                                                          
      break;                                                                                        
//          case 0xD:                                                                                 
//               strncpy(Coding_Variant,"3341314132",elcount(Coding_Variant));                        
//               setTimer(code_variant,100);                                                          
//      break;                                                                                        
//               case 0xE:                                                                            
//               strncpy(Coding_Variant,"3341314133",elcount(Coding_Variant));                        
//               setTimer(code_variant,100);                                                          
//      break;                                                                                        
//             case 0xF:                                                                              
//               strncpy(Coding_Variant,"3342324A30",elcount(Coding_Variant));                        
//               setTimer(code_variant,100);                                                          
//      break;                                                                                        
//        case 0x10:                                                                                  
//               strncpy(Coding_Variant,"3342324A31",elcount(Coding_Variant)); 		                     
//               setTimer(code_variant,100);                                                          
//      break;                                                                                        
//      case 0x11:                                                                                    
//               strncpy(Coding_Variant,"3342334A30",elcount(Coding_Variant));                        
//               setTimer(code_variant,100);                                                          
//      break;                                                                                        
//       case 0x12:                                                                                   
//               strncpy(Coding_Variant,"3342334A31",elcount(Coding_Variant));                        
//               setTimer(code_variant,100);                                                          
//      break;                                                                                        
//       case 0x13:                                                                                   
//               strncpy(Coding_Variant,"3344344130",elcount(Coding_Variant));                        
//               setTimer(code_variant,100);                                                          
//      break;                                                                                        
       case 0x14:                                                                                   
               strncpy(Coding_Variant,"3344344131",elcount(Coding_Variant));                        
               setTimer(code_variant,100);                                                          
      break;                                                                                        
       case 0x15:                                                                                   
               strncpy(Coding_Variant,"3344344132",elcount(Coding_Variant));                        
               setTimer(code_variant,100);                                                          
                                                                                                    
      break;
       case 0x16:
               strncpy(Coding_Variant,"3344344133",elcount(Coding_Variant));
               setTimer(code_variant,100); 

      break;
//       case 0x17:
//               strncpy(Coding_Variant,"3344354130",elcount(Coding_Variant));
//               setTimer(code_variant,100); 
//
//      break;
//       case 0x18:
//               strncpy(Coding_Variant,"3344354131",elcount(Coding_Variant));
//               setTimer(code_variant,100); 
//
//      break;
       case 0x19:
               strncpy(Coding_Variant,"3344354132",elcount(Coding_Variant));
               setTimer(code_variant,100); 

      break;
       case 0x1A:
               strncpy(Coding_Variant,"3344354133",elcount(Coding_Variant));
               setTimer(code_variant,100); 

      break;
       case 0x1B:
               strncpy(Coding_Variant,"3345344830",elcount(Coding_Variant));
               setTimer(code_variant,100); 

      break;
//       case 0x1D:
//               strncpy(Coding_Variant,"3345344831",elcount(Coding_Variant));
//             setTimer(code_variant,100); 
//
//     break;
//       case 0x1F:
//               strncpy(Coding_Variant,"3345344832",elcount(Coding_Variant));
//               setTimer(code_variant,100); 
//      break;
//      case 0x23:
//               strncpy(Coding_Variant,"3345354830",elcount(Coding_Variant));
//               setTimer(code_variant,100);
//
//      break;
//       case 0x1F:
//               strncpy(Coding_Variant,"3345354831",elcount(Coding_Variant));
//               setTimer(code_variant,100);
//
//      break;
//       case 0x20:
//               strncpy(Coding_Variant,"3345364530",elcount(Coding_Variant));
//               setTimer(code_variant,100);
//
//      break;
//       case 0x21:
//               strncpy(Coding_Variant,"3345364531",elcount(Coding_Variant));
//               setTimer(code_variant,100);

      break;
       case 0x22:
               strncpy(Coding_Variant,"3344354134",elcount(Coding_Variant));
               setTimer(code_variant,100);

      break;
       case 0x23:
               strncpy(Coding_Variant,"3345354830",elcount(Coding_Variant));
               setTimer(code_variant,100);

      break;
//       case 0x24:
//               strncpy(Coding_Variant,"3345374531",elcount(Coding_Variant));
//               setTimer(code_variant,100);
//
//      break;
//       case 0x25:
//               strncpy(Coding_Variant,"3345374532",elcount(Coding_Variant));
//               setTimer(code_variant,100);
//
//      break;
//       case 0x26:
//               strncpy(Coding_Variant,"3345364830",elcount(Coding_Variant));
//               setTimer(code_variant,100);
//
//      break;
//       case 0x27:
//               strncpy(Coding_Variant,"3345364831",elcount(Coding_Variant));
//               setTimer(code_variant,100);
//
//      break;
//       case 0x28:
//               strncpy(Coding_Variant,"3345364832",elcount(Coding_Variant));
//               setTimer(code_variant,100);
//
//      break;
//       case 0x29:
//               strncpy(Coding_Variant,"3345364730",elcount(Coding_Variant));
//               setTimer(code_variant,100);
//
//      break;
//       case 0x2A:
//               strncpy(Coding_Variant,"3345364731",elcount(Coding_Variant));
//               setTimer(code_variant,100);
//
//      break;
//       case 0x2B:
//               strncpy(Coding_Variant,"3345364732",elcount(Coding_Variant));
//               setTimer(code_variant,100);
//
//      break;
//       case 0x2C:
//               strncpy(Coding_Variant,"3345374830",elcount(Coding_Variant));
//               setTimer(code_variant,100);
//
//      break;
//       case 0x2D:
//               strncpy(Coding_Variant,"3345374831",elcount(Coding_Variant));
//               setTimer(code_variant,100);
//
//      break;
       case 0x2E:
               strncpy(Coding_Variant,"3344385030",elcount(Coding_Variant));
               setTimer(code_variant,100);

      break;
//       case 0x2F:
//               strncpy(Coding_Variant,"3345374730",elcount(Coding_Variant));
//               setTimer(code_variant,100);
//
//      break;
//       case 0x30:
//               strncpy(Coding_Variant,"3345374731",elcount(Coding_Variant));
//               setTimer(code_variant,100);
//
//      break;
       case 0x31:
               strncpy(Coding_Variant,"3344395031",elcount(Coding_Variant));
               setTimer(code_variant,100);

      break;
       case 0x32:
               strncpy(Coding_Variant,"3343305430",elcount(Coding_Variant));
               setTimer(code_variant,100);

      break;
       case 0x33:
               strncpy(Coding_Variant,"3343305431",elcount(Coding_Variant));
               setTimer(code_variant,100);

      break;
//       case 0x34:
//               strncpy(Coding_Variant,"3343305432",elcount(Coding_Variant));
//               setTimer(code_variant,100);
//
//      break;
       case 0x35:
               strncpy(Coding_Variant,"3343305130",elcount(Coding_Variant));
               setTimer(code_variant,100);

      break;
       case 0x36:
               strncpy(Coding_Variant,"3343305131",elcount(Coding_Variant));
               setTimer(code_variant,100);

      break;
       case 0x37:
               strncpy(Coding_Variant,"3343315430",elcount(Coding_Variant));
               setTimer(code_variant,100);

      break;
//       case 0x38:
//               strncpy(Coding_Variant,"3343315431",elcount(Coding_Variant));
//               setTimer(code_variant,100);
//
//      break;
       case 0x39:
               strncpy(Coding_Variant,"3343315432",elcount(Coding_Variant));
               setTimer(code_variant,100);

      break;
       case 0x3A:
               strncpy(Coding_Variant,"3343315130",elcount(Coding_Variant));
               setTimer(code_variant,100);

      break;
       case 0x3B:
               strncpy(Coding_Variant,"3343305030",elcount(Coding_Variant));
               setTimer(code_variant,100);

      break;
       case 0x3C:
               strncpy(Coding_Variant,"3343305031",elcount(Coding_Variant));
               setTimer(code_variant,100);

      break;
       case 0x3D:
               strncpy(Coding_Variant,"3343305032",elcount(Coding_Variant));
               setTimer(code_variant,100);

      break;
//       case 0x3E:
//               strncpy(Coding_Variant,"3343305033",elcount(Coding_Variant));
//               setTimer(code_variant,100);

      break;
       case 0x3F:
               strncpy(Coding_Variant,"3343315030",elcount(Coding_Variant));
               setTimer(code_variant,100);

      break;
//       case 0x40:
//               strncpy(Coding_Variant,"3346374830",elcount(Coding_Variant));
//               setTimer(code_variant,100);
//
//
//      break;
       case 0x41:
               strncpy(Coding_Variant,"3343315032",elcount(Coding_Variant));
               setTimer(code_variant,100);

      break;
       case 0x42:
               strncpy(Coding_Variant,"3343305433",elcount(Coding_Variant));
               setTimer(code_variant,100);

      break;
       case 0x43:
               strncpy(Coding_Variant,"3343315433",elcount(Coding_Variant));
               setTimer(code_variant,100);

      break;
       case 0x44:
               strncpy(Coding_Variant,"3343325430",elcount(Coding_Variant));
               setTimer(code_variant,100);

      break;
       case 0x45:
               strncpy(Coding_Variant,"3343335430",elcount(Coding_Variant));
               setTimer(code_variant,100);

      break;
      case 0x46:
               strncpy(Coding_Variant,"3343335431",elcount(Coding_Variant));
               setTimer(code_variant,100);

      break;
      case 0x47:
               strncpy(Coding_Variant,"3343335130",elcount(Coding_Variant));
               setTimer(code_variant,100);

      break;
      case 0x48:
               strncpy(Coding_Variant,"3343325030",elcount(Coding_Variant));
               setTimer(code_variant,100);

      break;
//      case 0x49:
//               strncpy(Coding_Variant,"3343325031",elcount(Coding_Variant));
//               setTimer(code_variant,100);
//
//      break;
      case 0x4A:
               strncpy(Coding_Variant,"3343335030",elcount(Coding_Variant));
               setTimer(code_variant,100);


      break;
//      case 0x4B:
//               strncpy(Coding_Variant,"3343355030",elcount(Coding_Variant));
//               setTimer(code_variant,100);
//
//      break;
      case 0x4C:
               strncpy(Coding_Variant,"3343355031",elcount(Coding_Variant));
               setTimer(code_variant,100);

      break;
//      case 0x4D:
//               strncpy(Coding_Variant,"3343345430",elcount(Coding_Variant));
//               setTimer(code_variant,100);

      break;
//      case 0x4e:
//               strncpy(Coding_Variant,"3343355430",elcount(Coding_Variant));
//               setTimer(code_variant,100);
//
//      break;	  
      case 0x4F:
               strncpy(Coding_Variant,"3343365430",elcount(Coding_Variant));
               setTimer(code_variant,100);

      break;
//      case 0x50:
//               strncpy(Coding_Variant,"3343355431",elcount(Coding_Variant));
//               setTimer(code_variant,100);
//
//      break;
//      case 0x51:
//               strncpy(Coding_Variant,"3343355432",elcount(Coding_Variant));
//               setTimer(code_variant,100);
//
//      break;
         case 0x52:
               strncpy(Coding_Variant,"3343355433",elcount(Coding_Variant));
               setTimer(code_variant,100);
         break;

//   case 0x53:
//               strncpy(Coding_Variant,"3345384530",elcount(Coding_Variant));
//               setTimer(code_variant,100);
//
//      break;
//         case 0x54:
//               strncpy(Coding_Variant,"3345384531",elcount(Coding_Variant));
//               setTimer(code_variant,100);
//
//      break;
//         case 0x55:
//               strncpy(Coding_Variant,"3345384532",elcount(Coding_Variant));
//               setTimer(code_variant,100);
//
//      break;
//         case 0x56:
//               strncpy(Coding_Variant,"3345394530",elcount(Coding_Variant));
//               setTimer(code_variant,100);
//
//      break;
//         case 0x57:
//               strncpy(Coding_Variant,"3345394531",elcount(Coding_Variant));
//               setTimer(code_variant,100);
//
//      break;
//         case 0x58:
//               strncpy(Coding_Variant,"3345394532",elcount(Coding_Variant));
//               setTimer(code_variant,100);
//
//      break;
//         case 0x59:
//               strncpy(Coding_Variant,"3345384730",elcount(Coding_Variant));
//               setTimer(code_variant,100);
//
//      break;
//         case 0x5A:
//               strncpy(Coding_Variant,"3345384731",elcount(Coding_Variant));
//               setTimer(code_variant,100);
//
//      break;
//         case 0x5B:
//               strncpy(Coding_Variant,"3345384732",elcount(Coding_Variant));
//               setTimer(code_variant,100);
//
//      break;
//         case 0x5C:
//               strncpy(Coding_Variant,"3345394730",elcount(Coding_Variant));
//               setTimer(code_variant,100);
//
//      break;
//         case 0x5D:
//               strncpy(Coding_Variant,"3345394731",elcount(Coding_Variant));
//               setTimer(code_variant,100);
//
//      break;
//         case 0x5E:
//               strncpy(Coding_Variant,"3345394732",elcount(Coding_Variant));
//               setTimer(code_variant,100);
//
//      break;
//         case 0x5F:
//               strncpy(Coding_Variant,"3341385030",elcount(Coding_Variant));
//               setTimer(code_variant,100);
//
//      break;
//         case 0x60:
//               strncpy(Coding_Variant,"3341385031",elcount(Coding_Variant));
//               setTimer(code_variant,100);
//
//      break;
//         case 0x61:
//               strncpy(Coding_Variant,"3341395030",elcount(Coding_Variant));
//               setTimer(code_variant,100);
//
//      break;
//         case 0x62:
//               strncpy(Coding_Variant,"3342325030",elcount(Coding_Variant));
//               setTimer(code_variant,100);
//      break;			   
//         case 0x63:
//               strncpy(Coding_Variant,"3342335030",elcount(Coding_Variant));
//               setTimer(code_variant,100);
//	    break;
//      case 0x52:
//               strncpy(Coding_Variant,"3343355433",elcount(Coding_Variant));
//               setTimer(code_variant,100);
//	    break;
      case 0x64:
               strncpy(Coding_Variant,"3341335032",elcount(Coding_Variant));
               setTimer(code_variant,100);
	    break;
              case 0x66:
               strncpy(Coding_Variant,"3344395030",elcount(Coding_Variant));
               setTimer(code_variant,100);
      break;			   
         case 0x68:
               strncpy(Coding_Variant,"3343305036",elcount(Coding_Variant));
               setTimer(code_variant,100);
	    break;
//      case 0x6A:
//               strncpy(Coding_Variant,"3346374830",elcount(Coding_Variant));
//               setTimer(code_variant,100);
//	    break;
      case 0x6C:
               strncpy(Coding_Variant,"3343305434",elcount(Coding_Variant));
               setTimer(code_variant,100);
	    break;
//		        case 0x6E:
//               strncpy(Coding_Variant,"3343345430",elcount(Coding_Variant));
//               setTimer(code_variant,100);
      break;			   
         case 0x70:
               strncpy(Coding_Variant,"3342335032",elcount(Coding_Variant));
               setTimer(code_variant,100);
	    break;
//      case 0x72:
//               strncpy(Coding_Variant,"3342335031",elcount(Coding_Variant));
//               setTimer(code_variant,100);
//	    break;
       
      case 0x7A:
               strncpy(Coding_Variant,"3345374832",elcount(Coding_Variant));
               setTimer(code_variant,100);
	    break;
      
//      case 0x80:
//               strncpy(Coding_Variant,"3345374833",elcount(Coding_Variant));
//               setTimer(code_variant,100);
//	    break;
      
      case 0x86:
               strncpy(Coding_Variant,"3342384732",elcount(Coding_Variant));
               setTimer(code_variant,100);
	    break;
      
      case 0x8C:
               strncpy(Coding_Variant,"3342384733",elcount(Coding_Variant));
               setTimer(code_variant,100);
	    break;
      
      case 0x92:
               strncpy(Coding_Variant,"3342384531",elcount(Coding_Variant));
               setTimer(code_variant,100);
	    break;
      
      case 0x9E:
               strncpy(Coding_Variant,"3342384532",elcount(Coding_Variant));
               setTimer(code_variant,100);
	    break;
      
//      case 0xAA:
//               strncpy(Coding_Variant,"3342384830",elcount(Coding_Variant));
//               setTimer(code_variant,100);
//	    break;
      
      case 0xB6:
               strncpy(Coding_Variant,"3343315434",elcount(Coding_Variant));
               setTimer(code_variant,100);
	    break;
      
      case 0xC2:
               strncpy(Coding_Variant,"3346374830",elcount(Coding_Variant));
               setTimer(code_variant,100);
	    break;
      
      case 0xCE:
               strncpy(Coding_Variant,"3346374831",elcount(Coding_Variant));
               setTimer(code_variant,100);
	    break;
//      case 0xDA:
//               strncpy(Coding_Variant,"3342384831",elcount(Coding_Variant));
//               setTimer(code_variant,100);
//	    break;
      
      case 0xFE:
               strncpy(Coding_Variant,"3346334830",elcount(Coding_Variant));
               setTimer(code_variant,100);
	    break;
      
      case 0x116:
               strncpy(Coding_Variant,"3343305435",elcount(Coding_Variant));
               setTimer(code_variant,100);
	    break;
      
      case 0x12E:
               strncpy(Coding_Variant,"3346354831",elcount(Coding_Variant));
               setTimer(code_variant,100);
	    break;
      
      case 0x146:
               strncpy(Coding_Variant,"3346354830",elcount(Coding_Variant));
               setTimer(code_variant,100);
	    break;
      
      case 0x15E:
               phase=0;
               setTimer(waitTimeForResponse,100);
      break;
      default:
       write("Invalid phase!!!");
      break;
  }
}

on envVar Env_MY23_30AAExecute
{
strncpy(Zeros_Reserve,"0000000000000000000000000000000000000000000000000000000000000000000000000000000000000000000000000000",elcount(Zeros_Reserve));
  seq1=0;
  switch(getvalue(EnvHonda30AAVariantSelect))
  {
      case 0x0:
               strncpy(Coding_Variant,"3330414130",elcount(Coding_Variant));
               setTimer(code_variant,100); 
      
      break;
      
      case 0x1:
               strncpy(Coding_Variant,"3330414131",elcount(Coding_Variant));
               setTimer(code_variant,100); 
      break;
    
      
      case 0x2:
               strncpy(Coding_Variant,"3330424131",elcount(Coding_Variant));
               setTimer(code_variant,100); 
      break;
    
      
      case 0x3:
               strncpy(Coding_Variant,"3330424130",elcount(Coding_Variant));
               setTimer(code_variant,100); 
      break;
      
      case 0x4:
               strncpy(Coding_Variant,"3330424132",elcount(Coding_Variant));
               setTimer(code_variant,100); 
      break;
       case 0x5:
               strncpy(Coding_Variant,"3330415830",elcount(Coding_Variant));
               setTimer(code_variant,100); 
      break;
       case 0x6:
               strncpy(Coding_Variant,"3330415930",elcount(Coding_Variant));
               setTimer(code_variant,100); 
      break;
       case 0x7:
               strncpy(Coding_Variant,"3330415931",elcount(Coding_Variant));
               setTimer(code_variant,100); 
      break;
       case 0x8:
               strncpy(Coding_Variant,"3330425830",elcount(Coding_Variant));
               setTimer(code_variant,100); 
      break;
        case 0x9:
               strncpy(Coding_Variant,"3330425930",elcount(Coding_Variant));
               setTimer(code_variant,100); 
      break;
        case 0xA:
               strncpy(Coding_Variant,"3330425931",elcount(Coding_Variant));
               setTimer(code_variant,100); 
      break;
        case 0xB:
               strncpy(Coding_Variant,"3330414430",elcount(Coding_Variant));
               setTimer(code_variant,100); 
      break;
        case 0xC:
               strncpy(Coding_Variant,"3330424430",elcount(Coding_Variant));
               setTimer(code_variant,100); 
      break;
        case 0xD:
               strncpy(Coding_Variant,"3330424431",elcount(Coding_Variant));
               setTimer(code_variant,100); 
      break;
        case 0xE:
               strncpy(Coding_Variant,"3330414B30",elcount(Coding_Variant));
               setTimer(code_variant,100); 
      break;
//        case 0xF:
//               strncpy(Coding_Variant,"3330414B31",elcount(Coding_Variant));
//               setTimer(code_variant,100); 
//      break;
        case 0x10:
               strncpy(Coding_Variant,"3330424B30",elcount(Coding_Variant));
               setTimer(code_variant,100); 
      break;
//        case 0x11:
//               strncpy(Coding_Variant,"3330424D30",elcount(Coding_Variant));
//               setTimer(code_variant,100); 
//      break;
        case 0x12:
               strncpy(Coding_Variant,"33304B4830",elcount(Coding_Variant));
               setTimer(code_variant,100); 
      break;
//	        case 0x13:
//               strncpy(Coding_Variant,"33304B4831",elcount(Coding_Variant));
//               setTimer(code_variant,100); 
//      break;
        case 0x14:
               strncpy(Coding_Variant,"3330484830",elcount(Coding_Variant));
               setTimer(code_variant,100); 
      break;
	        case 0x15:
               strncpy(Coding_Variant,"3330484831",elcount(Coding_Variant));
               setTimer(code_variant,100); 
      break;
        case 0x16:
               strncpy(Coding_Variant,"33304D5430",elcount(Coding_Variant));
               setTimer(code_variant,100); 
      break;
	        case 0x17:
               strncpy(Coding_Variant,"33304D5431",elcount(Coding_Variant));
               setTimer(code_variant,100); 
      break;
        case 0x18:
               strncpy(Coding_Variant,"33304D5432",elcount(Coding_Variant));
               setTimer(code_variant,100); 
      break;
//	        case 0x19:
//               strncpy(Coding_Variant,"33304C5430",elcount(Coding_Variant));
//               setTimer(code_variant,100); 
//      break;
//        case 0x1A:
//               strncpy(Coding_Variant,"33304C5431",elcount(Coding_Variant));
//               setTimer(code_variant,100); 
//      break;
//	        case 0x1B:
//               strncpy(Coding_Variant,"33304C5530",elcount(Coding_Variant));
//               setTimer(code_variant,100); 
//      break;
//        case 0x1C:
//               strncpy(Coding_Variant,"33304C5531",elcount(Coding_Variant));
//               setTimer(code_variant,100); 
//      break;
//       case 0x1D:
//               strncpy(Coding_Variant,"33304C5032",elcount(Coding_Variant));
//               setTimer(code_variant,100); 
//      break;
//	        case 0x1E:
//               strncpy(Coding_Variant,"33304C5030",elcount(Coding_Variant));
//               setTimer(code_variant,100); 
//      break;
//        case 0x1F:
//               strncpy(Coding_Variant,"33304C5031",elcount(Coding_Variant));
//               setTimer(code_variant,100); 
//      break;
	        case 0x20:
               strncpy(Coding_Variant,"33304D5130",elcount(Coding_Variant));
               setTimer(code_variant,100); 
      break;

      case 0x21:
               strncpy(Coding_Variant,"33304D5530",elcount(Coding_Variant));
               setTimer(code_variant,100); 
      break;
      
      case 0x22:
               strncpy(Coding_Variant,"33304B4831",elcount(Coding_Variant));
               setTimer(code_variant,100); 
      break;
      
      case 0x23:
               strncpy(Coding_Variant,"3330415932",elcount(Coding_Variant));
               setTimer(code_variant,100); 
      break;
      case 0x24:
               strncpy(Coding_Variant,"3330424D30",elcount(Coding_Variant));
               setTimer(code_variant,100); 
      break;
      
      break;
      case 0x25:
               phase=0;
               setTimer(waitTimeForResponse,100);
      break;
      default:
       write("Invalid phase!!!");
      break;
  }
}

on envVar Env_MY24_TGVXExecute
{
strncpy(Zeros_Reserve,"0000000000000000000000000000000000000000000000000000000000000000000000000000000000000000000000000000",elcount(Zeros_Reserve));
  seq1=0;
  switch(getvalue(EnvHondaTGVXVariantSelect))
  {
      case 0x0:
               strncpy(Coding_Variant,"5447564130",elcount(Coding_Variant));
               setTimer(code_variant,100); 
      
      break;
      
//      case 0x1:
//               strncpy(Coding_Variant,"5447564131",elcount(Coding_Variant));
//               setTimer(code_variant,100); 
//      break;
    
      
//      case 0x2:
//               strncpy(Coding_Variant,"5447565830",elcount(Coding_Variant));
//               setTimer(code_variant,100); 
//      break;
    
      
      case 0x3:
               strncpy(Coding_Variant,"5447565831",elcount(Coding_Variant));
               setTimer(code_variant,100); 
      break;
      
      case 0x4:
               strncpy(Coding_Variant,"5447565930",elcount(Coding_Variant));
               setTimer(code_variant,100); 
      break;
       case 0x5:
               strncpy(Coding_Variant,"5447565931",elcount(Coding_Variant));
               setTimer(code_variant,100); 
      break;
       case 0x6:
               strncpy(Coding_Variant,"5447594130",elcount(Coding_Variant));
               setTimer(code_variant,100); 
      break;
       case 0x7:
               strncpy(Coding_Variant,"5447594131",elcount(Coding_Variant));
               setTimer(code_variant,100); 
      break;
       case 0x8:
               strncpy(Coding_Variant,"54475A4130",elcount(Coding_Variant));
               setTimer(code_variant,100); 
      break;
        case 0x9:
               strncpy(Coding_Variant,"54475A4330",elcount(Coding_Variant));
               setTimer(code_variant,100); 
      break;
        case 0xA:
               strncpy(Coding_Variant,"54475A5830",elcount(Coding_Variant));
               setTimer(code_variant,100); 
      break;
        case 0xB:
               strncpy(Coding_Variant,"54475A5930",elcount(Coding_Variant));
               setTimer(code_variant,100); 
      break;
     
      case 0xC:
               phase=0;
               setTimer(waitTimeForResponse,100);
      break;
      default:
       write("Invalid phase!!!");
      break;
  }
}

on envVar Env_MY24_TYAWExecute
{
strncpy(Zeros_Reserve,"0000000000000000000000000000000000000000000000000000000000000000000000000000000000000000000000000000",elcount(Zeros_Reserve));
  seq1=0;
  switch(getvalue(EnvHondaTYAWVariantSelect))
  {
      case 0x0:
               strncpy(Coding_Variant,"5459414130",elcount(Coding_Variant));
               setTimer(code_variant,100); 
      
      break;
      
      case 0x1:
               strncpy(Coding_Variant,"5459414131",elcount(Coding_Variant));
               setTimer(code_variant,100); 
      break;
    
      
      case 0x2:
               strncpy(Coding_Variant,"5459414132",elcount(Coding_Variant));
               setTimer(code_variant,100); 
      break;
    
      
//      case 0x3:
//               strncpy(Coding_Variant,"5459415830",elcount(Coding_Variant));
//               setTimer(code_variant,100); 
//      break;
      
      case 0x4:
               strncpy(Coding_Variant,"5459415831",elcount(Coding_Variant));
               setTimer(code_variant,100); 
      break;
       case 0x5:
               strncpy(Coding_Variant,"5459415930",elcount(Coding_Variant));
               setTimer(code_variant,100); 
      break;
       case 0x6:
               strncpy(Coding_Variant,"5459415931",elcount(Coding_Variant));
               setTimer(code_variant,100); 
      break;

      case 0x7:
               phase=0;
               setTimer(waitTimeForResponse,100);
      break;
      default:
       write("Invalid phase!!!");
      break;
  }
}

on envVar Env_MY24_T95BExecute
{
strncpy(Zeros_Reserve,"0000000000000000000000000000000000000000000000000000000000000000000000000000000000000000000000000000",elcount(Zeros_Reserve));
  seq1=0;
  switch(getvalue(EnvHondaT95BVariantSelect))
  {
      case 0x0:
               strncpy(Coding_Variant,"5439354130",elcount(Coding_Variant));
               setTimer(code_variant,100); 
      
      break;
      
      case 0x1:
               strncpy(Coding_Variant,"5439354A30",elcount(Coding_Variant));
               setTimer(code_variant,100); 
      break;      
      
      case 0x2:
               phase=0;
               setTimer(waitTimeForResponse,100);
      break;
      default:
       write("Invalid phase!!!");
      break;
  }
}

on envVar Env_MY24_3BMAExecute
{
strncpy(Zeros_Reserve,"0000000000000000000000000000000000000000000000000000000000000000000000000000000000000000000000000000",elcount(Zeros_Reserve));
  seq1=0;
  switch(getvalue(EnvHonda3BMAVariantSelect))
  {
      case 0x0:
               strncpy(Coding_Variant,"33424D4130",elcount(Coding_Variant));
               setTimer(code_variant,100); 
      
      break;
      
//      case 0x1:
//               strncpy(Coding_Variant,"33424D4B30",elcount(Coding_Variant));
//               setTimer(code_variant,100); 
//      break;      
      
      case 0x1:
               phase=0;
               setTimer(waitTimeForResponse,100);
      break;
      default:
       write("Invalid phase!!!");
      break;
  }
}

on envVar Env_MY25_30AY_31VZExecute
{
strncpy(Zeros_Reserve,"0000000000000000000000000000000000000000000000000000000000000000000000000000000000000000000000000000",elcount(Zeros_Reserve));
  seq1=0;
  switch(getvalue(EnvHonda30AY_31VZVariantSelect))
  {
      case 0x0:
               strncpy(Coding_Variant,"33304B4830",elcount(Coding_Variant));
               setTimer(code_variant,100); 
      
      break;
       case 0x1:
               strncpy(Coding_Variant,"3330484830",elcount(Coding_Variant));
               setTimer(code_variant,100); 
      
      break;
       case 0x2:
               strncpy(Coding_Variant,"3330484831",elcount(Coding_Variant));
               setTimer(code_variant,100); 
      
      break;
       case 0x3:
               strncpy(Coding_Variant,"3331564830",elcount(Coding_Variant));
               setTimer(code_variant,100); 
      
      break;
       case 0x4:
               strncpy(Coding_Variant,"3331564831",elcount(Coding_Variant));
               setTimer(code_variant,100); 
      
      break;
       case 0x5:
               strncpy(Coding_Variant,"3331574831",elcount(Coding_Variant));
               setTimer(code_variant,100); 
      
      break;
       case 0x6:
               strncpy(Coding_Variant,"33304D5430",elcount(Coding_Variant));
               setTimer(code_variant,100); 
      
      break;
       case 0x7:
               strncpy(Coding_Variant,"33304D5431",elcount(Coding_Variant));
               setTimer(code_variant,100); 
      
      break;
       case 0x8:
               strncpy(Coding_Variant,"33304D5432",elcount(Coding_Variant));
               setTimer(code_variant,100); 
      
      break;
       case 0x9:
               strncpy(Coding_Variant,"33304D5530",elcount(Coding_Variant));
               setTimer(code_variant,100); 
      
      break;
       case 0xA:
               strncpy(Coding_Variant,"33304D5130",elcount(Coding_Variant));
               setTimer(code_variant,100); 
      
      break;
      case 0xB:
               phase=0;
               setTimer(waitTimeForResponse,100);
      break;
      default:
       write("Invalid phase!!!");
      break;
  }
}

on envVar Env_MY25_3A0X_3F0XExecute
{
strncpy(Zeros_Reserve,"0000000000000000000000000000000000000000000000000000000000000000000000000000000000000000000000000000",elcount(Zeros_Reserve));
  seq1=0;
  switch(getvalue(EnvHonda3A0X_3F0XVariantSelect))
  {
      case 0x0:
               strncpy(Coding_Variant,"3345374832",elcount(Coding_Variant));
               setTimer(code_variant,100); 
      
      break;
       case 0x1:
               strncpy(Coding_Variant,"3346334830",elcount(Coding_Variant));
               setTimer(code_variant,100); 
      
      break;
       case 0x2:
               strncpy(Coding_Variant,"3345344830",elcount(Coding_Variant));
               setTimer(code_variant,100); 
      
      break;
       case 0x3:
               strncpy(Coding_Variant,"3345354830",elcount(Coding_Variant));
               setTimer(code_variant,100); 
      
      break;
       case 0x4:
               strncpy(Coding_Variant,"3346374831",elcount(Coding_Variant));
               setTimer(code_variant,100); 
      
      break;
       case 0x5:
               strncpy(Coding_Variant,"3346374830",elcount(Coding_Variant));
               setTimer(code_variant,100); 
      
      break;
       case 0x6:
               strncpy(Coding_Variant,"3342384532",elcount(Coding_Variant));
               setTimer(code_variant,100); 
      
      break;
       case 0x7:
               strncpy(Coding_Variant,"3346354831",elcount(Coding_Variant));
               setTimer(code_variant,100); 
      
      break;
       case 0x8:
               strncpy(Coding_Variant,"3346354830",elcount(Coding_Variant));
               setTimer(code_variant,100); 
      
      break;
       case 0x9:
               phase=0;
               setTimer(waitTimeForResponse,100);
      
      break;
      
      default:
       write("Invalid phase!!!");
      break;
  }
}


on envVar Env_MY26_3T0ZExecute
{
strncpy(Zeros_Reserve,"0000000000000000000000000000000000000000000000000000000000000000000000000000000000000000000000000000",elcount(Zeros_Reserve));
  seq1=0;
  switch(getvalue(EnvHonda3T0ZVariantSelect))
  {
      case 0x0:
               ascii2hex("3T0J4", Coding_Variant);
               setTimer(code_variant,100); 
      
      break;
       case 0x1:
               ascii2hex("3T0J5", Coding_Variant);
               setTimer(code_variant,100); 
      
      break;
       case 0x2:
               ascii2hex("3T0J6", Coding_Variant);
               setTimer(code_variant,100); 
      
      break;
       case 0x3:
               ascii2hex("3T1J4", Coding_Variant);
               setTimer(code_variant,100); 
      
      break;
       case 0x4:
               ascii2hex("3T1J5", Coding_Variant);
               setTimer(code_variant,100); 
      
      break;
       case 0x5:
               ascii2hex("3T1J6", Coding_Variant);
               setTimer(code_variant,100); 
      
      break;
       case 0x6:
               ascii2hex("3T2J3", Coding_Variant);
               setTimer(code_variant,100); 
      
      break;
       case 0x7:
               ascii2hex("3T2J6", Coding_Variant);
               setTimer(code_variant,100); 
      
      break;
       case 0x8:
               ascii2hex("3T2J4", Coding_Variant);
               setTimer(code_variant,100); 
      
      break;
      case 0x9:
               ascii2hex("3T2J5", Coding_Variant);
               setTimer(code_variant,100); 
      
      break;
      case 0xA:
               ascii2hex("3T2J7", Coding_Variant);
               setTimer(code_variant,100); 
      
      break;
      case 0xB:
               ascii2hex("3T0U5", Coding_Variant);
               setTimer(code_variant,100); 
      
      break;
      case 0xC:
               ascii2hex("3T2U2", Coding_Variant);
               setTimer(code_variant,100); 
      
      break;
      case 0xD:
               ascii2hex("3T2U3", Coding_Variant);
               setTimer(code_variant,100); 
      
      break;
      case 0xE:
               ascii2hex("3T2T0", Coding_Variant);
               setTimer(code_variant,100); 
      
      break;
       case 0xF:
               phase=0;
               setTimer(waitTimeForResponse,100);
      
      break;
      
      default:
       write("Invalid phase!!!");
      break;
  }
}

on envVar Env_MY26_T90XExecute
{
strncpy(Zeros_Reserve,"0000000000000000000000000000000000000000000000000000000000000000000000000000000000000000000000000000",elcount(Zeros_Reserve));
  seq1=0;
  switch(getvalue(EnvHondaT90XVariantSelect))
  {
      case 0x0:
               ascii2hex("T90A6", Coding_Variant);
               setTimer(code_variant,100); 
      break;
       case 0x1:
               ascii2hex("T90A7", Coding_Variant);
               setTimer(code_variant,100); 
      
      break;
       case 0x2:
               ascii2hex("T90A8", Coding_Variant);
               setTimer(code_variant,100); 
      break;
       case 0x3:
               ascii2hex("T90A9", Coding_Variant);
               setTimer(code_variant,100); 
      
      break;
       case 0x4:
               ascii2hex("T90C1", Coding_Variant);
               setTimer(code_variant,100); 
      break;
       case 0x5:
               ascii2hex("T90C2", Coding_Variant);
               setTimer(code_variant,100); 
      break;
       case 0x6:
               ascii2hex("T90C3", Coding_Variant);
               setTimer(code_variant,100); 
      break;
       case 0x7:
               ascii2hex("T90C4", Coding_Variant);
               setTimer(code_variant,100); 
      
      break;
       case 0x8:
               ascii2hex("T90K2", Coding_Variant);
               setTimer(code_variant,100); 
      break;
      case 0x9:
               ascii2hex("T90K3", Coding_Variant);
               setTimer(code_variant,100); 
      break;
      case 0xA:
               ascii2hex("T90Y3", Coding_Variant);
               setTimer(code_variant,100); 
      break;
      case 0xB:
               ascii2hex("T90Y4", Coding_Variant);
               setTimer(code_variant,100); 
      
      break;
      case 0xC:
               ascii2hex("T90Y5", Coding_Variant);
               setTimer(code_variant,100);
      break;
      case 0xD:
               ascii2hex("T90D1", Coding_Variant);
               setTimer(code_variant,100); 
      break;
      case 0xE:
               ascii2hex("T91A4", Coding_Variant);
               setTimer(code_variant,100); 
      
      break;
      case 0xF:
               ascii2hex("T91A5", Coding_Variant);
               setTimer(code_variant,100); 
      break;
      case 0x10:
               ascii2hex("T91X1", Coding_Variant);
               setTimer(code_variant,100); 
      break;
      case 0x11:
               ascii2hex("T91K1", Coding_Variant);
               setTimer(code_variant,100); 
      break;
      case 0x12:
               ascii2hex("T91Y1", Coding_Variant);
               setTimer(code_variant,100); 
      
      break;
      case 0x13:
               phase=0;
               setTimer(waitTimeForResponse,100);
      
      break;
      
      default:
       write("Invalid phase!!!");
      break;
  }
}


on envVar Env_MY26_3A0WExecute
{
strncpy(Zeros_Reserve,"0000000000000000000000000000000000000000000000000000000000000000000000000000000000000000000000000000",elcount(Zeros_Reserve));
  seq1=0;
  switch(getvalue(EnvHonda3A0WVariantSelect))
  {
      case 0x0:
               ascii2hex("3A0A4", Coding_Variant);
               setTimer(code_variant,100); 
      break;
       case 0x1:
               ascii2hex("3A1A4", Coding_Variant);
               setTimer(code_variant,100); 
      
      break;
       case 0x2:
               ascii2hex("3D4A7", Coding_Variant);
               setTimer(code_variant,100); 
      break;
       case 0x3:
               ascii2hex("3D5A8", Coding_Variant);
               setTimer(code_variant,100); 
      
      break;
       case 0x4:
               ascii2hex("3A0C0", Coding_Variant);
               setTimer(code_variant,100); 
      break;
       case 0x5:
               ascii2hex("3A1C0", Coding_Variant);
               setTimer(code_variant,100); 
      break;
       case 0x6:
               ascii2hex("3D4C0", Coding_Variant);
               setTimer(code_variant,100); 
      break;
       case 0x7:
               ascii2hex("3A3X0", Coding_Variant);
               setTimer(code_variant,100); 
      
      break;
       case 0x8:
               ascii2hex("3D8X0", Coding_Variant);
               setTimer(code_variant,100); 
      break;
      case 0x9:
               ascii2hex("3D9X0", Coding_Variant);
               setTimer(code_variant,100); 
      break;
      case 0xA:
               ascii2hex("3D8D0", Coding_Variant);
               setTimer(code_variant,100); 
      break;
      case 0xB:
               ascii2hex("3D9D0", Coding_Variant);
               setTimer(code_variant,100); 
      
      break;
      case 0xC:
               ascii2hex("3A2K0", Coding_Variant);
               setTimer(code_variant,100);
      break;
      case 0xD:
               ascii2hex("3A3K0", Coding_Variant);
               setTimer(code_variant,100); 
      break;
      case 0xE:
               ascii2hex("3E4H2", Coding_Variant);
               setTimer(code_variant,100); 
      
      break;
      case 0xF:
               ascii2hex("3E5H2", Coding_Variant);
               setTimer(code_variant,100); 
      break;
      case 0x10:
               ascii2hex("3E8H0", Coding_Variant);
               setTimer(code_variant,100); 
      break;
      case 0x11:
               ascii2hex("3E9H0", Coding_Variant);
               setTimer(code_variant,100); 
      break;
      case 0x12:
               ascii2hex("3E7H4", Coding_Variant);
               setTimer(code_variant,100); 
      
      break;
      case 0x13:
               ascii2hex("3F1H0", Coding_Variant);
               setTimer(code_variant,100); 
      
      break;
      case 0x14:
               ascii2hex("3F4H0", Coding_Variant);
               setTimer(code_variant,100); 
      
      break;
      case 0x15:
               ascii2hex("3F5H2", Coding_Variant);
               setTimer(code_variant,100); 
      
      break;
      case 0x16:
               ascii2hex("3F3H1", Coding_Variant);
               setTimer(code_variant,100); 
      
      break;
      case 0x17:
               ascii2hex("3C2J0", Coding_Variant);
               setTimer(code_variant,100); 
      
      break;
      case 0x18:
               ascii2hex("3C3J0", Coding_Variant);
               setTimer(code_variant,100); 
      
      break;
      case 0x19:
               ascii2hex("3C0Q3", Coding_Variant);
               setTimer(code_variant,100); 
      
      break;
      case 0x1A:
               ascii2hex("3C1Q2", Coding_Variant);
               setTimer(code_variant,100); 
      
      break;
      case 0x1B:
               ascii2hex("3C3Q2", Coding_Variant);
               setTimer(code_variant,100); 
      
      break;
      case 0x1C:
               ascii2hex("3C3Q3", Coding_Variant);
               setTimer(code_variant,100); 
      
      break;
      case 0x1D:
               ascii2hex("3C2Q0", Coding_Variant);
               setTimer(code_variant,100); 
      
      break;
      case 0x1E:
               ascii2hex("3C2Q1", Coding_Variant);
               setTimer(code_variant,100); 
      
      break;
      case 0x1F:
               ascii2hex("3C0U0", Coding_Variant);
               setTimer(code_variant,100); 
      
      break;
      case 0x20:
               ascii2hex("3C4M0", Coding_Variant);
               setTimer(code_variant,100); 
      
      break;
      case 0x21:
               ascii2hex("3C4M1", Coding_Variant);
               setTimer(code_variant,100); 
      
      break;
      case 0x22:
               ascii2hex("3C1U0", Coding_Variant);
               setTimer(code_variant,100); 
      
      break;
      case 0x23:
               ascii2hex("3C5M0", Coding_Variant);
               setTimer(code_variant,100); 
      
      break;
      case 0x24:
               ascii2hex("3C1U1", Coding_Variant);
               setTimer(code_variant,100); 
      
      break;
      case 0x25:
               ascii2hex("3C2Z0", Coding_Variant);
               setTimer(code_variant,100); 
      
      break;
      case 0x26:
               ascii2hex("3C3Z0", Coding_Variant);
               setTimer(code_variant,100); 
      
      break;
      case 0x27:
               ascii2hex("3C7M1", Coding_Variant);
               setTimer(code_variant,100); 
      
      break;
      case 0x28:
               ascii2hex("3C3Z1", Coding_Variant);
               setTimer(code_variant,100); 
      
      break;
      case 0x29:
               ascii2hex("3C7M0", Coding_Variant);
               setTimer(code_variant,100); 
      
      break;
      case 0x2A:
               ascii2hex("3C0Y0", Coding_Variant);
               setTimer(code_variant,100); 
      
      break;
      case 0x2B:
               ascii2hex("3C0Y1", Coding_Variant);
               setTimer(code_variant,100); 
      
      break;
      case 0x2C:
               ascii2hex("3C5P3", Coding_Variant);
               setTimer(code_variant,100); 
      
      break;
      case 0x2D:
               ascii2hex("3C5F0", Coding_Variant);
               setTimer(code_variant,100); 
      
      break;
      case 0x2E:
               ascii2hex("3C1Y0", Coding_Variant);
               setTimer(code_variant,100); 
      
      break;
      case 0x2F:
               ascii2hex("3C2P2", Coding_Variant);
               setTimer(code_variant,100); 
      
      break;
      case 0x30:
               ascii2hex("3C3Y0", Coding_Variant);
               setTimer(code_variant,100); 
      
      break;
      case 0x31:
               ascii2hex("3C3P2", Coding_Variant);
               setTimer(code_variant,100); 
      
      break;
      case 0x32:
               ascii2hex("3C7F0", Coding_Variant);
               setTimer(code_variant,100); 
      
      break;
      case 0x33:
               ascii2hex("3C7F1", Coding_Variant);
               setTimer(code_variant,100); 
      
      break;
      case 0x34:
               ascii2hex("3C2K0", Coding_Variant);
               setTimer(code_variant,100); 
      
      break;
      case 0x35:
               phase=0;
               setTimer(waitTimeForResponse,100);
      
      break;
      
      
      default:
       write("Invalid phase!!!");
      break;
  }
}

on envVar Env_MY28_30AWExecute
{
strncpy(Zeros_Reserve,"0000000000000000000000000000000000000000000000000000000000000000000000000000000000000000000000000000",elcount(Zeros_Reserve));
  seq1=0;
  switch(getvalue(EnvHondaMY28_30AWVariantSelect))
  {
      case 0x0:
               phase=0;
               setTimer(waitTimeForResponse,100);
      break;
      case 0x1:
               ascii2hex("30EH0", Coding_Variant);
               setTimer(code_variant,100); 
      break;
      case 0x2:
               ascii2hex("30EH1", Coding_Variant);
               setTimer(code_variant,100); 
      break;
      case 0x3:
               ascii2hex("30FH0", Coding_Variant);
               setTimer(code_variant,100); 
      break;
      case 0x4:
               ascii2hex("30FH1", Coding_Variant);
               setTimer(code_variant,100); 
      break;
      case 0x5:
               ascii2hex("30EH2", Coding_Variant);
               setTimer(code_variant,100); 
      break;
      case 0x6:
               ascii2hex("30EH3", Coding_Variant);
               setTimer(code_variant,100); 
      break;
      case 0x7:
               ascii2hex("30FH2", Coding_Variant);
               setTimer(code_variant,100); 
      break;
      case 0x8:
               ascii2hex("30FH3", Coding_Variant);
               setTimer(code_variant,100); 
      break;
      case 0x9:
               ascii2hex("31VB0", Coding_Variant);
               setTimer(code_variant,100); 
      break;
      case 0xA:
               ascii2hex("31VB1", Coding_Variant);
               setTimer(code_variant,100); 
      break;
      case 0xB:
               ascii2hex("30XH0", Coding_Variant);
               setTimer(code_variant,100); 
      break;
      case 0xC:
               ascii2hex("30XH1", Coding_Variant);
               setTimer(code_variant,100);
      break;
      case 0xD:
               ascii2hex("31VB2", Coding_Variant);
               setTimer(code_variant,100); 
      break;
      case 0xE:
               ascii2hex("31VB3", Coding_Variant);
               setTimer(code_variant,100); 
      break;
      case 0xF:
               ascii2hex("30XH2", Coding_Variant);
               setTimer(code_variant,100); 
      break;
      case 0x10:
               ascii2hex("30XH3", Coding_Variant);
               setTimer(code_variant,100); 
      break;
      case 0x11:
               ascii2hex("3DSA0", Coding_Variant);
               setTimer(code_variant,100); 
      break;
      case 0x12:
               ascii2hex("3DTA0", Coding_Variant);
               setTimer(code_variant,100); 
      break;
      case 0x13:
               ascii2hex("3DTA1", Coding_Variant);
               setTimer(code_variant,100); 
      break;
      case 0x14:
               ascii2hex("3DTA2", Coding_Variant);
               setTimer(code_variant,100); 
      break;
      case 0x15:
               ascii2hex("3DTC0", Coding_Variant);
               setTimer(code_variant,100); 
      break;
      case 0x16:
               ascii2hex("3DTC1", Coding_Variant);
               setTimer(code_variant,100); 
      break;
      case 0x17:
               ascii2hex("3DTP0", Coding_Variant);
               setTimer(code_variant,100); 
      break;
      case 0x18:
               ascii2hex("3DTP1", Coding_Variant);
               setTimer(code_variant,100); 
      break;
      case 0x19:
               ascii2hex("3DTP2", Coding_Variant);
               setTimer(code_variant,100); 
      break;
      case 0x1A:
               ascii2hex("3DSP2", Coding_Variant);
               setTimer(code_variant,100); 
      break;
      case 0x1B:
               ascii2hex("3DSP3", Coding_Variant);
               setTimer(code_variant,100); 
      break;
      case 0x1C:
               ascii2hex("3DTP3", Coding_Variant);
               setTimer(code_variant,100); 
      break;
      case 0x1D:
               ascii2hex("3DTP4", Coding_Variant);
               setTimer(code_variant,100); 
      break;
      case 0x1E:
               ascii2hex("30MT3", Coding_Variant);
               setTimer(code_variant,100); 
      break;
      case 0x1F:
               ascii2hex("30MT4", Coding_Variant);
               setTimer(code_variant,100); 
      break;
      case 0x20:
               ascii2hex("30MT5", Coding_Variant);
               setTimer(code_variant,100); 
      break;
      case 0x21:
               ascii2hex("30MT6", Coding_Variant);
               setTimer(code_variant,100); 
      break;

      case 0x22:
               ascii2hex("30MT7", Coding_Variant);
               setTimer(code_variant,100); 
      break;

      case 0x23:
               ascii2hex("30MT8", Coding_Variant);
               setTimer(code_variant,100); 
      break;

      case 0x24:
               ascii2hex("TSTH0", Coding_Variant);
               setTimer(code_variant,100); 
      break;

      case 0x25:
               ascii2hex("TSTH1", Coding_Variant);
               setTimer(code_variant,100); 
      break;
      
      default:
              write("Invalid phase!!!");
      break;
  }
}

void ascii2hex(char str[], char hexstr[])
{
  dword val;
  int i; 
  
  snprintf(hexstr, elcount(hexstr), "%.2X", str[0]);
  for(i = 1; i < strlen(str); i++)
  {
    snprintf(hexstr, elcount(hexstr), "%s%.2X", hexstr, str[i]);
  }
}

on envVar EnvSendBuffer_1     
{
     if ( getValue (this) )
   {
      DirectTxDataLen = getValue( EnvTxData_1, TxDataBuffer );
    write("DirectTxDataLen = %d",DirectTxDataLen);
      StartDiagService( DIRECT_RQ );
   }
}

///For GEN3 security = below functions are used for sec unlock

void ParseSecurityXML(char nameOfFile[])
{
  
  dword fileHandle;
  char buffer[10000];
  char FileBuffer[150000];
  int filePos;
  int key_type = 0;
  int staticPosStart;
  int staticPosEnd;
  char staticBuffer[50000];
  int seedPosStart;
  int seedPosEnd;
  int staticPos=0;
  int i;
  fileHandle=0;
  strncpy(buffer,"", 10000);
  strncpy(FileBuffer,"", 150000);
  filePos=0;
  key_type = 0;
  staticPosStart=0;
  staticPosEnd=0;
  strncpy(staticBuffer,"", 50000);
  seedPosStart=0;
  seedPosEnd=0;
  staticPos=0;
  i=0;
  write("In PARSE IM");
  write("nameOfFile ---> %s",nameOfFile);
  fileHandle =  openFileRead (nameOfFile,0);
  write("fileHandle=%d",fileHandle);
  while (fileGetStringSZ(buffer,elcount(buffer),fileHandle)!=0)
  {
     //write("In PARSE IM 1");
    
    strncat(FileBuffer, buffer, elcount(FileBuffer));
   // write("FileBuffer=%s",FileBuffer);
  }
  fileClose (fileHandle);
  if(strstr(FileBuffer,"0x61\" key_type=\"static")!=-1)
  {  write("In PARSE IM 2");
    filePos = strstr(FileBuffer,"dia_sub_function=\"0x61\" encrypted=\"no\"");
    if(filePos!=-1)
    {//write("In PARSE IM 3");
      staticPosStart = strstr_off(FileBuffer,filePos,"<SEEDS>")+7;
      staticPosEnd = strstr_off(FileBuffer,filePos,"</KEYS>");
      substr_cpy(staticBuffer, FileBuffer, staticPosStart,staticPosEnd-staticPosStart,elcount(staticBuffer));
	    i=0;
      while(1)
      { //write("In PARSE IM 4 SEED");
        seedPosStart = strstr_off(staticBuffer,staticPos,"<SEED>")+6;
        if(seedPosStart==-1)
        {
          break;
        }
        seedPosEnd = strstr_off(staticBuffer,staticPos+7,"</SEED>");
        if(seedPosEnd==-1)
        {
          break;
        }
        substr_cpy(seedList[i], staticBuffer, seedPosStart+2,seedPosEnd-seedPosStart-2,elcount(seedList));
        i++;
        staticPos = seedPosEnd;
		//  write("seedList[i]len = %d ",elcount(seedList[i]));
      }
      i=0;
	  staticPos = 0;
      while(1)
      { //write("In PARSE IM 5 KEY");
        seedPosStart = strstr_off(staticBuffer,staticPos,"<KEY>")+5;
        if(seedPosStart==-1)
        {
          break;
        }
        seedPosEnd = strstr_off(staticBuffer,staticPos+7,"</KEY>");
        if(seedPosEnd==-1)
        {
          break;
        }
        substr_cpy(keyList[i], staticBuffer, seedPosStart+2,seedPosEnd-seedPosStart-2,elcount(keyList));
        i++;
        staticPos = seedPosEnd;
	//	write("keyList[i] = %x",keyList[i]);
     //   write("keyList[i]len = %d ",elcount(keyList[i]));
      }
    }
    
    securityType = SEEDNKEYFBLREQUEST;
    write("In parse xml_0x61\" key_type=\"static= securityType=%x",securityType);
    write("In parse xml_0x61\" key_type=\"static= SEEDNKEYFBLREQUEST=%x",SEEDNKEYFBLREQUEST);
  }
  else if(strstr(FileBuffer,"0x61\" key_type=\"dynamic")!=-1)
  {
    securityType = SEEDNKEYFBLDYNAMICREQUEST;
    write("In parse xml_0x61\" key_type=\"Dynamic= securityType=%x",securityType);
  }
  else if(strstr(FileBuffer,"0x61\" key_type=\"conventional")!=-1)
  {
    securityType = SEEDNKEYREQUEST;
    write("In parse xml_0x61\" key_type=\"conventional= securityType=%x",securityType);
  }
  else
  {
    write("The Security XML is not as per standards. Conventional mode is active");
  }
  
  //****** For HONDA Security Unlock *******
  if(strstr(FileBuffer,"0x01\" key_type=\"static")!=-1)
  {
    filePos = strstr(FileBuffer,"dia_sub_function=\"0x01\" encrypted=\"no\"");
    if(filePos!=-1)
    {
      staticPosStart = strstr_off(FileBuffer,filePos,"<SEEDS>")+7;
      staticPosEnd = strstr_off(FileBuffer,filePos,"</KEYS>");
      substr_cpy(staticBuffer, FileBuffer, staticPosStart,staticPosEnd-staticPosStart,elcount(staticBuffer));
	    i=0;
      staticPos = 0;
      while(1)
      {
        seedPosStart = strstr_off(staticBuffer,staticPos,"<SEED>")+6;
        if(seedPosStart==-1)
        {
          break;
        }
        seedPosEnd = strstr_off(staticBuffer,staticPos+7,"</SEED>");
        if(seedPosEnd==-1)
        {
          break;
        }
        substr_cpy(seedListHONDA[i], staticBuffer, seedPosStart+2,seedPosEnd-seedPosStart-2,elcount(seedListHONDA));
        i++;
        staticPos = seedPosEnd;
		
      }
      i=0;
	  staticPos = 0;
      while(1)
      {
        seedPosStart = strstr_off(staticBuffer,staticPos,"<KEY>")+5;
        if(seedPosStart==-1)
        {
          break;
        }
        seedPosEnd = strstr_off(staticBuffer,staticPos+7,"</KEY>");
        if(seedPosEnd==-1)
        {
          break;
        }
        substr_cpy(keyListHONDA[i], staticBuffer, seedPosStart+2,seedPosEnd-seedPosStart-2,elcount(keyListHONDA));
        i++;
        staticPos = seedPosEnd;
		
      }
    }
    
    securityTypeHONDA = SEEDNKEYHONDAEOLREQUEST;
    
  }
  else if(strstr(FileBuffer,"0x\01\" key_type=\"dynamic")!=-1)
  {
    securityTypeHONDA = SEEDNKEYHONDADYNAMICREQUEST;
  }
  else if(strstr(FileBuffer,"0x01\" key_type=\"conventional")!=-1)
  {
    securityTypeHONDA = SEEDNKEYHONDAREQUEST;
  }
  else
  {
    write("The Security XML is not as per standards. Conventional mode is active");
  }
  
  Write("securityType == %d and securityTypeHONDA == %d ",securityType,securityTypeHONDA);
  
  
}

MyEvaluateResponse ()
{
	int i;
	int RespLength;

	char buffer[200000];
	char buffer2[200000]="0";

 
	strncpy(buffer2, "0", 6);
	strncpy(MVbuffer2, "",6);
	strncpy(MVbuffer, "",6);

	
		RespLength = ReceiveBufferLength;


	for(i=0; i < ReceiveBufferLength; i++)
	{
		ltoa(ReceiveBuffer[i], MVbuffer2, 16);
		if( strlen( MVbuffer2 ) == 1 )
			{
				strncat(buffer2, MVbuffer2, 200000);
				strncat(MVbuffer, buffer2, 200000);
				strncpy(buffer2, "0", 6);
			}
		else
			{
				strncat(MVbuffer, MVbuffer2, 200000);
			}
	}
  write("MVBuffer in evealution:%s",MVbuffer);
	putValue(EnvDirectReceive,  MVbuffer);
}

void DynamicKeySend()
{
  if(DynamicFlag == 1 ||DynamicFlag == 2)
  {
    cancelTimer(sectimer1);
    cancelTimer(sectimer2);
    putValue(Env_SecurityMode_Output,"Dynamic Security Mode Active");
    dynamicKeyLen = getValue(Env_Security_DynamicInput,DynamicKey);
    sendKey[0]=0x27;
    if(DynamicFlag == 1)
    {
      sendKey[1]=SeednKeyFBLRequest[1]+1;
    }
    else if(DynamicFlag == 2)
    {
      sendKey[1]=SeednKeyHONDAEOLRequest[1]+1;
    }
    k=2;  
    
    strncpy(temp1, "0x",3);
    
    for(j=0;j<dynamicKeyLen;j+=2)
    {
      temp1[2]=DynamicKey[j];
      temp1[3]=DynamicKey[j+1];
      temp1[4]=0;
      sendKey[k]=atol(temp1);
      k++;
     // write("%d",k);
    }
    
    gTxlength = (dynamicKeyLen/2)+2;
    StartDiagService( SEEDNKEYHONDARESP);
    
    
    DynamicFlag = 0;
    putValue(Env_Security_DynamicInput," ");
  }
  
}
void EvaluateRxData( int Length )
{
   int      DtcNr;  
   int      i, j;
   dword    auxRT;
   float    convert_rad_grad = 57.295779513082320876798154814105;
 //  Byte     Seed[4];
   char     Seed[4095];
  char DefaultSeed[600][600] = {0};
   dword    resultarray_32[6]={0,0,0,0,0,0};
   byte     puffer[10]={0,0,0,0,0,0,0,0,0,0};

   dword    REP_RBA_CBB_AKEY_VALUE  = 0x41916668;
   dword    REP_RBA_CBB_BKEY_VALUE = 0x12774118;
   dword    REP_RBA_CBB_CKEY_VALUE = 0x86905668;
   dword    REP_RBA_CBB_DKEY_VALUE = 0x10371229;


   dword    WERK_RBA_CBB_AKEY_VALUE  = 0x52917768;  //Minicode 2703/2704
   dword    WERK_RBA_CBB_BKEY_VALUE = 0x12774118;   // Porsche
   dword    WERK_RBA_CBB_CKEY_VALUE = 0x86905668;  // Porsche
   dword    WERK_RBA_CBB_DKEY_VALUE = 0x21482338;  // Porsche

   dword    DEV_RBA_CBB_AKEY_VALUE  = 0x46947376; //Minicode 2721/2722
   dword    DEV_RBA_CBB_BKEY_VALUE = 0x12774118;  // Porsche
   dword    DEV_RBA_CBB_CKEY_VALUE = 0x86905668;  // Porsche
   dword    DEV_RBA_CBB_DKEY_VALUE = 0x45982573;   // Porsche

   dword    RBEOLPin = 0x42444441; //It has been derived from the ASCII values of 'Bosch Diagnostics for Driver Assistance'
   dword    PMARequest = 0x80FA1108; //Plant mode activation part request



    dword    keytemp;
    char    buffer[50],tempbuffer[50];
    Byte    ByteValue[1];
    int     IdentifierId;
    int     IdentifierValue;
 ///////////////////////////////////////////////////////
  // For Gen 3 Sec Unlock:
  
  dword m,k;

  byte securityRespBuffer[1100];
   char pufferStr[2200];
  char temp[5];
  char IMBuffer[4];
  int responseLen;

 
  byte First_MID[200000];  
  byte Last_MID[200000];
  char	MVbuffer[400000] = "";
  char	MVbuffer2[200000] = "";
  char  buffer2[200000]="0"; 
  char	MVbuffer5[200000] = "";
  char	MVbuffer6[200000] = "";
  char  buffer5[200000]="0";
  dword bufferSize;
  int RBflag1 =0;
  int RBflag2 = 0;

  strncpy(buffer2, "0", 4);
	strncpy(MVbuffer2, "",4);
	strncpy(MVbuffer, "",4);
  strncpy(buffer5, "0", 4);
	strncpy(MVbuffer6, "",4);
	strncpy(MVbuffer5, "",4);
   bufferSize = gRxSize;
  
EvaluateResponse( );  


   switch ( CurrentDiagServ )  
   {
      

      case READ_DTC_PASS: 
         if ( RxDataBuffer[0] == 0x59 )
         {
            RxBufferIndex  = 3;
            NrOfReadDTC    = (Length - 3)/4;  
            DtcNr        = 1; 
            
            putValue (EnvDtcInEmPresent , 0);
            for (i = 0; i < NrOfReadDTC; i++)
            {
                  errorDTC[DtcNr]      = (dword)RxDataBuffer[RxBufferIndex++] << 16;
                  errorDTC[DtcNr]      += (dword)RxDataBuffer[RxBufferIndex++] << 8;
                  errorDTC[DtcNr]      += (dword)RxDataBuffer[RxBufferIndex++]; 
 
                // Bescos new Function Look for a particular DTC in EM, Flag for found : EnvDtcInEmPresent
  
                snprintf (buffer, 49, "%06x", errorDTC[DtcNr]);
                getValue(EnvDtcLookForInEm,tempbuffer);
                if  ( strncmp(buffer,tempbuffer,strlen(tempbuffer))== 0)  //equal
                {
                    putValue (EnvDtcInEmPresent , 1);
                }

            // 	write(" buffer %s: tembuffer  %s ",  buffer,tempbuffer );
               errorStatus[DtcNr++] = RxDataBuffer[RxBufferIndex++];
			   
            }
            if ( (NrOfReadDTC == 0) )
            {
                   putValue (EnvReqStatus_CAN, "No DTCs");
            }else{
                   putValue (EnvReqStatus_CAN, "All DTCs received");
            }

               CurrentDTC = 1;
               ShowDTCs();
               
            
            }
    break; 




	case READ_HIST_DTC:  
         if ( RxDataBuffer[0] == 0x71 )
         {
            RxBufferIndex  = 2;
            NrOfHistDTC        = RxDataBuffer[RxBufferIndex++];
            NrOfReadHistDTC    = (Length - 3)/3;
            DtcNr        = 1; 
         
            for (i = 0; i < NrOfReadHistDTC; i++)
            {
               errorHistDTC[DtcNr]      = (dword)RxDataBuffer[RxBufferIndex++] << 8;
               errorHistDTC[DtcNr]      += (dword)RxDataBuffer[RxBufferIndex++];
               errorHistStatus[DtcNr++] = RxDataBuffer[RxBufferIndex++];
	            }
         
         	EvaluateResponse();

            if ( (NrOfReadHistDTC == NrOfHistDTC) && (NrOfHistDTC) )
            {
               
                    putValue (EnvReqStatus_CAN, "All Historical DTCs received");
               
               CurrentHistDTC = 1;
            // ShowHistDTCs();
            }
            else if ( NrOfReadHistDTC != NrOfHistDTC )
            { 
                
                    putValue (EnvReqStatus_CAN, "Nr. of Hist DTCs != Data");
               CurrentHistDTC = 1;
            // ShowHistDTCs();
            }

            if ( (NrOfHistDTC == 0) && (NrOfReadHistDTC == NrOfHistDTC) )
            {
               
                    putValue (EnvReqStatus_CAN, "No Historical DTCs");
            }

         }
        
      break; 
      
            
        case MINICODEREQUEST: 
            //Calculate  key after receiving seed
           
            getvalue(EnvRxData_CAN,puffer);
            resultarray[0] = 0x27 ;
           
            for (i = 2; i <6 ; i++)
            {
            	resultarray_32[i]=puffer [i];
            }

			seedReprogValue = resultarray_32[5] |
							  (resultarray_32[4] << 8) |
							  (resultarray_32[3] << 16) |
							  (resultarray_32[2] << 24);

		

         	write(" seed Value %lx: ",  seedReprogValue);    
    
            switch ( whichlogin )    
            {
                case 5:         // plant
                     resultarray[1] = 0x04 ;
                    CalculateKey (seedReprogValue,WERK_RBA_CBB_AKEY_VALUE,WERK_RBA_CBB_BKEY_VALUE,WERK_RBA_CBB_CKEY_VALUE,WERK_RBA_CBB_DKEY_VALUE);

                break;

                case 6 :         //dev
                  resultarray[1] = 0x22 ;
                    CalculateKey (seedReprogValue,DEV_RBA_CBB_AKEY_VALUE,DEV_RBA_CBB_BKEY_VALUE,DEV_RBA_CBB_CKEY_VALUE,DEV_RBA_CBB_DKEY_VALUE);

                 break;
            }
           
  
        	resultarray[5] = (byte)(keyReprogValue & 0xff);
			resultarray[4] = (byte)((keyReprogValue >> 8) & 0xff);
			resultarray[3] = (byte)((keyReprogValue >> 16) & 0xff);
			resultarray[2] = (byte)((keyReprogValue >> 24) & 0xff);
            
            StartDiagService( SEEDNKEYRESP);
        
      break;

      case SEEDNKEYREPROGREQUEST:
      
          
            getvalue(EnvRxData_CAN,puffer);
           
          // New Calculation of Reprog Key in BL for Release X060 onwards:
            
            resultarray[0] = 0x27 ;
            resultarray[1] = 0x12 ;

            for (i = 2; i <6 ; i++)
            {
            	resultarray_32[i]=puffer [i];
            }

			seedReprogValue = resultarray_32[5] |
							  (resultarray_32[4] << 8) |
							  (resultarray_32[3] << 16) |
							  (resultarray_32[2] << 24);

			keyReprogValue = seedReprogValue;

        
    
       		for(j = 0; j <7 ; j++)
        	{

            	keytemp = keyReprogValue ;
            	keyReprogValue = keyReprogValue + REP_RBA_CBB_AKEY_VALUE;
	       		// write(" keytemp and keyReprogValue  for j value %i beginning loop: %lx, %lx ",j, keytemp, keyReprogValue );    
    
    			if((keyMaxReprogValue - REP_RBA_CBB_AKEY_VALUE) < keytemp)
    			{
    	  		/* Rotate Right by 10 */
 	       			keyLowReprogValue = keyReprogValue & (0x000003FF);
 	    			keyUpperReprogValue = keyLowReprogValue << 22;
 	    			keyReprogValue = keyReprogValue >> 10;
 	    			keyReprogValue = keyReprogValue | keyUpperReprogValue;
       				keyReprogValue = keyReprogValue ^ REP_RBA_CBB_BKEY_VALUE;
    			}
    			else
    			{
 	    		/* Rotate Left by 13 */
 	    		    keyUpperReprogValue = keyReprogValue & (0xFFF80000);
 			        keyLowReprogValue   = keyUpperReprogValue >> 19;
 			    	keyReprogValue      = keyReprogValue << 13;
		 	    	keyReprogValue      = keyReprogValue | keyLowReprogValue;
		       		keyReprogValue      = keyReprogValue ^ REP_RBA_CBB_CKEY_VALUE;
		    	}
      		}
 
        	keyReprogValue = keyReprogValue - REP_RBA_CBB_DKEY_VALUE;

		  /* Key Algo end */
			    //write(" final  keyReprogValue %lx",keyReprogValue );    
  
        	resultarray[5] = (byte)(keyReprogValue & 0xff);
			resultarray[4] = (byte)((keyReprogValue >> 8) & 0xff);
			resultarray[3] = (byte)((keyReprogValue >> 16) & 0xff);
			resultarray[2] = (byte)((keyReprogValue >> 24) & 0xff);

           StartDiagService (SEEDNKEYRESP);
         
      break;

      case SEEDNKEYREPROGREQUESTWRITEKEY:
      
          
            getvalue(EnvRxData_CAN,puffer);
           
          // New Calculation of Reprog Key in BL for Release X060 onwards:
            
            resultarray[0] = 0x27 ;
            resultarray[1] = 0x12 ;

            for (i = 2; i <6 ; i++)
            {
            	resultarray_32[i]=puffer [i];
            }

			seedReprogValue = resultarray_32[5] |
							  (resultarray_32[4] << 8) |
							  (resultarray_32[3] << 16) |
							  (resultarray_32[2] << 24);

			keyReprogValue = seedReprogValue;

        
    
       		for(j = 0; j <7 ; j++)
        	{

            	keytemp = keyReprogValue ;
            	keyReprogValue = keyReprogValue + REP_RBA_CBB_AKEY_VALUE;
	       		// write(" keytemp and keyReprogValue  for j value %i beginning loop: %lx, %lx ",j, keytemp, keyReprogValue );    
    
    			if((keyMaxReprogValue - REP_RBA_CBB_AKEY_VALUE) < keytemp)
    			{
    	  		/* Rotate Right by 10 */
 	       			keyLowReprogValue = keyReprogValue & (0x000003FF);
 	    			keyUpperReprogValue = keyLowReprogValue << 22;
 	    			keyReprogValue = keyReprogValue >> 10;
 	    			keyReprogValue = keyReprogValue | keyUpperReprogValue;
       				keyReprogValue = keyReprogValue ^ REP_RBA_CBB_BKEY_VALUE;
    			}
    			else
    			{
 	    		/* Rotate Left by 13 */
 	    		    keyUpperReprogValue = keyReprogValue & (0xFFF80000);
 			        keyLowReprogValue   = keyUpperReprogValue >> 19;
 			    	keyReprogValue      = keyReprogValue << 13;
		 	    	keyReprogValue      = keyReprogValue | keyLowReprogValue;
		       		keyReprogValue      = keyReprogValue ^ REP_RBA_CBB_CKEY_VALUE;
		    	}
      		}
 
        	keyReprogValue = keyReprogValue - REP_RBA_CBB_DKEY_VALUE;

		  /* Key Algo end */
			    write(" final  keyReprogValue %lx",keyReprogValue );
                putValue( EnvWriteLoginKey, keyReprogValue );    
           
      break;

     case SEEDNKEYRBOLREQUESTWRITEKEY:
      
          
            getvalue(EnvRxData_CAN,pufferEOL);
      
            resultarray[0] = 0x27 ;
            resultarray[1] = 0x62 ;
            
            for (i = 2; i <6 ; i++)
            {
            	resultarray[i]=pufferEOL [i];
            }

			authKey = resultarray[5] |
							  (resultarray[4] << 8) |
							  (resultarray[3] << 16) |
							  (resultarray[2] << 24);    

               
          authKey = authKey & RBEOLPin; //It has been derived from the ASCII values of "Bosch Diagnostics for Driver Assistance"
          authKey = authKey | PMARequest; //Plant mode activation part request
      
          resultarray[5] = (byte)(authKey & 0xff);
    	  resultarray[4] = (byte)((authKey >> 8) & 0xff);
    	  resultarray[3] = (byte)((authKey >> 16) & 0xff);
    	  resultarray[2] = (byte)((authKey >> 24) & 0xff);

		  StartDiagService (SEEDNKEYRESP); 
           
      break;          
      
//For Service Package 01...
        case SEEDNKEYREQUESTUNLOCKONE: 
            //Calculate  key after receiving seed
         if (( RxDataBuffer[0] == 0x67 ) && ( RxDataBuffer[1] == 0x01 )&& (( RxDataBuffer[2] != 0x00 )|| ( RxDataBuffer[3] != 0x00 )))
         {
          

           getvalue(EnvRxData_CAN,puffer);
           
           byte_buf[0] = puffer[2];
           byte_buf[1] = puffer[3];
           write("puffer[2] %x and puffer [3] %x", puffer[2], puffer[3]);
           SeedInInit = (((puffer[2]<<8)|puffer[3])&0xFFFF);
          write("SeedInit=%x",SeedInInit);

          write("sk1 = %x",SK1);
          write("sk2 = %x",SK2);
          write("sk3 = %x",SK3);
           KeyInInt = ((SeedInInit + SK1)^((SeedInInit*SK2)%SK3));
           write("KeyInInt value %x", KeyInInt);
           
           KeyInByte[0] = KeyInInt>>8;
          write("KeyInInt byte[0]= %x", KeyInByte[0]);
           KeyInByte[1] = (KeyInInt&0xFF);
          write("KeyInInt byte[1]= %x", KeyInByte[1]);
           
           

    /*            //calculate the Key
                t_crc = 0xFF;
                byte_buf[0]=puffer[2];	byte_buf[1]=puffer[3];	byte_buf[2]=puffer[4];	byte_buf[3]=puffer[5];	
                CalculateCrc8 ();
                byte_buf[0] = t_crc;
                t_crc = 0xFF;

                CalculateCrc8 ();
                sec_key[0] = t_crc;
                t_crc = 0xFF;

                byte_buf[0]=puffer[2]; 	byte_buf[1]=sec_key[0];	
                CalculateCrc8 ();
                sec_key[1] = t_crc;
                t_crc = 0xFF;
						
            //crc8(&t_crc, seedlength, byte_buf);
            //key[1] = crc8(&t_crc, seedlength, byte_buf);;
			byte_buf[1]=puffer[3]; 	byte_buf[2]=sec_key[1];				
            CalculateCrc8 ();
            sec_key[2] = t_crc;
            t_crc = 0xFF;

        	byte_buf[2]=puffer[4]; 	byte_buf[3]=sec_key[2];	
            CalculateCrc8 ();
            sec_key[3] = t_crc;
            //t_crc = 0xFF;

                //result=puffer[2]*0x1000000+puffer[3]*0x10000+puffer[4]*0x100+puffer[5] + getValue(EnvDevLoginValue);
 */
            resultarrayTypeOne[3]=KeyInByte[1];
          write("resultarrayTypeOne[3]= %x", resultarrayTypeOne[3]);
            resultarrayTypeOne[2]=KeyInByte[0];
          write("resultarrayTypeOne[2]= %x", resultarrayTypeOne[2]);
			resultarrayTypeOne[1]=0x02;
          write("resultarrayTypeOne[1]= %x", resultarrayTypeOne[1]);
            resultarrayTypeOne[0]=0x27;
          write("resultarrayTypeOne[0]= %x", resultarrayTypeOne[0]);
            whichlogin=0;
          StartDiagService(SEEDNKEYRESP_TYPE1);

          }

      break;

      case SEEDNKEYREQUESTUNLOCKFOUR:

         write("Response %x%x%x%x%x%x%x",RxDataBuffer[0], RxDataBuffer[1], RxDataBuffer[2],RxDataBuffer[3],RxDataBuffer[4],RxDataBuffer[5],RxDataBuffer[6] );
            //Calculate  key after receiving seed
         if (( RxDataBuffer[0] == 0x67 ) && ( RxDataBuffer[1] == 0x41 )&& (( RxDataBuffer[2] != 0x00 )|| ( RxDataBuffer[3] != 0x00 )|| ( RxDataBuffer[4] != 0x00 )|| ( RxDataBuffer[5] != 0x00 )|| ( RxDataBuffer[6] != 0x00 )))
         {


           long Temp_u32 = 0x0;
           long Temp2_u32 = 0x0;
           getvalue(EnvRxData_CAN,puffer);

           byte_buf1[0] = puffer[2];
           byte_buf1[1] = puffer[3];
           byte_buf1[2] = puffer[4];
           byte_buf1[3] = puffer[5];
           write("puffer[2] %x and puffer [3] %x", puffer[2], puffer[3]);
           write("puffer[4] %x and puffer [5] %x", puffer[4], puffer[5]);

           //SeedInInit = ((puffer[2]<<24)|(puffer[3]<<16)|(puffer[4]<<8)|(puffer[5]<<0));
           SeedInInit = ((puffer[4]<<8)|(puffer[5]<<0));
           SeedInInit = (SeedInInit|(puffer[3]<<16));
           SeedInInit = (SeedInInit|(puffer[2]<<24));
           write("SeedInInit value %x", SeedInInit);
            //Keywk1 = (SeedInInit + SFC1);
           sum_carry = 0;

           sum_res[0] = byte_buf1[3] + SFC1[3];
           sum_carry = sum_res[0]>>8;
           sum_res[0] = sum_res[0]&0xFF;
           write("sum_res[0] value %x sum_carry value %x", sum_res[0],sum_carry);

           sum_res[1] = byte_buf1[2] + SFC1[2] + sum_carry;
           sum_carry = sum_res[1]>>8;
           sum_res[1] = sum_res[1]&0xFF;
           write("sum_res[1] value %x sum_carry value %x", sum_res[1],sum_carry);

           sum_res[2] = byte_buf1[1] + SFC1[1] + sum_carry;
           sum_carry = sum_res[2]>>8;
           sum_res[2] = sum_res[2]&0xFF;
           write("sum_res[2] value %x sum_carry value %x", sum_res[2],sum_carry);

           sum_res[3] = byte_buf1[0] + SFC1[0] + sum_carry;
           sum_carry = sum_res[3]>>8;
           sum_res[3] = sum_res[3]&0xFF;
           write("sum_res[3] value %x sum_carry value %x", sum_res[3],sum_carry);

           sum_res[4] = sum_carry;

           write("sum_res value %x%x%x%x%x", sum_res[4],sum_res[3],sum_res[2],sum_res[1],sum_res[0]);


           Temp_u32 = (sum_res[3]<<24)|(sum_res[2]<<16)|(sum_res[1]<<08)|(sum_res[0]);

          write("seed in hex %x",Temp_u32);
          /*Rotate left 3 times*/
           Temp2_u32 = (Temp_u32<<3)&0xFFFFFFF8;
           Temp_u32 = ((Temp_u32&0xE0000000)>>29)&0x7;
           //Temp2_u32 = Temp2_u32|(Temp_u32>>31);
           Temp_u32 = Temp2_u32|Temp_u32;
            
           sum_res[0] = (Temp_u32&0xFF);
           sum_res[1] = (Temp_u32&0xFF00)>>08;
           sum_res[2] = (Temp_u32&0xFF0000)>>16;
           sum_res[3] = (Temp_u32&0xFF000000)>>24;
           sum_res[4] = 0;

           write("Keywk1 value after 3 rol %x %x %x %x %x", sum_res[4],sum_res[3],sum_res[2],sum_res[1],sum_res[0]);

           Keywk1[0] = sum_res[0];
           Keywk1[1] = sum_res[1];
           Keywk1[2] = sum_res[2];
           Keywk1[3] = sum_res[3];
           Keywk1[4] = sum_res[4];
          
          /*Rotate left 3 times*/
           Temp2_u32 = (SeedInInit>>1)&0x7FFFFFFF;
           Temp_u32 = ((SeedInInit&0x00000001)<<31)&0x80000000;
           //Temp2_u32 = Temp2_u32|(Temp_u32>>31);
           Temp_u32 = Temp2_u32|Temp_u32;
          
           sum_res[0] = (Temp_u32&0xFF);
           sum_res[1] = (Temp_u32&0xFF00)>>08;
           sum_res[2] = (Temp_u32&0xFF0000)>>16;
           sum_res[3] = (Temp_u32&0xFF000000)>>24;
           sum_res[4] = 0;

           write("Keywk2 value after 3 rol %x %x %x %x %x", sum_res[4],sum_res[3],sum_res[2],sum_res[1],sum_res[0]);

           Keywk2[0] = sum_res[0];
           Keywk2[1] = sum_res[1];
           Keywk2[2] = sum_res[2];
           Keywk2[3] = sum_res[3];
           Keywk2[4] = sum_res[4];
          
           Temp_u32 = (SeedInInit>>16)&0xFFFF;
                    write("rnh %x",Temp_u32);
           Temp2_u32 = SeedInInit&0xFFFF;
             write("rnl %x",Temp2_u32);
           Temp_u32 = Temp_u32*Temp2_u32;
          
          write("multiple of rnh and rnl %x",Temp_u32);
          
           sum_res[0] = (Temp_u32&0xFF);
           sum_res[1] = (Temp_u32&0xFF00)>>08;
           sum_res[2] = (Temp_u32&0xFF0000)>>16;
           sum_res[3] = (Temp_u32&0xFF000000)>>24;
           sum_res[4] = 0;
          
           write("Keywk3 value after 3 rol %x%x%x%x%x", sum_res[4],sum_res[3],sum_res[2],sum_res[1],sum_res[0]);

          
           Keywk3[0] = sum_res[0];
           Keywk3[1] = sum_res[1];
           Keywk3[2] = sum_res[2];
           Keywk3[3] = sum_res[3];
           Keywk3[4] = sum_res[4];
          
           sum_res[0] =  Keywk1[0] ^  Keywk2[0] ^ Keywk3[0];
           sum_res[1] =  Keywk1[1] ^  Keywk2[1] ^ Keywk3[1];
           sum_res[2] =  Keywk1[2] ^  Keywk2[2] ^ Keywk3[2];
           sum_res[3] =  Keywk1[3] ^  Keywk2[3] ^ Keywk3[3];

           write("Keywk xored output value after 3 rol %x%x%x%x%x", sum_res[4],sum_res[3],sum_res[2],sum_res[1],sum_res[0]);

           sum_carry = 0;

           sum_res[0] = sum_res[0] + 0x14;
           sum_carry = sum_res[0]>>8;
           sum_res[0] = sum_res[0]&0xFF;
           write("sum_res[0] value %x sum_carry value %x", sum_res[0],sum_carry);

           sum_res[1] = sum_res[1] + 0x37 + sum_carry;
           sum_carry = sum_res[1]>>8;
           sum_res[1] = sum_res[1]&0xFF;
           write("sum_res[1] value %x sum_carry value %x", sum_res[1],sum_carry);

           sum_res[2] = sum_res[2] + 0x70 + sum_carry;
           sum_carry = sum_res[2]>>8;
           sum_res[2] = sum_res[2]&0xFF;
           write("sum_res[2] value %x sum_carry value %x", sum_res[2],sum_carry);

           sum_res[3] = sum_res[3] + 0x00 + sum_carry;
           sum_carry = sum_res[3]>>8;
           sum_res[3] = sum_res[3]&0xFF;
           write("sum_res[3] value %x sum_carry value %x", sum_res[3],sum_carry);

           sum_res[4] = sum_carry;

           write("sum_res value %x%x%x%x%x", sum_res[4],sum_res[3],sum_res[2],sum_res[1],sum_res[0]);          
          

            resultarrayTypeFour[6]= 0xEA;  
            //resultarrayTypeFour[2]=(KC4>>24)&(0xFF);
            //resultarrayTypeFour[3]=(KC4>>16)&(0xFF);
            //resultarrayTypeFour[4]=(KC4>>8)&(0xFF);
            //resultarrayTypeFour[5]=(KC4>>0)&(0xFF);
            resultarrayTypeFour[2]=sum_res[3];
            resultarrayTypeFour[3]=sum_res[2];
            resultarrayTypeFour[4]=sum_res[1];
            resultarrayTypeFour[5]=sum_res[0];
			resultarrayTypeFour[1]=0x42;
            resultarrayTypeFour[0]=0x27;
            whichlogin=0;
          StartDiagService(SEEDNKEYRESP_TYPE4);

          }

      break;
      
      case SEEDNKEYREQUESTUNLOCKFIVE: 
            //Calculate  key after receiving seed
         if (( RxDataBuffer[0] == 0x67 ) && ( RxDataBuffer[1] == 0x07 )&& (( RxDataBuffer[2] != 0x00 )|| ( RxDataBuffer[3] != 0x00 )||( RxDataBuffer[4] != 0x00 )||( RxDataBuffer[5] != 0x00 )))
         {
           byte Temp_KC5[2] = {0,0};    
           byte Temp_KC5_2[2] = {0,0}; 
           //int SC5_Select = 0;
           byte KC5_var_1[2] = {0,0};
           byte KC5_var_2[2] = {0,0};
           int sum_0 = 0;
           int sum_1 = 0;
          
           getvalue(EnvRxData_CAN,puffer);
           
           byte_buf[0] = puffer[2];
           byte_buf[1] = puffer[3];
           write("puffer[2] %x and puffer [3] %x", puffer[2], puffer[3]);
           SeedInInit = (((puffer[2]<<8)|puffer[3])&0xFFFF);
           write("SeedInInit %x",SeedInInit );
           //KeyInInt = ((SeedInInit + SK1)^((SeedInInit*SK2)%SK3));
           write("Env_SC5values %x",getvalue(Env_SC5values));
           switch(getvalue(Env_SC5values))
           {
           case 0xa810:    
              KC5_var_1[0] = 0x1D;
              KC5_var_1[1] = 0x0B;

              KC5_var_2[0] = 0xAD;
              KC5_var_2[1] = 0x07;
              write("A810 entered");
               
             break;
             
            case 0xa811:    
              KC5_var_1[0] = 0x9C;
              KC5_var_1[1] = 0xE7;

              KC5_var_2[0] = 0x0C;
              KC5_var_2[1] = 0x87;
               
             break;
              case 0xa812:    
              KC5_var_1[0] = 0x20;
              KC5_var_1[1] = 0xC2;

              KC5_var_2[0] = 0x10;
              KC5_var_2[1] = 0x4D;
               
             break;
              case 0xa813:    
              KC5_var_1[0] = 0x92;
              KC5_var_1[1] = 0x7C;

              KC5_var_2[0] = 0x0A;
              KC5_var_2[1] = 0x8C;
               
             break;
              
              case 0xa814:    
              KC5_var_1[0] = 0x11;
              KC5_var_1[1] = 0x97;

              KC5_var_2[0] = 0x29;
              KC5_var_2[1] = 0x8F;
               
             break;
               case 0xa815:    
              KC5_var_1[0] = 0x88;
              KC5_var_1[1] = 0x3A;

              KC5_var_2[0] = 0x99;
              KC5_var_2[1] = 0xED;
               
             break;
                case 0xa816:    
              KC5_var_1[0] = 0x9D;
              KC5_var_1[1] = 0x10;

              KC5_var_2[0] = 0x22;
              KC5_var_2[1] = 0xA9;
               
             break;
                 case 0xa817:    
              KC5_var_1[0] = 0x21;
              KC5_var_1[1] = 0x0B;

              KC5_var_2[0] = 0x39;
              KC5_var_2[1] = 0xC1;
               
             break;
             
           }
           
            Temp_KC5[0] = (byte_buf[0]^(KC5_var_1[0]));
            Temp_KC5[1] = (byte_buf[1]^(KC5_var_1[1]));
            write(" Temp_KC5[0] %x  Temp_KC5[1] %x",Temp_KC5[0], Temp_KC5[1]);
            Temp_KC5_2[0] = (Temp_KC5[0]<<2)|(Temp_KC5[1]>>6);
            Temp_KC5_2[1] = (Temp_KC5[1]<<2)|(Temp_KC5[0]>>6);
            write("Temp_KC5_2[0] %x & Temp_KC5_2[1] %x",Temp_KC5_2[0],Temp_KC5_2[1]);


            sum_0 = Temp_KC5_2[1] + KC5_var_2[1];
            write("sum_0 %x",sum_0);
            KeyInByte[1] = sum_0&0xFF;
            write("KeyInByte[0] %x",KeyInByte[0]);
            KeyInByte[0] = Temp_KC5_2[0] + KC5_var_2[0] + (sum_0>>8);
             write("KeyInByte[1] %x",KeyInByte[1]);
      
            resultarrayTypeFive[5]=puffer[5];
            resultarrayTypeFive[4]=puffer[4];             
            resultarrayTypeFive[3]=KeyInByte[1];
            resultarrayTypeFive[2]=KeyInByte[0];
  			    resultarrayTypeFive[1]=0x08;
            resultarrayTypeFive[0]=0x27;
             
            whichlogin=0;
            StartDiagService(SEEDNKEYRESP_TYPE5);

          }

      break;


     case RESET: 
     case START_IR_TEST: 
	 case STOP_IR_TEST: 
     case START_IMG_TEST: 
	 case STOP_IMG_TEST: 
	 case CALIB_AUTO:         
  	 case SKIP_CALIB:
	 case CALIB_SHIFT_UP:
	 case CALIB_SHIFT_DOWN:
	 case CALIB_SHIFT_LEFT:
	 case CALIB_SHIFT_RIGHT:
	 case CALIB_DATA_SAVE:
	 case CALIB_DATA_DEL:
	 case TESTER_PRESENT_ON:
     case TESTER_PRESENT_OFF:
     case DIS_NOR_MSG_TX: 
	 case EN_NOR_MSG_TX: 
	 case CLEAR_DTC: 
     case CLEAR_HIST_DTC: 
	 case SHOW_ENG_INFO:
     case DIRECT_RQ:

    break;

 
 // For GEN3 Sec unlock supported ::::
    

      case READ_DTC_BY_ST:
        if ( gRxDataBuffer[0] == 0x59 )
         {
            gRxBufferIndex  = 3;
            gNrOfReadDTC    = (Length - 3)/4;  
            DtcNr        = 1; 
            for (i = 0; i < gNrOfReadDTC; i++)
            {
                  gerrorDTC[DtcNr]      = (dword)gRxDataBuffer[gRxBufferIndex++] << 16;
                  gerrorDTC[DtcNr]      += (dword)gRxDataBuffer[gRxBufferIndex++] << 8;
                  gerrorDTC[DtcNr]      += (dword)gRxDataBuffer[gRxBufferIndex++]; 
                  gerrorStatus[DtcNr++] = gRxDataBuffer[gRxBufferIndex++];
			   
            }
            if ( (gNrOfReadDTC == 0) )
            {
                   putValue (EnvReqStatus_CAN, "No DTCs");
            }else{
                   putValue (EnvReqStatus_CAN, "All DTCs received");
            }

               gCurrentDTC = 1;
               ShowDTCs();
               
            
            }
    break; 
 
            
     case SEEDNKEYHONDAREQUEST: 
                
                
                getvalue(EnvRxData_CAN,puffer);

                 bin = 0x80;
                c_index=0;
    input[0] = puffer[2];
    input[1] = puffer[3];
    input[2] = puffer[4];
    input[3] =0xb7 ;
    input[4] = 0x16;
    input[5] = 0xd3;
    input[6] = 0xc6;
    input[7] = 0x5b;
    write("in resp code ");
                
    write("seed%x%x%x",puffer[2],puffer[3],puffer[4]);
    for(i = 0; i < 24; i++)
    {
        position_one[i]=init_array[i];
    }

    for(i = 0; i < 8; i++)
    {
        for(j = 7; j >= 0; j--)
        {
            challenge[c_index + j] = input[i] & bin;
            if(challenge[c_index + j] > 0)
            {
                challenge[c_index + j] = 1;
            }
            bin = bin >> 1;
        }
        bin = 0x80;
        c_index+=8;
    }
    
    for(i = 0; i < 64; i++)
    {
        position_two[23] = challenge[i] ^ position_one[0];
        for(j = 0; j < 23; j++)
        {
            position_two[j] = position_one[j+1];
        }
        for(j = 0; j < 24; j++)
        {
            if(j == 3 || j == 5 || j == 12 || j == 15 || j == 20)
            {
                position_one[j] = position_two[j] ^ position_two[23];
            }
            else
            {
                position_one[j] = position_two[j];
            }
        }        
    }
    
    resultarra[0] = 0x27;
    resultarra[1] = SeednKeyHONDAEOLRequest[1] + 1;
    resultarra[2] = (byte)((position_one[11] * 8 + position_one[10] * 4 + position_one[9] *2 + position_one[8]) * 16 + (position_one[7] * 8 + position_one[6] * 4 + position_one[5] *2 + position_one[4]));
    resultarra[3] = (byte)((position_one[15] * 8 + position_one[14] * 4 + position_one[13] *2 + position_one[12]) * 16 + (position_one[23] * 8 + position_one[22] * 4 + position_one[21] *2 + position_one[20]));
    resultarra[4] = (byte)((position_one[3] * 8 + position_one[2] * 4 + position_one[1] *2 + position_one[0]) * 16 + (position_one[19] * 8 + position_one[18] * 4 + position_one[17] *2 + position_one[16]));
    write(" key cal %x%x%x%x%x",resultarra[0],resultarra[1],resultarra[2],resultarra[3],resultarra[4]);
    StartDiagService( SEEDNKEYRBEOLRESP);
    break;

    
    case SEEDNKEYFBLREQUEST: 
     
    securityRespBuffer[0]='\0';
    responseLen = getvalue(EnvRxData_CAN,securityRespBuffer);        
    strncpy(pufferStr,"",elcount(pufferStr));
    strncpy(Seed,"",elcount(Seed));
        
    for(i=0;i<responseLen;i++)
    {
      ltoa(securityRespBuffer[i],IMBuffer,16);
      
      if( strlen( IMBuffer ) == 1 )
			{
				 IMBuffer[1] = IMBuffer[0];
         IMBuffer[0] = '0';
         strncat(pufferStr,IMBuffer,elcount(pufferStr));
			}
		  else
			{
				 strncat(pufferStr,IMBuffer,elcount(pufferStr));
			}
      
    }
    write("pufferStr=%s",pufferStr);
    substr_cpy(Seed,pufferStr,6,-1,elcount(Seed));
    if(securityRespBuffer[0] != 0x7F)
    {
      putValue(Env_Security_SeedOutput,Seed);
     // write("Seed len=%d",elcount(Seed));
      write("Seed in compare=%s",Seed);
    }
    toUpper(Seed,Seed,elcount(Seed));
          
    for(i=0;i<100;i++)
    {
      //write("seedList[%d]=%d",i,seedList[i]); //Seed comparision
      if(strncmp(seedList[i],Seed, elcount(Seed))== 0)
      {
      //  i=0;
         sendKey[0]='\0';
       write("i=%d",i);
        if(i!=-1)
       {

      write("I'm In SEC IF");
    sendKey[0]=0x27;
    sendKey[1]=SeednKeyFBLRequest[1]+1;      
    k=2;  
    strncpy(temp, "0x",3);
    
      j=0;
      
    TxLength = (strlen(keyList[i])/2)+2;
    write("TxLength=%d",TxLength);
    while(j<strlen(keyList[i]))
    {

      temp[2]=keyList[i][j];
      temp[3]=keyList[i][j+1];
      temp[4]=0;
      sendKey[k] = atol(temp);
    
      k++;
      j+=2;
       
    }
   
    write("k=%d,gTxlength=%d",k,gTxlength);
   
    for(i=0;i<968;i++)
    {
    write("In evaluate sendKey[i]=%x",sendKey[i]);
    }
   
    sendKey[k]='\0';
   

    StartDiagService( SEEDNKEYHONDARESP);    
    
    }
    else
    {
       putValue(Env_SecurityMode_Output," Seed Compare Failed ");
      write("The Security XML doesnt have the required seed - key pair ");
     
    }
        break;
  }
      else if(strncmp(DefaultSeed[i],Seed, elcount(Seed))!= 0)
       {
        putValue(Env_SecurityMode_Output," Already Sec Unlocked ");
           // i = -1;
        break; 
        
       }
      else 
      {
       // putValue(Env_SecurityMode_Output,"Wrong File Path - to compare Seed");
        
        //i = -1;
        break;
      }
      
    }
    
   
     break;

      case SEEDNKEYFBLDYNAMICREQUEST:
        
            responseLen = getvalue(EnvRxData_CAN,securityRespBuffer);
            for(i=0;i<responseLen;i++)
            {
              ltoa(securityRespBuffer[i],IMBuffer,16);
              if( strlen( IMBuffer ) == 1 )
			        {
				        IMBuffer[1] = IMBuffer[0];
                IMBuffer[0] = '0';
                strncat(pufferStr,IMBuffer,elcount(pufferStr));
			        }
		          else
			        {
				        strncat(pufferStr,IMBuffer,elcount(pufferStr));
			        }
              
            }
            substr_cpy(Seed,pufferStr,6,-1,elcount(Seed));
            
            if(securityRespBuffer[0] != 0x7F)
            {
             putValue(Env_Security_SeedOutput,Seed);
             setTimer(sectimer1,1000);
            }
            
            DynamicFlag = 1;
            break;
            
      case SEEDNKEYHONDADYNAMICREQUEST:
        
            responseLen = getvalue(EnvRxData_CAN,securityRespBuffer);
            for(i=0;i<responseLen;i++)
            {
              ltoa(securityRespBuffer[i],IMBuffer,16);
              if( strlen( IMBuffer ) == 1 )
			        {
				        IMBuffer[1] = IMBuffer[0];
                IMBuffer[0] = '0';
                strncat(pufferStr,IMBuffer,elcount(pufferStr));
			        }
		          else
			        {
				        strncat(pufferStr,IMBuffer,elcount(pufferStr));
			        }
              
            }
            substr_cpy(Seed,pufferStr,6,-1,elcount(Seed));
            
             if(securityRespBuffer[0] != 0x7F)
            {
             putValue(Env_Security_SeedOutput,Seed);
             setTimer(sectimer1,1000);
            }
            
            DynamicFlag = 2;
            break;
            
      case SEEDNKEYHONDAEOLREQUEST: 
        
    responseLen = getvalue(EnvRxData_CAN,securityRespBuffer);
    strncpy(pufferStr,"",elcount(pufferStr));
    strncpy(Seed,"",elcount(Seed));
        
    for(i=0;i<responseLen;i++)
    {
      ltoa(securityRespBuffer[i],IMBuffer,16);
      
      if( strlen( IMBuffer ) == 1 )
			{
				 IMBuffer[1] = IMBuffer[0];
         IMBuffer[0] = '0';
         strncat(pufferStr,IMBuffer,elcount(pufferStr));
			}
		  else
			{
				 strncat(pufferStr,IMBuffer,elcount(pufferStr));
			}
    
    }
    write("%s",pufferStr);
    substr_cpy(Seed,pufferStr,6,-1,elcount(Seed));
    
    if(securityRespBuffer[0] != 0x7F)
    {
      putValue(Env_Security_SeedOutput,Seed);
    }
    
    toUpper(Seed,Seed,elcount(Seed));
          
    for(i=0;i<100;i++)
    {
      if(strncmp(seedListHONDA[i],Seed, elcount(Seed))==0)
      {
        break;
      }
      else if(100== i+1)
      {
        write("The Security XML doesnt have the required seed - key pair ");
        
        i = -1;
        break;
      }
    }
    
    if(i!=-1)
    {
    sendKey[0]=0x27;
    sendKey[1]=SeednKeyHONDAEOLRequest[1]+1;
    k=2;  
    
    strncpy(temp, "0x",3);
    j=0;
    gTxlength = (strlen(keyListHONDA[i])/2)+2;
    
    while(j<strlen(keyListHONDA[i]))
    {
      temp[2]=keyListHONDA[i][j];
      temp[3]=keyListHONDA[i][j+1];
      temp[4]=0;
      sendKey[k]=atol(temp);
      k++;
      j+=2;
    }
    sendKey[k]='\0';    
    StartDiagService( SEEDNKEYHONDARESP);
    }
     break;
        
      case SEEDNKEYREQUEST:
      
          
            getvalue(EnvRxData_CAN,puffer);
           
          // New Calculation of Reprog Key in BL for Release X060 onwards:
            
            resultarray[0] = 0x27 ;
            resultarray[1] = SeednKeyFBLRequest[1] + 1;

            for (i = 2; i <6 ; i++)
            {
            	resultarray_32[i]=puffer [i];
            }

			seedReprogValue = resultarray_32[5] |
							  (resultarray_32[4] << 8) |
							  (resultarray_32[3] << 16) |
							  (resultarray_32[2] << 24);

			keyReprogValue = seedReprogValue;

        
    
       		for(j = 0; j <7 ; j++)
        	{

            	keytemp = keyReprogValue ;
            	keyReprogValue = keyReprogValue + REP_RBA_CBB_AKEY_VALUE;
	       		// write(" keytemp and keyReprogValue  for j value %i beginning loop: %lx, %lx ",j, keytemp, keyReprogValue );    
    
    			if((keyMaxReprogValue - REP_RBA_CBB_AKEY_VALUE) < keytemp)
    			{
    	  		/* Rotate Right by 10 */
 	       			keyLowReprogValue = keyReprogValue & (0x000003FF);
 	    			keyUpperReprogValue = keyLowReprogValue << 22;
 	    			keyReprogValue = keyReprogValue >> 10;
 	    			keyReprogValue = keyReprogValue | keyUpperReprogValue;
       				keyReprogValue = keyReprogValue ^ REP_RBA_CBB_BKEY_VALUE;
    			}
    			else
    			{
 	    		/* Rotate Left by 13 */
 	    		    keyUpperReprogValue = keyReprogValue & (0xFFF80000);
 			        keyLowReprogValue   = keyUpperReprogValue >> 19;
 			    	keyReprogValue      = keyReprogValue << 13;
		 	    	keyReprogValue      = keyReprogValue | keyLowReprogValue;
		       		keyReprogValue      = keyReprogValue ^ REP_RBA_CBB_CKEY_VALUE;
		    	}
      		}
 
        	keyReprogValue = keyReprogValue - REP_RBA_CBB_DKEY_VALUE;

		  /* Key Algo end */
			    //write(" final  keyReprogValue %lx",keyReprogValue );    
  
        	resultarray[5] = (byte)(keyReprogValue & 0xff);
			resultarray[4] = (byte)((keyReprogValue >> 8) & 0xff);
			resultarray[3] = (byte)((keyReprogValue >> 16) & 0xff);
			resultarray[2] = (byte)((keyReprogValue >> 24) & 0xff);

           StartDiagService (SEEDNKEYRESP);
         
      break;
      
      case READ_DTC_BY_ST_RBEOL:  //***********************************RBEOL******************************************************
        if ( gRxDataBuffer[0] == 0x59 )
         {
            gRxBufferIndex  = 3;
            gNrOfReadDTC    = (Length - 3)/4;  
            DtcNr        = 1; 
            for (i = 0; i < gNrOfReadDTC; i++)
            {
                  gerrorDTC[DtcNr]      = (dword)gRxDataBuffer[gRxBufferIndex++] << 16;
                  gerrorDTC[DtcNr]      += (dword)gRxDataBuffer[gRxBufferIndex++] << 8;
                  gerrorDTC[DtcNr]      += (dword)gRxDataBuffer[gRxBufferIndex++]; 
                  gerrorStatus[DtcNr++] = gRxDataBuffer[gRxBufferIndex++];
			   
            }
            if ( (gNrOfReadDTC == 0) )
            {
                   putValue (EnvReqStatus_CAN, "No DTCs");
            }else{
                   putValue (EnvReqStatus_CAN, "All DTCs received");
            }

               gCurrentDTC = 1;
               ShowDTCs();
               
            
            }
    break;
            
              
   }

}  



//Ends here 
///////////////////////////////////////////////////////////////////////
void StartDiagService( byte ServiceId )           //Can be used for GEN3 sec unlock mechanism
{ 
    int i;
    byte buffer[1];
    long switchEWBsValue = 0x00;

   CurrentDiagServ = ServiceId;
    
         putValue (EnvReqStatus_CAN, "...");
         putValue (EnvRespTime_CAN, 0.0);
    

   //Diag Switch
   switch ( ServiceId )
   {
        case TESTER_PRESENT_OFF:
            //msgDiagRequest.byte(0) = 0x02;
            //msgDiagRequest.byte(1) = 0x10;
            //msgDiagRequest.byte(2) = 0x01;   //Default session

            cancelTimer (TesterPresentTimer);
          //  ReqDiagMsgGlobal.CAN = SEND_CAN;        

          //output (msgDiagRequest);
      
      //      putValue (EnvReqStatus_CAN, "OK");
        break;

        case TESTER_PRESENT_ON:
            //msgDiagRequest.byte(0) = 0x02;
            //msgDiagRequest.byte(1) = 0x10;
            //msgDiagRequest.byte(2) = 0x03;	//Extended diag session
            


            cancelTimer (TesterPresentTimer);
            setTimer (TesterPresentTimer, FirstTesterPresentTime);

            //msgDiagRequest.CAN = SEND_CAN;        

         // output (msgDiagRequest);
      
       //     putValue (EnvReqStatus_CAN, "OK");

        break;

      
      case DIAG_SESSION_ON:
           TxDataBuffer[0] = 0x10;
            TxDataBuffer[1] = 0x03;	//Extended diag session
            
            TxLength = 2;  
            TransmitTxBuffer();
            
      break;
      
      case ENGINEERING_SESSION_ON:
           TxDataBuffer[0] = 0x10;
            TxDataBuffer[1] = 0x4f;	//Engineering diag session
            
            TxLength = 2;  
            TransmitTxBuffer();
            
      break;

      
      
      case READ_DTC_BY_ST: 

         TxDataBuffer[0] = 0x19;
         TxDataBuffer[1] = 0x02;
         TxDataBuffer[2] = 0x09;  
        //  SId = TxDataBuffer[0];
         TxLength = 3; 
         TransmitTxBuffer();
         

      break;      


      case READ_DTC_PASS:

         TxDataBuffer[0] = 0x19;
         TxDataBuffer[1] = 0x02;
         TxDataBuffer[2] = 0x08;  
        // SId = TxDataBuffer[0];
         TxLength = 3;  
         TransmitTxBuffer();
      break;



      case CLEAR_DTC: 
         TxDataBuffer[0] = 0x14;
         TxDataBuffer[1] = 0xFF;  
         TxDataBuffer[2] = 0xFF;
         TxDataBuffer[3] = 0xFF;   
         // SId = TxDataBuffer[0];
         TxLength = 4;
         TransmitTxBuffer();
      break;


      case DIRECT_RQ: 
      TxLength = DirectTxDataLen;
         TransmitTxBuffer();
         /*if(Radar_start==1)
        {
          Radar_start=0;
          putValue(Env_RADAR_Info,1);
          
        }
        else
        {
         TxLength = DirectTxDataLen;
         TransmitTxBuffer();
        }*/
      break;

      case READ_HIST_DTC_BY_ST: 
         TxDataBuffer[0] = 0x19;
         TxDataBuffer[1] = 0x02;
         TxDataBuffer[2] = 0x08;  //passive
 //        TxDataBuffer[2] = 0x10;  //untested
   //    TxDataBuffer[3] = 0x00;
         
         TxLength = 3;  //4
         TransmitTxBuffer();
      break;  
      case P_MODE_ACT_P1:
      
        //1) Send part1 request "80 B5 28 C3 1E FD"
        TxDataBuffer[0] = 0x80;
        TxDataBuffer[1] = 0xB5;
        TxDataBuffer[2] = 0x28;  
        TxDataBuffer[3] = 0xC3;  
        TxDataBuffer[4] = 0x1E;  
        TxDataBuffer[5] = 0xFD;  
       
        TxLength = 6; 
        TransmitTxBuffer();
        
      break;  
      
      case P_MODE_ACT_P2:
      
        //2) Send part2 request "80 B5 7C 68"
        TxDataBuffer[0] = 0x80;
        TxDataBuffer[1] = 0xB5;
        TxDataBuffer[2] = 0x7C;  
        TxDataBuffer[3] = 0x68;  
        
        TxLength = 4; 
        TransmitTxBuffer();
        
      break; 

    case FINGERPRINT: 
         
        putValue(EnvTxData_1,Fingerprint);
        DirectTxDataLen = getValue( EnvTxData_1, TxDataBuffer );
        TxLength = DirectTxDataLen;
        TransmitTxBuffer();
        setTimer(ProgDate,200);
    break; 

    
    case PROGDATE: 
    
        putValue(EnvTxData_1,ProgrammingDate);
        DirectTxDataLen = getValue( EnvTxData_1, TxDataBuffer );
        TxLength = DirectTxDataLen;
        TransmitTxBuffer();
         switch ( whichlogin)
         {
             case 1:
             case 2:
                setTimer(SeednKeyReq,200);
             break;
             case 5:
             case 6:
                setTimer ( MinicodeReq, 200);
             break;
        }

    break; 

    case SEEDNKEYREQUEST: 
         
        putValue(EnvTxData_1,SeednKeyRequest);
        DirectTxDataLen = getValue( EnvTxData_1, TxDataBuffer );
        TxLength = DirectTxDataLen;
        TransmitTxBuffer();
       
    break; 

            
//For GEN3 Unlock:
       case SEEDNKEYHONDAREQUEST: 
         
          putValue(EnvTxData_1,SeednKeyHONDAEOLRequest);
          DirectTxDataLen = getValue( EnvTxData_1, TxDataBuffer );
          TxLength = DirectTxDataLen;
          TransmitTxBuffer();
       
      break; 
      
      case SEEDNKEYHONDAEOLREQUEST: 
         
          putValue(EnvTxData_1,SeednKeyHONDAEOLRequest);
          DirectTxDataLen = getValue( EnvTxData_1, TxDataBuffer );
          TxLength = DirectTxDataLen;
          TransmitTxBuffer();
       
      break; 
         case SEEDNKEYFBLREQUEST: 
         
          putValue(EnvTxData_1,SeednKeyFBLRequest);
          DirectTxDataLen = getValue( EnvTxData_1, TxDataBuffer );
          TxLength = DirectTxDataLen;
          TransmitTxBuffer();
       
      break; 
        
      case SEEDNKEYFBLDYNAMICREQUEST:
        
          putValue(EnvTxData_1,SeednKeyFBLRequest);
          DirectTxDataLen = getValue( EnvTxData_1, TxDataBuffer );
          TxLength = DirectTxDataLen;
          TransmitTxBuffer();
          break;
        
      case SEEDNKEYHONDADYNAMICREQUEST:
        
          putValue(EnvTxData_1,SeednKeyHONDAEOLRequest);
          DirectTxDataLen = getValue( EnvTxData_1, TxDataBuffer );
          TxLength = DirectTxDataLen;
          TransmitTxBuffer();
          break;
            
          case SEEDNKEYRBEOLRESP: 
            putValue(EnvTxData_1,resultarra);
            DirectTxDataLen = getValue( EnvTxData_1, TxDataBuffer );
            TxLength = DirectTxDataLen;
            TransmitTxBuffer();
           
    break;
     

    case SEEDNKEYHONDARESP: 
        
            putValue(EnvTxData_1,sendKey);
            DirectTxDataLen = getValue( EnvTxData_1, TxDataBuffer );
            TransmitTxBuffer();
           
    break;     
          
    case READ_DTC_BY_ST_RBEOL: // Trasmitting Read DTC request in RBEOL****************************************************
           TxDataBuffer[0] = 0x19;
           TxDataBuffer[1] = 0x02;
           TxDataBuffer[2] = 0xFF;  
           TxLength = 3; 
           TransmitTxBuffer();
          break;      
            
            
            
 /////////////////////////////////////////////////////           
    case SEEDNKEYREPROGREQUEST: 
         
        putValue(EnvTxData_1,SeednKeyReprogRequest);
        DirectTxDataLen = getValue( EnvTxData_1, TxDataBuffer );
        TxLength = DirectTxDataLen;
        TransmitTxBuffer();
      
    break;

    case SEEDNKEYRBEOLREQUEST: 
         
        putValue(EnvTxData_1,SeednKeyRBEOLRequest);
        DirectTxDataLen = getValue( EnvTxData_1, TxDataBuffer );
        TxLength = DirectTxDataLen;
        TransmitTxBuffer();
      
    break;

   
    
    case SEEDNKEYREPROGREQUESTWRITEKEY: 
         
        putValue(EnvTxData_1,SeednKeyReprogRequest);
        DirectTxDataLen = getValue( EnvTxData_1, TxDataBuffer );
        TxLength = DirectTxDataLen;
        TransmitTxBuffer();
      
    break; 
  
     case  MINICODEREQUEST : 
        if (whichlogin == 5)   // Plant
        {
            MinicodeRequest[1]= 0x03; 
      
        }else {
             MinicodeRequest[1]= 0x21;  // Development
        }
        putValue(EnvTxData_1,MinicodeRequest);
        DirectTxDataLen = getValue( EnvTxData_1, TxDataBuffer );
        TxLength = DirectTxDataLen;
        TransmitTxBuffer();
         
     break; 


     //  case SEEDRBEOLREQUEST: 
         
       //    TxDataBuffer[0] = 0x23;
       //    TxDataBuffer[1] = 0x88;
       //    TxDataBuffer[2] = 0x01;  
       //    TxDataBuffer[3] = 0x00;  
       //    TxDataBuffer[4] = 0x00;
         
       //  TxLength = 5;  //4
      //   TransmitTxBuffer();
        
    //  break; 
     
         case SEEDNKEYRESP: 
            putValue(EnvTxData_1,resultarray);
            DirectTxDataLen = getValue( EnvTxData_1, TxDataBuffer );
            TxLength = DirectTxDataLen;
            TransmitTxBuffer();
           
         break; 

         case SEEDNKEYRESP_TYPE1: 
            putValue(EnvTxData_1,resultarrayTypeOne);
            DirectTxDataLen = getValue( EnvTxData_1, TxDataBuffer );
            TxLength = DirectTxDataLen;
            TransmitTxBuffer();
           
         break; 

        case SEEDNKEYRESP_TYPE4: 
            putValue(EnvTxData_1,resultarrayTypeFour);
            DirectTxDataLen = getValue( EnvTxData_1, TxDataBuffer );
            TxLength = DirectTxDataLen;
            TransmitTxBuffer();
           
        break;
        
        case SEEDNKEYRESP_TYPE5: 
        
            putValue(EnvTxData_1,resultarrayTypeFive);
            DirectTxDataLen = getValue( EnvTxData_1, TxDataBuffer );
            TxLength = DirectTxDataLen;
            TransmitTxBuffer();
           
        break;

        case  READ_EWB_ACT:

         TxDataBuffer[0] = 0x22;
         TxDataBuffer[1] = 0x05;
         TxDataBuffer[2] = EWB_VZE_ID; 
         TxDataBuffer[3] = 0x05;
         TxDataBuffer[4] = EWB_VZF_ID; 
         TxDataBuffer[5] = 0x05;
         TxDataBuffer[6] = EWB_EHR_ID;
         TxDataBuffer[7] = 0x05;
         TxDataBuffer[8] = EWB_HCA_ID;
         TxDataBuffer[9] = 0x05;
         TxDataBuffer[10] = EWB_MOD_ID;
         TxDataBuffer[11] = 0x05;
         TxDataBuffer[12] = EWB_FLA_ID;
         TxDataBuffer[13] = 0x09; //MI
         TxDataBuffer[14] = EWBs_ID; //MI
    
         TxLength = 15;  
         TransmitTxBuffer();
        break;  
 

        case  READ_DEACT_FUNC :  
         TxDataBuffer[0] = 0x22;
         TxDataBuffer[1] =  0x05;
         TxDataBuffer[2] = DEACT_FLA_ID; 
         TxDataBuffer[3] =  0x05;
         TxDataBuffer[4] = DEACT_VZE_ID; 
         TxDataBuffer[5] = 0x05;
         TxDataBuffer[6] = DEACT_CCP_ID;
         TxLength = 7;  
         TransmitTxBuffer();
  break;




   case  PRE_WRITE : 
        SetControlForeColor("Anpassungen", "PrepareWriteControl", MakeRGB(0,192,0));
            
        putvalue(EnvDirectSend,"104F");
     
        putvalue(EnvLogIn106A3,1);
        // Set tester present 
        putvalue(EnvTesterPresentOnOff, 1);
      
   break;

      case  PRE_WRITE_MINICODE : 
        SetControlForeColor("Anpassungen", "PrepareWriteControlMinicode", MakeRGB(0,192,0));
            
        putvalue(EnvDirectSend,"104F");
     
        putvalue(EnvMinicode_Dev,1);
        // Set tester present 
        putvalue(EnvTesterPresentOnOff, 1);
      
   break;

 

     case  READ_MASK_FAULT_CLASS:
 
         TxDataBuffer[0] = 0x22;
         TxDataBuffer[1] =  0x05;
         TxDataBuffer[2] = MASK_FAULT_CLASS_ID; 
         TxLength = 3;  
         TransmitTxBuffer();
        
    break;

     
       case   READ_MASK_ERR_RCTN:
 
         TxDataBuffer[0] = 0x22;
         TxDataBuffer[1] =  0x05;
         TxDataBuffer[2] = MASK_ERR_RCTN_ID; 
         TxLength = 3;  
         TransmitTxBuffer();
        
    break;


      case  READ_BAP_PERS:
 
         TxDataBuffer[0] = 0x22;
         TxDataBuffer[1] =  0x09;
         TxDataBuffer[2] = BAP_PERS_ID;  
         TxLength = 3;  
         TransmitTxBuffer();
        
    break;
 

      case READ_V_THRESHOLD_MAINBEAM_ON:
 
         TxDataBuffer[0] = 0x22;
         TxDataBuffer[1] =  0x3B;
         TxDataBuffer[2] = V_THRESHOLD_MAINBEAM_ON_ID;
         TxLength = 3;  
         TransmitTxBuffer();
        
    break;
  

      case READ_V_THRESHOLD_MAINBEAM_OFF:
 
         TxDataBuffer[0] = 0x22;
         TxDataBuffer[1] =  0x3B;
         TxDataBuffer[2] = V_THRESHOLD_MAINBEAM_OFF_ID;
         TxLength = 3;  
         TransmitTxBuffer();
        
    break;

    case SEEDNKEYREQUESTUNLOCKONE: 
                
        putValue(EnvTxData_1,SeednKeyTypeOne);
        DirectTxDataLen = getValue( EnvTxData_1, TxDataBuffer );
        TxLength = DirectTxDataLen;
        TransmitTxBuffer();
      
    break;
    case SEEDNKEYREQUESTUNLOCKFOUR: 
                
        putValue(EnvTxData_1,SeednKeyTypeFour);
        DirectTxDataLen = getValue( EnvTxData_1, TxDataBuffer );
        TxLength = DirectTxDataLen;
        TransmitTxBuffer();
      
    break;
    
    case SEEDNKEYREQUESTUNLOCKFIVE: 
                
        putValue(EnvTxData_1,SeednKeyTypeFive);
        DirectTxDataLen = getValue( EnvTxData_1, TxDataBuffer );
        TxLength = DirectTxDataLen;
        TransmitTxBuffer();
      
    break;

}


}   

CharArray2Byte(char convertable_array[])
{

    int i;
    char c1,c2;
    int strIndex;
    
    strIndex = 0;
    
    for (i = 0; i < elcount(RqTxStringData); i++)
      {
          RqTxStringData[i] = 0;
      } 
   
    for (i = 0; i < elcount(convertable_array); i++)
     {
      RqTxStringData[i] = convertable_array[i];     //RqTxStringData is a global variable
     }

    ByteSize = 0;  //ByteSize is a global variable
    for (i = 0; i < (strlen(RqTxStringData)/2); i++)
    {
        strIndex = i * 2;
         
        c1 = RqTxStringData[strIndex];
        c2 = RqTxStringData[strIndex + 1];
//        write ("Here is c1: %c and c2: %c", c1, c2);
        RqTxData[i] = char2byte(c1, 16) + char2byte(c2, 1);     // RqTxData is a global variable
        ByteSize++;
    }
    SID = RqTxData[0];
    write("SID chararray %x",SID);
    write("RqTxData[0] inside chararray %x",RqTxData[0]);
    write("convertable_array %s  %d",convertable_array,elcount(convertable_array));
}

byte char2byte (char c, int factor)
{
    switch(c){
    case 'F':
    case 'f': return 15 * factor;
    case 'E':
    case 'e': return 14 * factor;
    case 'D':
    case 'd': return 13 * factor;
    case 'C':
    case 'c': return 12 * factor;
    case 'B':
    case 'b': return 11 * factor;
    case 'A':
    case 'a': return 10 * factor;
    case '9': return 9 * factor;
    case '8': return 8 * factor;
    case '7': return 7 * factor;
    case '6': return 6 * factor;
    case '5': return 5 * factor;
    case '4': return 4 * factor;
    case '3': return 3 * factor;
    case '2': return 2 * factor;
    case '1': return 1 * factor;
    }
    return 0;
}


void TransmitTxBuffer (void)
{ 	

    /*switch (getvalue(EnvDiagPhyTxCANIDs))
    {
        case 0x18DAB5F1: 
    
        // Physical CanID 1
        ConfigTP(0x18DAB5F1, 0x18DAF1B5);
    
        break;

        case 0x18DAB5F2: 

        // Physical CanID 2
        ConfigTP(0x18DAB5F2, 0x18DAF2B5);
        break;


        case 0x18DAB5F3: 

        // Physical CanID 3
        ConfigTP(0x18DAB5F3, 0x18DAF3B5);
        break;


    
        case 0x18DAB5F4: 

        // Physical CanID 4
        ConfigTP(0x18DAB5F4, 0x18DAF4B5);
        break;



        case 0x18DAB5F5: 

        // Physical CanID 5
        ConfigTP(0x18DAB5F5, 0x18DAF5B5);
        break;

    

        case 0x18DAB5F6: 

        // Physical CanID 6
        ConfigTP(0x18DAB5F6, 0x18DAF6B5);
        break;

    
        case 0x18DAB5F7: 

        // Physical CanID 7
        ConfigTP(0x18DAB5F7, 0x18DAF7B5);
        break;


    
        case 0x18DAB5F8: 

        // Physical CanID 8
        ConfigTP(0x18DAB5F8, 0x18DAF8B5);
        break;

    

        case 0x18DAB5F9: 

        // Physical CanID 9
        ConfigTP(0x18DAB5F9, 0x18DAF9B5);
        break;




        case 0x18DAB5FA: 

        // Physical CanID 10
        ConfigTP(0x18DAB5FA, 0x18DAFAB5);
        break;



        case 0x18DAB5FB: 

        // Physical CanID 11
        ConfigTP(0x18DAB5FB, 0x18DAFBB5);
        break;



        case 0x18DAB5FC: 

        // Physical CanID 12
        ConfigTP(0x18DAB5FC, 0x18DAFCB5);
        break;



        case 0x18DAB5FD: 

        // Physical CanID 13
        ConfigTP(0x18DAB5FD, 0x18DAFDB5);
        break;



    }*/

	// OSEK TP supports up to 4095 bytes per transmission
  //	SId = TxDataBuffer[0];
	if (TxLength >= 4096)
		TxLength = 4095;
	

	//Fault Injections
	if (getvalue(EnvCFDoubleDelay)!=0)
		{
			OSEKTL_FI_DoubleCF (getvalue(EnvCFNr), getvalue(EnvCFDoubleDelay));
			write ("FI Fault Double CF"); 
		}


	if (getvalue(EnvCFDrop)==1)
	{
			OSEKTL_FI_DropCF(getvalue(EnvCFNr));
			write ("FI Fault Drop CF Nr %i",getvalue(EnvCFNr));
	}

	
 

	if (getvalue(EnvCFDelay)!=0)
	{
		OSEKTL_FI_DelayCF(getvalue(EnvCFNr),getvalue(EnvCFDelay));
	}
    
	// Empty Value for EnvRxData to avoid showing old values

    	putValue( EnvRxData_CAN,emptyString,0);
        putValue(EnvRxDataLen_CAN,0);
  write("MVBuffer transmit buff:%s",MVbuffer);
  putvalue (EnvDirectReceive,MVbuffer); // delete old value from receive 
  
 
	    OSEKTL_DataReq( TxDataBuffer, TxLength ); 
		
		putValue( EnvTxData_1, TxDataBuffer, TxLength );



	SId = TxDataBuffer[0];

}

OSEKTL_DataCon(long status)
{
	if (status != 0) 
	{
		RespTime = ( (float) timeNow() * (-1.0) );	
       	
	}
	else
	{
		write("Tx error, status is %d", status);
	}
}



OSEKTL_DataInd( long rxCount )
{
  // write("in dataind"); 
    int i;
    char	MVbuffer[200000] = "";
    char	MVbuffer2[200000] = "";
    char buffer2[200000]="0";
    
    strncpy(buffer2, "0", 6);
	  strncpy(MVbuffer2, "",6);
	  strncpy(MVbuffer, "",6);   
     write("in dataind"); 
	/* Get received data */
   
	OSEKTL_GetRxData( RxDataBuffer, elcount(RxDataBuffer) );
 ///////////////////////////////NA RBS////////////////// 
  write("RxDataBuffer[0] %x RxDataBuffer[1] %x RxDataBuffer[2] %x RxDataBuffer[3] %x",RxDataBuffer[0],RxDataBuffer[1],RxDataBuffer[2],RxDataBuffer[3]);
 
 if ((RxDataBuffer[0]==0x62)&(RxDataBuffer[1]==0xA8)&(RxDataBuffer[2]==0xC2)&(env_SW_Set==1))
  {
    int temp = 0;
   
//   getvalue(EnvDirectReceive,a8c2buffer);
   //write("A8C2 data:%s",a8c2buffer);
    putValue (EnvDiagSession, 0);
    
     for (temp=0;temp<9;temp++)
        {
          SWbuildversion[temp]= RxDataBuffer[temp+3];
        }
        for (temp=0;temp<5;temp++)
        {
          VariantName[temp]= RxDataBuffer[temp+12];
        }
        SeriesPKG[0] = RxDataBuffer[60];
       
        ////write("a8c2buffer[0]:%c",a8c2buffer[0]);
    putValue(EnvReadSoftwareVersion,SWbuildversion);
        //write("SWbuildversion data:%s",SWbuildversion);
    putValue(EnvReadVariantName,VariantName);
         //write("VariantName data:%s",VariantName);
    putValue(EnvReadSeriesPKG,SeriesPKG);
         //write("SeriesPKG data:%s",SeriesPKG);
        if(RxDataBuffer[75]== 0x01)
        {
          putValue(Env_Development_mode,"Enabled");
        }
        else
        {
          putValue(Env_Development_mode,"Disabled");
          
        }
        ReqDiagMsgGlobal1.dlc = 0x08;
                 ReqDiagMsgGlobal1.byte(0) = 0x02;
                 ReqDiagMsgGlobal1.byte(1) = 0x10;
                 ReqDiagMsgGlobal1.byte(2) = 0x01;
                 ReqDiagMsgGlobal1.byte(3) = 0x55;
                 ReqDiagMsgGlobal1.byte(4) = 0x55;
                 ReqDiagMsgGlobal1.byte(5) = 0x55;
                 ReqDiagMsgGlobal1.byte(6) = 0x55;
                 ReqDiagMsgGlobal1.byte(7) = 0x55;
                 output (ReqDiagMsgGlobal1);
        env_SW_Set = 0;
  }

  if((RxDataBuffer[0]==0x7F)&(RxDataBuffer[1]==0x22)&(RxDataBuffer[2]==0x31) )
  {
     //write(",fdjgbfdgkb f");
  //putValue(Env_RADAR_Info,1);
    
  
  }
  
 
    if((RxDataBuffer[0]==0x63)&&((RxDataBuffer[1]==0x01)||(RxDataBuffer[1]==0x00)))
  {
        
        write("flag=%d\n",flag);
    if(flag==1)
    { //Considered when u restart the Cfg.. to update the radar with the last variant coded values
		    putvalue(EnvDirectSend,"1001");
        flag=0;
    }
    if(RxDataBuffer[2] == 0x52 || RxDataBuffer[2] == 0x54)
    { //For the radar message update 
    
//       putvalue(E_pric_Bosch_Radar_RADAR_VARIANT_INFO_VARIANT_INFO_1_Rv,RxDataBuffer[2]);
//       putvalue(E_pric_Bosch_Radar_RADAR_VARIANT_INFO_VARIANT_INFO_2_Rv,RxDataBuffer[3]);
//       putvalue(E_pric_Bosch_Radar_RADAR_VARIANT_INFO_VARIANT_INFO_3_Rv,RxDataBuffer[4]);
//       putvalue(E_pric_Bosch_Radar_RADAR_VARIANT_INFO_VARIANT_INFO_4_Rv,RxDataBuffer[5]);
//       putvalue(E_pric_Bosch_Radar_RADAR_VARIANT_INFO_VARIANT_INFO_5_Rv,RxDataBuffer[6]);
        OSEKTL_SetUseFC(1);
      }  
   } 
  
  
  if((RxDataBuffer[0]==0x62)&(RxDataBuffer[1]==0x48)&(RxDataBuffer[2]==0xf5)&(RxDataBuffer[3]==0x01))
  {
//        putvalue(E_pric_Bosch_Radar_RADAR_VARIANT_INFO_VARIANT_INFO_1_Rv,RxDataBuffer[4]);
//        putvalue(E_pric_Bosch_Radar_RADAR_VARIANT_INFO_VARIANT_INFO_2_Rv,RxDataBuffer[5]);
//        putvalue(E_pric_Bosch_Radar_RADAR_VARIANT_INFO_VARIANT_INFO_3_Rv,RxDataBuffer[6]);
//        putvalue(E_pric_Bosch_Radar_RADAR_VARIANT_INFO_VARIANT_INFO_4_Rv,RxDataBuffer[7]);
//        putvalue(E_pric_Bosch_Radar_RADAR_VARIANT_INFO_VARIANT_INFO_5_Rv,RxDataBuffer[8]);
        OSEKTL_SetUseFC(1);
  }
  

  
  if ((RxDataBuffer[0]==0x6e)&(RxDataBuffer[1]==0x48)&(RxDataBuffer[2]==0xf5))
  {
    DirectTxDataLen = 0x3;
    TxDataBuffer[0] = 0x22;
    TxDataBuffer[1] = 0x48;
    TxDataBuffer[2] = 0xf5;
    StartDiagService( DIRECT_RQ );
  }
  
  
    if (RxDataBuffer[0]!=127) // response different than Response Pending
	    {  
              TxLength=0;
        }
     //to save the RxDataBuffer into ErrValue[] for EnvSetReadDTC
    for (i=0;i<rxCount;i++)
        {
            ErrValue[i]=RxDataBuffer[i];
            ltoa(RxDataBuffer[i], MVbuffer2, 16);
            if( strlen( MVbuffer2 ) == 1 )
        		{
        			strncat(buffer2, MVbuffer2, 500);
        			strncat(MVbuffer, buffer2, 500);
        			strncpy(buffer2, "0", 6);
        		}
        		else
        		{
        			strncat(MVbuffer, MVbuffer2, 500);
        		}
        }
    //Convert binary ErrValue[] to string ErrString[]
    FillErrString(rxCount);

    RespTime += timeNow();
    RespTime /= 100;
 write("MVbuffer = %s",MVbuffer); 
    
    //      write("DATA Ind for MPC");		//debugging
            putValue( EnvRespTime_CAN, RespTime);
            putValue( EnvRxData_CAN, RxDataBuffer, rxCount );   
        write("MVBuffer before:%s",MVbuffer);
        putValue(EnvDirectReceive,  MVbuffer);
        write("MVBuffer after:%s",MVbuffer);
	        putValue( EnvRxDataLen_CAN, rxCount );
            getvalue(EnvRxData_CAN,TxDataBuffer);
//            for (i=0;i<getvalue(EnvRxData_CAN,TxDataBuffer);i++)
//            {
//                write(" CAN %x",TxDataBuffer[i]);
//            }
        
//    if ((RxDataBuffer[0]==0x62)&(RxDataBuffer[1]==0xA8)&(RxDataBuffer[2]==0xC2))
//  {
//    int temp = 0;
//   
//   getvalue(EnvDirectReceive,a8c2buffer);
//   write("A8C2 data:%s",a8c2buffer);
//    putValue (EnvDiagSession, 0);
//    SeriesPKG[0] = a8c2buffer[57];
//     for (temp=0;temp<18;temp++)
//        {
//          SWbuildversion[temp]= a8c2buffer[temp+6];
//        }
//        for (temp=0;temp<10;temp++)
//        {
//          VariantName[temp]= a8c2buffer[temp+24];
//        }
//         for (temp=0;temp<2;temp++)
//        {
//          SeriesPKG[temp]= a8c2buffer[temp+120];
//        }
//        write("a8c2buffer[0]:%c",a8c2buffer[0]);
//    putValue(EnvReadSoftwareVersion,SWbuildversion);
//        write("SWbuildversion data:%s",SWbuildversion);
//    putValue(EnvReadVariantName,VariantName);
//         write("VariantName data:%s",VariantName);
//    putValue(EnvReadSeriesPKG,SeriesPKG);
//         write("SeriesPKG data:%s",SeriesPKG);
//  }
        EvaluateRxData( rxCount );
    	

  
 }

on busOff
{
  resetCANEx(1);
}

OSEKTL_ErrorInd(int error)
{
long FI_ID ;

    if (!OSEKTL_GetRxId())
    {	
    switch( error )
	{
		case 1: 	
			write(" Error (%d): Timeout while waiting for CF",  error );
			putValue( EnvReqStatus_CAN, "Timeout while waiting for CF" );
			putValue( EnvRespTime_CAN, OSEKTL_GetTimeoutCF() );	
		break;

		case 2: 	
			write(" Error (%d): Timeout while waiting for FC",  error ); 
			putValue( EnvReqStatus_CAN, "Timeout while waiting for FC" );
			putValue( EnvRespTime_CAN, OSEKTL_GetTimeoutFC() );			
		break;

		case 3:
		 	write(" Error (%d): Wrong Sequence Number",  error );
			putValue( EnvReqStatus_CAN, "Wrong Sequence Number" );
		break;

		case 4:
		 	write(" Error (%d): TP_DLL busy",  error ); 
			putValue( EnvReqStatus_CAN, "TP_DLL busy" );
		break;

		case 5:
		 	write(" Error (%d): Unexpected PDU",  error ); 
			putValue( EnvReqStatus_CAN, "Unexpected PDU" );
		break;

		case 6:
		 	write(" Error (%d): Timeout while trying to send a CAN frame",  error );
			putValue( EnvReqStatus_CAN, "Timeout while trying to send a CAN frame" );
		break;

		case 7:
		 	write(" Error (%d): Too many FCs: WFT Overrun",  error ); 
			putValue( EnvReqStatus_CAN, "To many flow control: WFT Overrun" );
		break;
		
		case 8:
			write(" Error (%d):Receiver buffer overflow",  error ); 
			putValue( EnvReqStatus_CAN, "Receiver buffer overflow" );
		break;

		case 9:
			write(" Error (%d): Wrong parameter",  error ); 
			putValue( EnvReqStatus_CAN, "Wrong parameter" );
		break;
		
		default: 	
			write(" Error (%d): unknown error",  error ); 
			putValue( EnvReqStatus_CAN, "unknown error" );
		break;
	}
    }

}

OSEKTL_FI_PreSend( word msgDlc[], byte data[])
{  
	int Correct_CFValue;


	if( OSEKTL_FI_IsFC())
	{
		if (getvalue(EnvFC_FalsePCIon))
		{
		 data[0]= getvalue(EnvFC_PCIValue);
		}
	}
	else
	{  //CFs False PCI
		switch (getvalue(EnvCFNr))
			{
					case 1:
						Correct_CFValue=0x21;
					break;
					case 2:
						Correct_CFValue=0x22;
					break;
					case 3:
						Correct_CFValue=0x23;
					break;
					case 4:
						Correct_CFValue=0x24;
					break;
					case 5:
						Correct_CFValue=0x25;
					break;
					case 6:
						Correct_CFValue=0x26;
					break;
					case 7:
						Correct_CFValue=0x27;
					break;
					case 8:
						Correct_CFValue=0x28;
					break;
					case 9:
						Correct_CFValue=0x29;
					break;

			}
		if (getvalue(EnvCF_FalsePCIon)&& data[0]==Correct_CFValue) 
		{	 write ("false PCI in CF  ");
 		data[0]= getvalue(EnvCF_PCIValue);
		}

  
 
	}





	
}

OSEKTL_FirstFrameIndication( long source, long target, long length) 
{ 


// Do not react to Requests from another tester (VAS-Tester...)
    if ( TxLength ==0 )
    {
      //Commented For proper variant Code after RESET...
      //OSEKTL_SetUseFC(0);
    	//write ("Request was sent from other tester, Canoe Tester is not sending  FC");

    }

    else
    { 
           	OSEKTL_SetUseFC( GetValue( EnvUseFC ) );
   //     	write ("Request was sent from CANOE, sending  FC, for TX length = %i ",TxLength);
    }

//Fault Injections 
	if (getvalue(EnvFCDoubleOn)==1)
		{	OSEKTL_FI_DoubleFC (getvalue(EnvFCNr));
			write ("FI-Double FC  Nr %d",getvalue(EnvFCNr));
		}


}

int EvaluateResponse()
{  
   int ret; 
   
   ret = 0;

   if ( RxDataBuffer[0] == 0x7F )
   {
   
      switch ( RxDataBuffer[2] ) 
      {
         case 0x10: 
            putValue (EnvReqStatus_CAN, "General reject");
         break;

         case 0x11: 
            putValue (EnvReqStatus_CAN, "Service not supported");
         break;

         case 0x12: 
            putValue (EnvReqStatus_CAN, "SubFunction Not Supported");
         break;

         case 0x13: 
            putValue (EnvReqStatus_CAN, " InCorrect Message Length-invalid Format");
         break;

         case 0x21: 
            putValue (EnvReqStatus_CAN, "Busy Repeat Request");
         break;

         case 0x22: 
            putValue (EnvReqStatus_CAN, "Conditions Not Correct");
         break;

     //    case 0x23: 
     //       putValue (EnvReqStatus_CAN, "Routine not complete");
     //    break;

         case 0x24: 
           putValue (EnvReqStatus_CAN, "Request Sequence Error");
         break;

         case 0x26: 
            putValue (EnvReqStatus_CAN, "Failure Prevents Execution of requested action");
         break;

         case 0x31: 
            putValue (EnvReqStatus_CAN, "Request Out Of Range");
         break;

         case 0x33: 
            putValue (EnvReqStatus_CAN, "Security Access Denied");
         break;

         case 0x35: 
            putValue (EnvReqStatus_CAN, "Invalid key");
         break;

         case 0x36: 
            putValue (EnvReqStatus_CAN, "Exceed number of attempts");
         break;

         case 0x37: 
            putValue (EnvReqStatus_CAN, "Time delay not expired");
         break;

         case 0x78: 
            putValue (EnvReqStatus_CAN, "Request Correctly Received-Response Pending");
            // Wait
			ret = 0; 
		 break;

      //   case 0x80: 
      //      putValue (EnvReqStatus_CAN, "Service not supported in active mode");
      //   break;

         case 0x7E: 
             putValue (EnvReqStatus_CAN, "SubFunction Not Supported In Active Diagnostic Session");
    	 break;

         case 0x7F: 
             putValue (EnvReqStatus_CAN, "Service Not Supported In Active Diagnosic Session");
    	 break;
             
         case 0x83: 
             putValue (EnvReqStatus_CAN, "Condition not correct - Engine running");
    	 break;
         
         case 0x88: 
             putValue (EnvReqStatus_CAN, "Vehicle Speed Too High");
    	 break;

         case 0x89: 
             putValue (EnvReqStatus_CAN, "Negative Response:ESP_v_Signal<= 50 km/h");
    	 break;


         default:   
            putValue (EnvReqStatus_CAN, "Negative Response: Acknowledge not defined");
         break;
         }
   }
   else
   {
     write("RxDataBuffer[0] = %x %x",RxDataBuffer[0], SId  );
      if ( RxDataBuffer[0] == ( SId + 0x40 ) )        
      {
         // Positive response
         
                 putValue (EnvReqStatus_CAN,"OK! Positive response");
    
    
    	 ret = 1; 
      }
      else                      
      {
           
           putValue (EnvReqStatus_CAN ,"Unknown response");
		 
         ret = 0; 
      }
   }

   return ( ret ); 
}

void GetDtcName (dword error,int DTC_or_historical)
{	
	char DTCText [256];
    long res;
   

    // Hole DTC Beschreibung aus Tabelle
  
    if (getValue (EnvDllRxId) == 0x7C2)
    {
       // res=GetDTCdescription_BVS(error, DTCText);
    }else{
       //  res=GetDTCdescription_Kamera(error, DTCText);
    }
  
    if(res == 0) // DTC in Tabelle nicht gefunden
    {
        snprintf( DTCText, 255,"Unknown Error: %d",error);
    }

 	if (DTC_or_historical==1)  //ReadDTC
		{
			putValue (EnvDtcName, DTCText);
            Display_DTC_MID_Name(error);   
		}  else {  // Read Historical DTCs							
	    	putValue (EnvHistDtcName, DTCText);   
		}
   
   
}

void ClearDtcDisplay (void)
{
   
   NrOfReadDTC = 0;
   CurrentDTC  = 0;

   ShowDTCs();
}

void ShowDTCs (void)
{
   char buffer[50];
   long buffer_dec;
   
   if ( CurrentDTC > NrOfReadDTC )
   {
      CurrentDTC = NrOfReadDTC;
   } 
   else if ( (CurrentDTC < 1) && (NrOfReadDTC) )
   {
      CurrentDTC = 1;
   }
   else if ( (CurrentDTC < 0) && (!NrOfReadDTC) )
   {
      CurrentDTC = 0;
   } 
   
   snprintf (buffer, 49, "%02d/%02d", CurrentDTC, NrOfReadDTC);
   putValue (EnvDtcPosition, buffer);  
   
   if ( CurrentDTC )
   {
      // DTC No
      snprintf (buffer, 49, "%06x",   errorDTC[CurrentDTC]);
      putValue (EnvDtcNr, buffer);
      // convert DTC No. from hex to dec
      snprintf (buffer, 49, "0x%06x", errorDTC[CurrentDTC]);
      buffer_dec = atol(buffer);
      putValue (EnvDtcNr_dec, buffer_dec);
      //DTC Status
      snprintf (buffer, 49, "%02x", errorStatus[CurrentDTC]);
      putValue (EnvDtcState, buffer);
      GetDtcName (errorDTC[CurrentDTC],1);
      

   }
   else
   {
      putValue (EnvDtcNr,     "----");
      putValue (EnvDtcState,  "--");
      putValue (EnvDtcName,   "----");
	  putValue( EnvEnvDataDisplay, "------"  );
   } 
}

on timer UpdateRuntime
{
	StartDiagService( GET_SYS_RUNTIME );
	SetTimer( UpdateRuntime, UpdateCycle);
}

void GetSupplier(byte Code, char Supplier[])
{
   switch ( Code )
   {
	  case 0x03: 
	  	strncpy(Supplier,"Bosch",10);
	  break; 

      default:   
	  	strncpy(Supplier,"Error!!",10);
      break; 
   }
}

EvaluateEnvData()
{
  snprintf( StringAux,99,"Environment data:                ");
  strncpy( Stringbuffer, StringAux,255);

  switch( ( (word)RxDataBuffer[2] << 8 ) | (word)RxDataBuffer[3] )
  {  

    
  
    default:
    {
    }
    break;
  }

  putValue( EnvEnvDataDisplay, Stringbuffer);

}

on envVar EnvTesterPresentOnOff
{
    if(getvalue(this))
    {
        StartDiagService( TESTER_PRESENT_ON );
    }
    else
    {
        StartDiagService( TESTER_PRESENT_OFF );
        SetControlForeColor("Anpassungen", "PrepareWriteControl", MakeRGB(255,0,0));
    }
        
        

    /* 
        if (getvalue(this))
        {    
            if (TesterPresentOnOff==0) 
            {
                StartDiagService( TESTER_PRESENT_ON );
                TesterPresentOnOff=1;
            }
        }
        else
        {
            if (TesterPresentOnOff==1) 
            {
                StartDiagService( TESTER_PRESENT_OFF );    
                TesterPresentOnOff=0;
            }
        }
    */
}

on timer TesterPresentTimer
{
  write(" from tester presetn CAN ID %x",getvalue(EnvDiagPhyTxCANIDs));
  switch (getvalue(EnvDiagPhyTxCANIDs))
    {
        case 0x18DAB5F1: 
                
                 ReqDiagMsgGlobalFun1.dlc = 0x08;
                 ReqDiagMsgGlobalFun1.byte(0) = 0x02;
                 ReqDiagMsgGlobalFun1.byte(1) = 0x3E;
                 ReqDiagMsgGlobalFun1.byte(2) = 0x80;
                 ReqDiagMsgGlobalFun1.byte(3) = 0x55;
                 ReqDiagMsgGlobalFun1.byte(4) = 0x55;
                 ReqDiagMsgGlobalFun1.byte(5) = 0x55;
                 ReqDiagMsgGlobalFun1.byte(6) = 0x55;
                 ReqDiagMsgGlobalFun1.byte(7) = 0x55;
                 output (ReqDiagMsgGlobalFun1);
                 // reStart timer
                 setTimer (TesterPresentTimer, TesterPresentTime);

        // Functional CanID 1 (CAN ID 1-13 For ECU supporting HDC_CAN)
       // ConfigTP(0x18DBEFF1, 0x18DAF1B5);

        break;

        case 0x18DAB5F2: 
                 ReqDiagMsgGlobalFun2.dlc = 0x08;
                 ReqDiagMsgGlobalFun2.byte(0) = 0x02;
                 ReqDiagMsgGlobalFun2.byte(1) = 0x3E;
                 ReqDiagMsgGlobalFun2.byte(2) = 0x80;
                 ReqDiagMsgGlobalFun2.byte(3) = 0x55;
                 ReqDiagMsgGlobalFun2.byte(4) = 0x55;
                 ReqDiagMsgGlobalFun2.byte(5) = 0x55;
                 ReqDiagMsgGlobalFun2.byte(6) = 0x55;
                 ReqDiagMsgGlobalFun2.byte(7) = 0x55;
                 output (ReqDiagMsgGlobalFun2);
                 // reStart timer
                 setTimer (TesterPresentTimer, TesterPresentTime);

        // Functional CanID 2
        //ConfigTP(0x18DBEFF2, 0x18DAF2B5);
     
        break;


        case 0x18DAB5F3: 
                 ReqDiagMsgGlobalFun3.dlc = 0x08;
                 ReqDiagMsgGlobalFun3.byte(0) = 0x02;
                 ReqDiagMsgGlobalFun3.byte(1) = 0x3E;
                 ReqDiagMsgGlobalFun3.byte(2) = 0x80;
                 ReqDiagMsgGlobalFun3.byte(3) = 0x55;
                 ReqDiagMsgGlobalFun3.byte(4) = 0x55;
                 ReqDiagMsgGlobalFun3.byte(5) = 0x55;
                 ReqDiagMsgGlobalFun3.byte(6) = 0x55;
                 ReqDiagMsgGlobalFun3.byte(7) = 0x55;
                 output (ReqDiagMsgGlobalFun3);
                 // reStart timer
                 setTimer (TesterPresentTimer, TesterPresentTime);

        // Functional CanID 3
       // ConfigTP(0x18DBEFF3, 0x18DAF3B5);
        break;



        case 0x18DAB5F4: 
                 ReqDiagMsgGlobalFun4.dlc = 0x08;
                 ReqDiagMsgGlobalFun4.byte(0) = 0x02;
                 ReqDiagMsgGlobalFun4.byte(1) = 0x3E;
                 ReqDiagMsgGlobalFun4.byte(2) = 0x80;
                 ReqDiagMsgGlobalFun4.byte(3) = 0x55;
                 ReqDiagMsgGlobalFun4.byte(4) = 0x55;
                 ReqDiagMsgGlobalFun4.byte(5) = 0x55;
                 ReqDiagMsgGlobalFun4.byte(6) = 0x55;
                 ReqDiagMsgGlobalFun4.byte(7) = 0x55;
                 output (ReqDiagMsgGlobalFun4);
                 // reStart timer
                 setTimer (TesterPresentTimer, TesterPresentTime);

        // Functional CanID 4
       // ConfigTP(0x18DBEFF4, 0x18DAF4B5);
        break;



        case 0x18DAB5F5: 
                 ReqDiagMsgGlobalFun5.dlc = 0x08;
                 ReqDiagMsgGlobalFun5.byte(0) = 0x02;
                 ReqDiagMsgGlobalFun5.byte(1) = 0x3E;
                 ReqDiagMsgGlobalFun5.byte(2) = 0x80;
                 ReqDiagMsgGlobalFun5.byte(3) = 0x55;
                 ReqDiagMsgGlobalFun5.byte(4) = 0x55;
                 ReqDiagMsgGlobalFun5.byte(5) = 0x55;
                 ReqDiagMsgGlobalFun5.byte(6) = 0x55;
                 ReqDiagMsgGlobalFun5.byte(7) = 0x55;
                 output (ReqDiagMsgGlobalFun5);
                 // reStart timer
                 setTimer (TesterPresentTimer, TesterPresentTime);

        
        break;
      
//        case 0x18DAB5F6: 
//                 ReqDiagMsgGlobalFun6.dlc = 0x08;
//                 ReqDiagMsgGlobalFun6.byte(0) = 0x02;
//                 ReqDiagMsgGlobalFun6.byte(1) = 0x3E;
//                 ReqDiagMsgGlobalFun6.byte(2) = 0x80;
//                 ReqDiagMsgGlobalFun6.byte(3) = 0x55;
//                 ReqDiagMsgGlobalFun6.byte(4) = 0x55;
//                 ReqDiagMsgGlobalFun6.byte(5) = 0x55;
//                 ReqDiagMsgGlobalFun6.byte(6) = 0x55;
//                 ReqDiagMsgGlobalFun6.byte(7) = 0x55;
//                 output (ReqDiagMsgGlobalFun6);
//                 // reStart timer
//                 setTimer (TesterPresentTimer, TesterPresentTime);

        
//        break;
//              case 0x18DAB5F7: 
//                 ReqDiagMsgGlobalFun7.dlc = 0x08;
//                 ReqDiagMsgGlobalFun7.byte(0) = 0x02;
//                 ReqDiagMsgGlobalFun7.byte(1) = 0x3E;
//                 ReqDiagMsgGlobalFun7.byte(2) = 0x80;
//                 ReqDiagMsgGlobalFun7.byte(3) = 0x55;
//                 ReqDiagMsgGlobalFun7.byte(4) = 0x55;
//                 ReqDiagMsgGlobalFun7.byte(5) = 0x55;
//                 ReqDiagMsgGlobalFun7.byte(6) = 0x55;
//                 ReqDiagMsgGlobalFun7.byte(7) = 0x55;
//                 output (ReqDiagMsgGlobalFun7);
//                 // reStart timer
//                 setTimer (TesterPresentTimer, TesterPresentTime);

        
//        break;
//              case 0x18DAB5F8:
//                 ReqDiagMsgGlobalFun8.dlc = 0x08;
//                 ReqDiagMsgGlobalFun8.byte(0) = 0x02;
//                 ReqDiagMsgGlobalFun8.byte(1) = 0x3E;
//                 ReqDiagMsgGlobalFun8.byte(2) = 0x80;
//                 ReqDiagMsgGlobalFun8.byte(3) = 0x55;
//                 ReqDiagMsgGlobalFun8.byte(4) = 0x55;
//                 ReqDiagMsgGlobalFun8.byte(5) = 0x55;
//                 ReqDiagMsgGlobalFun8.byte(6) = 0x55;
//                 ReqDiagMsgGlobalFun8.byte(7) = 0x55;
//                 output (ReqDiagMsgGlobalFun8);
//                 // reStart timer
//                 setTimer (TesterPresentTimer, TesterPresentTime);

        
//        break;
//             case 0x18DAB5F9: 
//                 ReqDiagMsgGlobalFun9.dlc = 0x08;
//                 ReqDiagMsgGlobalFun9.byte(0) = 0x02;
//                 ReqDiagMsgGlobalFun9.byte(1) = 0x3E;
//                 ReqDiagMsgGlobalFun9.byte(2) = 0x80;
//                 ReqDiagMsgGlobalFun9.byte(3) = 0x55;
//                 ReqDiagMsgGlobalFun9.byte(4) = 0x55;
//                 ReqDiagMsgGlobalFun9.byte(5) = 0x55;
//                 ReqDiagMsgGlobalFun9.byte(6) = 0x55;
//                 ReqDiagMsgGlobalFun9.byte(7) = 0x55;
//                 output (ReqDiagMsgGlobalFun9);
//                 // reStart timer
//                 setTimer (TesterPresentTimer, TesterPresentTime);

        
//        break;
//       case 0x18DAB5FA: 
//                 ReqDiagMsgGlobalFunA.dlc = 0x08;
//                 ReqDiagMsgGlobalFunA.byte(0) = 0x02;
//                 ReqDiagMsgGlobalFunA.byte(1) = 0x3E;
//                 ReqDiagMsgGlobalFunA.byte(2) = 0x80;
//                 ReqDiagMsgGlobalFunA.byte(3) = 0x55;
//                 ReqDiagMsgGlobalFunA.byte(4) = 0x55;
//                 ReqDiagMsgGlobalFunA.byte(5) = 0x55;
//                 ReqDiagMsgGlobalFunA.byte(6) = 0x55;
//                 ReqDiagMsgGlobalFunA.byte(7) = 0x55;
//                 output (ReqDiagMsgGlobalFunA);
//                 // reStart timer
//                 setTimer (TesterPresentTimer, TesterPresentTime);

        
//        break;
//          case 0x18DAB5FB: 
//                 ReqDiagMsgGlobalFunB.dlc = 0x08;
//                 ReqDiagMsgGlobalFunB.byte(0) = 0x02;
//                 ReqDiagMsgGlobalFunB.byte(1) = 0x3E;
//                 ReqDiagMsgGlobalFunB.byte(2) = 0x80;
//                 ReqDiagMsgGlobalFunB.byte(3) = 0x55;
//                 ReqDiagMsgGlobalFunB.byte(4) = 0x55;
//                 ReqDiagMsgGlobalFunB.byte(5) = 0x55;
//                 ReqDiagMsgGlobalFunB.byte(6) = 0x55;
//                 ReqDiagMsgGlobalFunB.byte(7) = 0x55;
//                 output (ReqDiagMsgGlobalFunB);
//                 // reStart timer
//                 setTimer (TesterPresentTimer, TesterPresentTime);

        
//        break;
//          case 0x18DAB5FC:
//                 ReqDiagMsgGlobalFunC.dlc = 0x08;
//                 ReqDiagMsgGlobalFunC.byte(0) = 0x02;
//                 ReqDiagMsgGlobalFunC.byte(1) = 0x3E;
//                 ReqDiagMsgGlobalFunC.byte(2) = 0x80;
//                 ReqDiagMsgGlobalFunC.byte(3) = 0x55;
//                 ReqDiagMsgGlobalFunC.byte(4) = 0x55;
//                 ReqDiagMsgGlobalFunC.byte(5) = 0x55;
//                 ReqDiagMsgGlobalFunC.byte(6) = 0x55;
//                 ReqDiagMsgGlobalFunC.byte(7) = 0x55;
//                 output (ReqDiagMsgGlobalFunC);
//                 // reStart timer
//                 setTimer (TesterPresentTimer, TesterPresentTime);

        
//        break;
//             case 0x18DAB5FD: 
//                 ReqDiagMsgGlobalFunD.dlc = 0x08;
//                 ReqDiagMsgGlobalFunD.byte(0) = 0x02;
//                 ReqDiagMsgGlobalFunD.byte(1) = 0x3E;
//                 ReqDiagMsgGlobalFunD.byte(2) = 0x80;
//                 ReqDiagMsgGlobalFunD.byte(3) = 0x55;
//                 ReqDiagMsgGlobalFunD.byte(4) = 0x55;
//                 ReqDiagMsgGlobalFunD.byte(5) = 0x55;
//                 ReqDiagMsgGlobalFunD.byte(6) = 0x55;
//                 ReqDiagMsgGlobalFunD.byte(7) = 0x55;
//                 output (ReqDiagMsgGlobalFunD);
//                 // reStart timer
//                 setTimer (TesterPresentTimer, TesterPresentTime);

        
//        break;
     

    }
 

} 

on timer TesterPresentTimeOutTimer
{
   write (" tester present timer expired - switch off diagnostics");
   putValue (EnvDiagOnOff, 0);
}

on envVar EnvDiagSession
{
//    if (!getvalue(EnvBVSDPC))
//    {
        if (getvalue(this))
        {
            if (DiagSession==0)
            {
                StartDiagService( DIAG_SESSION_ON );
                putvalue(EnvTesterPresentOnOff,1);
                DiagSession=1;
            }
        }
        else
        {
            if (DiagSession==1)
            {
                putvalue(EnvTesterPresentOnOff,0);
                DiagSession=0;
            }
        }
//    }
        
}

on preStart
{
   /*if(0!= ReadDTCTableFile_BVS("c:\\Kamera.csv"))
        write("Fehler beim Lesen der CSV-Datei f�r BVS");*/
	char absPath[256];
  //for GEN3 Sec
  char DTC_File_Path[250];
  char absPathsecurity[256];
//   	getAbsFilePath("\\pc_mpc2_models\\Kamera.csv", absPath, 256);
// 
// 
//  // 	if(0!= ReadDTCTableFile_Kamera(absPath))
//    {
//        getAbsFilePath("\\pc_mpc2_model\\Kamera.csv", absPath, 256);
//   //     ReadDTCTableFile_Kamera(absPath);
//    }
    
    //write("Fehler beim Lesen der CSV-Datei f�r Kamera");

    
    //FOr GEN3sec
    
//  getAbsFilePath("\\vs_models\\ECU_Unlock_Security.xml", absPathsecurity, 256);
//  write("ECU_Unlock_Security.xml=%s",absPathsecurity);
//  ParseSecurityXML(absPathsecurity);
   
    
    //C:\\\\CANFD\\MY22_Honda_Gen3\\cs_honda\\cs_honda_dbcs\\ECU_Unlock_Security.xml
  //  C:\Users\ENS6KOR\Desktop\CANFD\MY22_Honda_Gen3\cs_honda\cs_honda_dbcs\
//  if(0!=  ReadDTCTableFile_Kamera(absPath))
//  {
//  write("Error reading CSV file!!!");
//  }  
    
}


on start
{   // putValue(voltage_input, 0); 
//  float fVoltageVal;
  
  
    byte buffer[1]={0xFF};
  //  flag=1;
    //ConfigTP();
//    fVoltageVal = 12;
//    SetVoltage(fVoltageVal);
//    ConfigTP(0x18DAB5F1, 0x18DAF1B5);
    ConfigTP(0x18DAB0F1, 0x18DAF1B0);

       // Default Suche nach DTC 000124
                putValue ( EnvDtcLookForInEm , "000124");

      write("SP_EOLcode = %s",SP_EOLcode);        
    
    // working EOL Calibration String that can be used to test the EOL-Kalibrierung
    putValue(EnvEOLString, "2e25f4840f9a0fc308d8089c08b4088c192c47181630192c35e81630192c47180f50192c35e80f50"); 
    putValue(Env2E_extrinsic, "2e09b74e204e204e2004b0"); 

    //MI
 /*   DirectTxDataLen = 0x2;
    TxDataBuffer[0] = 0x10;
    TxDataBuffer[1] = 0x01;
    Radar_start=1;
    StartDiagService( DIRECT_RQ );*/
    
     
        
      
//    DirectTxDataLen = 0x3;
//    TxDataBuffer[0] = 0x22;
//    TxDataBuffer[1] = 0x48;  //There is no variant Coding yet for MY22
//    TxDataBuffer[2] = 0xf5;
//    StartDiagService( DIRECT_RQ );
   
    //For GEN3 Sec
      DirectCounter = 0;
  defaultsec[0] = 0x61;
  putValue(Env_Security_SubFunction,defaultsec);
  defaultsec[0] = 0x01;
 
    
//EPS Signals setting for Making Camera error free
    putValue(E_pubc_EPS_EPS_1AB_EPS_VARIANT_FLAG_Pv,1);
    putValue(E_pubc_EPS_EPS_14A_EPS_STR_ANGLE_Pv,0);
    putValue(E_pubc_EPS_EPS_14A_EPS_STR_ANGLE_SW_Pv,0);
    putValue(E_pubc_EPS_EPS_14A_EPS_STR_SPEED_Pv,0);
    putValue(E_pubc_EPS_EPS_18F_EPS_STEERING_TORQUE_Pv,0);
    putValue(E_pubc_EPS_EPS_18F_EPS_MOTOR_ROTATING_SPEED_Pv,0);
    
    
   //Update for MaxHold Resim My28
   
    setTimer(Wait_diag,550);
//    setTimer(Wait_on,108000);
    
    //Hanlde during log IG on off
//    setTimer(Wait_off, 30441.782);  //#2_100k
//    setTimer(Wait_off, 13303.727);  //#2_130km
//    setTimer(Wait_off, 25549.992);  //#7_1_N1    
//    setTimer(Wait_off, 37371.393);  //#7_1_N3
//    setTimer(Wait_off, 40320.774);  //#7_2_N1
//    setTimer(Wait_off, 35280.488);  //#7_2_N2
//    setTimer(Wait_off, 33355.294);  //#7_2_N3
//    setTimer(Wait_off, 32854.853);  //#7_4_N1
//    setTimer(Wait_off, 32256.956);  //#8_1_N3
    igResetIndex = 0;
    if (igResetEventCount > 0)
    {
      setTimer(Wait_off, (long)(igOffDelayMs[igResetIndex] + 0.5));
    }
//    setTimer(Wait_off, 32872.619);  //#8_2_N2
//    setTimer(Wait_off, 25401.468);  //#8_2_N3
//    setTimer(Wait_off, 47616.487);  //#9_1
//    setTimer(Wait_off, 55583.698);  //#10_1_N1
//    setTimer(Wait_off, 111691.914); //#15_N1
//    setTimer(Wait_off, 29559.968);  //#15_N2
//    setTimer(Wait_off, 35640.519);  //#17
//    setTimer(Wait_off, 65278.449);  //#20,21_1
 
    
    
    //Turn off ECU
//    setTimer(Wait_off, 610000);

    
}


on timer Wait_diag
{
  //Update for MaxHold Resim My28
  DiagSession = 0;                        // reset guard so session request is always sent
  putvalue(EnvDiagSession,1);             // step 1: send 10 03 (extended session)
  putvalue(EnvLogInUnlockTypeFour,0);     // reset so handler fires reliably in step 2
  setTimer(WaitForextendedsession,50);   // step 2: fire unlock after 100 ms delay
}
on timer Wait_on
{  
  // IP Toellner control
  sysExec("C:\\FSI\\FSI.exe","-c power -cmd on");
  setTimer(Wait_diag,1000);  
  igResetIndex++;
  if (igResetIndex < igResetEventCount)
  {
    setTimer(Wait_off, (long)(igOffDelayMs[igResetIndex] + 0.5));
  }
  }
  
on timer Wait_off
  { 
  // IP Toellner control
  sysExec("C:\\FSI\\FSI.exe","-c power -cmd off");
  putvalue(EnvDiagSession,0);
//  setTimer(Wait_on, 4007.228); //#2_100k
//  setTimer(Wait_on, 4006.401); //#2_130km
//  setTimer(Wait_on, 3205.828); //#7_1_N1    
//  setTimer(Wait_on, 3205.679); //#7_1_N3
//  setTimer(Wait_on, 3305.42);  //#7_2_N1
//  setTimer(Wait_on, 3207.327); //#7_2_N2
//  setTimer(Wait_on, 3406.327); //#7_2_N3
//  setTimer(Wait_on, 3304.808); //#7_4_N1
//  setTimer(Wait_on, 3306.24);  //#8_1_N3
  if (igResetIndex < igResetEventCount)
  {
    setTimer(Wait_on, (long)(igOnDelayMs[igResetIndex] + 0.5));
  }
//  setTimer(Wait_on, 3303.882); //#8_2_N2
//  setTimer(Wait_on, 3806.494); //#8_2_N3
//  setTimer(Wait_on, 4308.124); //#9_1
//  setTimer(Wait_on, 3406.58);  //#10_1_N1
//  setTimer(Wait_on, 3649.585); //#15_N1
//  setTimer(Wait_on, 3496.114); //#15_N2
//  setTimer(Wait_on, 9946.445); //#17
//  setTimer(Wait_on, 5009.771); //#20,21_1
  }


on envVar EnvRxData_CAN
{
	if( DirectCounter == 1 )
		{
			ReceiveBufferLength =getValue(this, ReceiveBuffer);
			MyEvaluateResponse();
			DirectCounter = 0;
		}
}

on envVar Env_Security_DynamicButton 
{
  DynamicKeySend();
}

on envVar Env_Security_DynamicInput
{
  DynamicKeySend();
}



on envVar EnvDllTxId

{ 	OSEKTL_SetTxId( GetValue( EnvDllTxId ) );
	//write("TX Id: %X",  OSEKTL_GetTxId() );		//debugging
}

on envVar EnvDllRxId
{	OSEKTL_SetRxId( GetValue( this ) );
	//write("RX Id: %X",  OSEKTL_GetRxId() );    	//debugging

}

on envVar EnvDllSTMin
{
	OSEKTL_SetSTMIN(getvalue(this));
	//write("STmin: %d",OSEKTL_GetSTMIN() );	//debugging




}

on envVar EnvDllBlockSize

{
	OSEKTL_SetBS(getvalue(this));
	write("BS: %d",OSEKTL_GetBS() );

}

on envVar EnvECUAdress
{
	write("Atention, ECU Adress has been changed!");    

}

on envVar EnvFCDelay
{
	
	OSEKTL_SetFCDelay(getValue(this));
}

on envVar EnvTransfer
{
	TxLength = getValue(this);
}

on envVar EnvUseFC

{
	OSEKTL_SetUseFC(getvalue(this));

	write("EnvUseFC: %d",OSEKTL_IsUseFC() );



}

on envVar EnvWaitingState
{
  OSEKTL_SetWaiting(getValue(this));
write ("Tester sends wait = %d",OSEKTL_GetWaiting());
}

void ConfigTP(long TxID, long RxID)
{

  OSEKTL_UseExtId( 1);  //Use 29 bit Extended addresing on CAN

	OSEKTL_SetNrmlMode();

	OSEKTL_FI_Enable(); //Enable Fault Injection for Transport Layer Tests

	// Normal Addressing
	OSEKTL_SetTxId( TxID );
	//write("TX Id: %X",  OSEKTL_GetTxId() );	//debugging

	OSEKTL_SetRxId( RxID );
	//write("RX Id: %X",  OSEKTL_GetRxId() );	//debugging    

	// Flow Control
	OSEKTL_SetBS( GetValue( EnvDllBlockSize ) );
	//write("BS: %d",OSEKTL_GetBS() );		//debugging

	OSEKTL_SetSTMIN( GetValue( EnvDllSTMin ) );
	//write("STmin: %d",OSEKTL_GetSTMIN() );	//debugging

	OSEKTL_SetUseFC( GetValue( EnvUseFC ) );
	//write("FC timeout: %d",OSEKTL_GetTimeoutFC() );	//debugging

//	PutValue( EnvCAN, SEND_CAN );
	OSEKTL_SetCAN( 1 );


OSEKTL_Set0Pattern(0x55);
OSEKTL_Set0Padding( );
  
  
}

on envVar EnvDiagTxDefaultValues
{

//TxDataBuffer = 


switch (getvalue(EnvDiagTxDefaultValues))
{
    case 0x2: 
    // SoftwareVersionNumber
    TxDataBuffer_temp[0]=0x22;
    TxDataBuffer_temp[1]=0xf1;
    TxDataBuffer_temp[2]=0x89;
    putValue( EnvTxData_1, TxDataBuffer_temp, 3 );
    break;

    case 0x1: 
    // ECUHardwareNumber
    TxDataBuffer_temp[0]=0x22;
    TxDataBuffer_temp[1]=0xf1;
    TxDataBuffer_temp[2]=0x91;
    putValue( EnvTxData_1, TxDataBuffer_temp, 3 );
    break;

    case 0x3: 
    // VWSparePartNumber
    TxDataBuffer_temp[0]=0x22;
    TxDataBuffer_temp[1]=0xf1;
    TxDataBuffer_temp[2]=0x87;
    putValue( EnvTxData_1, TxDataBuffer_temp, 3 );
    break;

    case 0x4: 
    // VW ECU Serial Number
    TxDataBuffer_temp[0]=0x22;
    TxDataBuffer_temp[1]=0xf1;
    TxDataBuffer_temp[2]=0x8C;
    putValue( EnvTxData_1, TxDataBuffer_temp, 3 );
    break;

    case 0x5: 
    // SystemNameOrEngineType
    TxDataBuffer_temp[0]=0x22;
    TxDataBuffer_temp[1]=0xf1;
    TxDataBuffer_temp[2]=0x97;
    putValue( EnvTxData_1, TxDataBuffer_temp, 3 );
    break;

    case 0x6: 
    // ASAM/ODXFileIdentifier 
    TxDataBuffer_temp[0]=0x22;
    TxDataBuffer_temp[1]=0xf1;
    TxDataBuffer_temp[2]=0x9E;
    putValue( EnvTxData_1, TxDataBuffer_temp, 3 );
    break;

    case 0x7: 
    // ASAM/ODXFileVersion
    TxDataBuffer_temp[0]=0x22;
    TxDataBuffer_temp[1]=0xf1;
    TxDataBuffer_temp[2]=0xA2;
    putValue( EnvTxData_1, TxDataBuffer_temp, 3 );
    break;

    case 0x8: 
    // VWECUHardwareVersionNumber
    TxDataBuffer_temp[0]=0x22;
    TxDataBuffer_temp[1]=0xf1;
    TxDataBuffer_temp[2]=0xA3;
    putValue( EnvTxData_1, TxDataBuffer_temp, 3 );
    break;

    case 0x9: 
    // VWWorkshopSystemName
    TxDataBuffer_temp[0]=0x22;
    TxDataBuffer_temp[1]=0xf1;
    TxDataBuffer_temp[2]=0xAA;
    putValue( EnvTxData_1, TxDataBuffer_temp, 3 );
    break;

    case 0xA: 
    // VW Variant CodingValue
    TxDataBuffer_temp[0]=0x22;
    TxDataBuffer_temp[1]=0x06;
    TxDataBuffer_temp[2]=0x00;
    putValue( EnvTxData_1, TxDataBuffer_temp, 3 );
    break;

    case 0xB: 
    // VWTesterCodingInformation
    TxDataBuffer_temp[0]=0x22;
    TxDataBuffer_temp[1]=0x06;
    TxDataBuffer_temp[2]=0x01;
    putValue( EnvTxData_1, TxDataBuffer_temp, 3 );
    break;

    case 0xC: 
    // Anzahl der Programmierversuche
    TxDataBuffer_temp[0]=0x22;
    TxDataBuffer_temp[1]=0x04;
    TxDataBuffer_temp[2]=0x07;
    putValue( EnvTxData_1, TxDataBuffer_temp, 3 );
    break;

    case 0xD: 
    // Anzahl der Parametrierversuche
    TxDataBuffer_temp[0]=0x22;
    TxDataBuffer_temp[1]=0x04;
    TxDataBuffer_temp[2]=0x09;
    putValue( EnvTxData_1, TxDataBuffer_temp, 3 );
    break;

    case 0xE: 
    // Anz. erfolg. Parametrierversuche
    TxDataBuffer_temp[0]=0x22;
    TxDataBuffer_temp[1]=0x04;
    TxDataBuffer_temp[2]=0x0A;
    putValue( EnvTxData_1, TxDataBuffer_temp, 3 );
    break;

    case 0xF: 
    // max. Anz. d. m�glichen Updateprogrammierungen
    TxDataBuffer_temp[0]=0x22;
    TxDataBuffer_temp[1]=0x04;
    TxDataBuffer_temp[2]=0x0F;
    putValue( EnvTxData_1, TxDataBuffer_temp, 3 );
    break;

    case 0x10: 
    // Identifikation der angeschlossenen Komponenten
    TxDataBuffer_temp[0]=0x22;
    TxDataBuffer_temp[1]=0x2a;
    TxDataBuffer_temp[2]=0x30;
    putValue( EnvTxData_1, TxDataBuffer_temp, 3 );
    break;

    case 0x11: 
    // Werkstattcode u. Datum d. letzten Updateprog. der SW Module
    TxDataBuffer_temp[0]=0x22;
    TxDataBuffer_temp[1]=0xf1;
    TxDataBuffer_temp[2]=0x5B;
    putValue( EnvTxData_1, TxDataBuffer_temp, 3 );
    break;

    case 0x12: 
    // Baugruppen und Seriennummer
    TxDataBuffer_temp[0]=0x22;
    TxDataBuffer_temp[1]=0xf1;
    TxDataBuffer_temp[2]=0x79;
    putValue( EnvTxData_1, TxDataBuffer_temp, 3 );
    break;

    case 0x13: 
    // Datum der letzten Codierung
    TxDataBuffer_temp[0]=0x22;
    TxDataBuffer_temp[1]=0xf1;
    TxDataBuffer_temp[2]=0x7B;
    putValue( EnvTxData_1, TxDataBuffer_temp, 3 );
    break;

    case 0x14: 
    // Fazit Identifikation
    TxDataBuffer_temp[0]=0x22;
    TxDataBuffer_temp[1]=0xf1;
    TxDataBuffer_temp[2]=0x7C;
    putValue( EnvTxData_1, TxDataBuffer_temp, 3 );
    break;

    case 0x15: 
    // Identifikation der Parametrierung
    TxDataBuffer_temp[0]=0x22;
    TxDataBuffer_temp[1]=0xf1;
    TxDataBuffer_temp[2]=0x82;
    putValue( EnvTxData_1, TxDataBuffer_temp, 3 );
    break;

    case 0x16: 
    // Diagnosemodus
    TxDataBuffer_temp[0]=0x22;
    TxDataBuffer_temp[1]=0xf1;
    TxDataBuffer_temp[2]=0x86;
    putValue( EnvTxData_1, TxDataBuffer_temp, 3 );
    break;

    case 0x17: 
    // Herstellungsdatum
    TxDataBuffer_temp[0]=0x22;
    TxDataBuffer_temp[1]=0x04;
    TxDataBuffer_temp[2]=0x8B;
    putValue( EnvTxData_1, TxDataBuffer_temp, 3 );
    break;

    case 0x18: 
    // Fahrgestellnummer
    TxDataBuffer_temp[0]=0x22;
    TxDataBuffer_temp[1]=0xf1;
    TxDataBuffer_temp[2]=0x90;
    putValue( EnvTxData_1, TxDataBuffer_temp, 3 );
    break;

    case 0x19: 
    // Werkstattcode der Anpassung
    TxDataBuffer_temp[0]=0x22;
    TxDataBuffer_temp[1]=0xf1;
    TxDataBuffer_temp[2]=0x9A;
    putValue( EnvTxData_1, TxDataBuffer_temp, 3 );
    break;

    case 0x1A: 
    // Datum der letzten Anpassung
    TxDataBuffer_temp[0]=0x22;
    TxDataBuffer_temp[1]=0xf1;
    TxDataBuffer_temp[2]=0x9B;
    putValue( EnvTxData_1, TxDataBuffer_temp, 3 );
    break;

    case 0x1B: 
    // Teilnummer des Parametersatzes
    TxDataBuffer_temp[0]=0x22;
    TxDataBuffer_temp[1]=0xf1;
    TxDataBuffer_temp[2]=0xA0;
    putValue( EnvTxData_1, TxDataBuffer_temp, 3 );
    break;

    case 0x1C: 
    // Version des Parametersatzes
    TxDataBuffer_temp[0]=0x22;
    TxDataBuffer_temp[1]=0xf1;
    TxDataBuffer_temp[2]=0xA1;
    putValue( EnvTxData_1, TxDataBuffer_temp, 3 );
    break;

    case 0x1D: 
    // Fahrzeugausstattungscode
    TxDataBuffer_temp[0]=0x22;
    TxDataBuffer_temp[1]=0xf1;
    TxDataBuffer_temp[2]=0xA4;
    putValue( EnvTxData_1, TxDataBuffer_temp, 3 );
    break;

    case 0x1E: 
    // Werkstattcode der Codierung
    TxDataBuffer_temp[0]=0x22;
    TxDataBuffer_temp[1]=0xf1;
    TxDataBuffer_temp[2]=0xA5;
    putValue( EnvTxData_1, TxDataBuffer_temp, 3 );
    break;

    case 0x1F: 
    // Werkstattcode der Parametrierung
    TxDataBuffer_temp[0]=0x22;
    TxDataBuffer_temp[1]=0xf1;
    TxDataBuffer_temp[2]=0xA8;
    putValue( EnvTxData_1, TxDataBuffer_temp, 3 );
    break;

    case 0x20: 
    // Datum der Parametrierung
    TxDataBuffer_temp[0]=0x22;
    TxDataBuffer_temp[1]=0xf1;
    TxDataBuffer_temp[2]=0xA9;
    putValue( EnvTxData_1, TxDataBuffer_temp, 3 );
    break;

    case 0x21: 
    // Versionen der Softwaremodule
    TxDataBuffer_temp[0]=0x22;
    TxDataBuffer_temp[1]=0xf1;
    TxDataBuffer_temp[2]=0xAB;
    putValue( EnvTxData_1, TxDataBuffer_temp, 3 );
    break;

    case 0x22: 
    // Anzahl der m�glichen Zugriffsberechtigungen
    TxDataBuffer_temp[0]=0x22;
    TxDataBuffer_temp[1]=0xf1;
    TxDataBuffer_temp[2]=0xAE;
    putValue( EnvTxData_1, TxDataBuffer_temp, 3 );
    break;

    case 0x23: 
    // Status der Programmierbarkeit
    TxDataBuffer_temp[0]=0x22;
    TxDataBuffer_temp[1]=0xf1;
    TxDataBuffer_temp[2]=0xDF;
    putValue( EnvTxData_1, TxDataBuffer_temp, 3 );
    break;

    case 0x24: 
    // Konsistenz der EEPROM Daten
    TxDataBuffer_temp[0]=0x22;
    TxDataBuffer_temp[1]=0xf1;
    TxDataBuffer_temp[2]=0xE0;
    putValue( EnvTxData_1, TxDataBuffer_temp, 3 );
    break;

    case 0x25: 
    // Bauzustandsdokumentation
    TxDataBuffer_temp[0]=0x22;
    TxDataBuffer_temp[1]=0xf1;
    TxDataBuffer_temp[2]=0xAC;
    putValue( EnvTxData_1, TxDataBuffer_temp, 3 );
    break;

    case 0x0: 
    // Empty Box
    putValue( EnvTxData_1, emptyString, 0 );
    break;
}


}

on envVar EnvClearBuffer_CAN
{
    if(getValue(this)){
        putvalue(EnvRxData_CAN,emptyString,0);
    }
}

on timer readDtcTimer
{
    int i;
    readTimeValue+=CNTR_VALUE;

    if (readTimeValue < 1000)   //try to read until 1000ms
    {
        //putValue(EnvDirectSend,readString);
		TxLength = (requestSize - 1)/2;
        for (i=0; i<TxLength; i++) TxDataBuffer[i]=readRequest[i];
        TransmitTxBuffer();

        strncpy(DTCValue,ErrString,strlen(ErrString)+1);
        //write("At %f DTCValue=%s",timeNowFloat()/100000,DTCValue);

        // if NOT "Busy Repeat Request", NOT "OK", NOT "Response Pending"
        if ( strncmp(DTCValue,"7f1921",6)!=0 &&     
             strncmp(DTCValue,"54",2)    !=0 &&
             strncmp(DTCValue,"7f1978",6)!=0 &&
             strlen(DTCValue)            !=0 )      
        {
            putValue(EnvErrValueOutput,DTCValue);
        } 
        else
        {
            //else (if "Busy...") do nothing
        }

        setTimer(readDtcTimer,CNTR_VALUE);
    }
    else  // time elapsed
    {
        cancelTimer(readDtcTimer);
        if (getValue(EnvErrValueOutput,DTCValue)==0)
        {
            putValue(EnvErrValueOutput,"No answer received.");
        }

        //syncronise the environmental variables
        putValue(EnvErrValueOutput,DTCValue);
        write("***At %f EnvErrValueOutput= %s",timeNowFloat()/100000,DTCValue);

    }

}

FillErrString (int length)
{
        //to create string representation of (bin)ErrValue[] in (char)ErrString[]

        char temp[3];
        int i;
        strncpy(ErrString,"",0);
        if (length!=0)
        {
        for (i=0;i<length;i++) 
            {
            strncpy(tempString,"",0);
            ltoa(ErrValue[i],temp,16);
            if (strlen(temp)==1) strncpy(tempString,"0",2);
            strncat(tempString,temp,(strlen(tempString)+strlen(temp))+1);
            //if (i<10) write("%d.%s->%s",i,temp,tempString);
            strncat(ErrString,tempString,strlen(tempString)+strlen(ErrString)+1);
            }
        length=0;
        //write("***At %f ErrString= %s",timeNowFloat()/100000,ErrString);
        }


}

on envVar EnvLogIn106A3
{

   if ( getValue (this) )
   {
    
     setTimer(FingerPrint,200);
      whichlogin=1;
     putvalue(EnvLogIn106A3,0); // Reset Value for next use
      
   }
  

   
}

on envVar EnvLogIn4E87
{

   if ( getValue (this) )
   {
    
     setTimer(FingerPrint,200);
     whichlogin=2;
     putvalue(EnvLogIn4E87,0); // Reset Value for next use
      
   }
    

}

on timer FingerPrint
{
StartDiagService( FINGERPRINT );
}

on timer SeednKeyReq
{
StartDiagService( SEEDNKEYREQUEST );
}

on timer ProgDate
{
StartDiagService( PROGDATE );
}

on envVar EnvRBEOL
{
   
   if ( getValue (this) )
   {
        whichlogin=4;
        StartDiagService( SEEDNKEYRBEOLREQUEST );
        StartDiagService( SEEDNKEYRBOLREQUESTWRITEKEY );
        putvalue(EnvRBEOL,0); // Reset Value for next use
    }
}

on envVar EnvLogInReprog
{


   if ( getValue (this) )
   {
        whichlogin=3;
       StartDiagService( SEEDNKEYREPROGREQUEST );
       putvalue(EnvLogInReprog,0); // Reset Value for next use
   }
  
      
   

}

on envVar EnvActPMode
{
    if ( getValue (this) )
    {
        StartDiagService( P_MODE_ACT_P1 ); //send part 1
        setTimer(ActPMode,200); //wait and send part2
        
        Putvalue(EnvActPMode,0); // Reset Value for next use
    }
}

on envVar EnvSetReadDTC
{
    int i;

    getValue(this,readString);

    if (strlen(readString)!=0) {

        //initialization
        requestSize = getValueSize(EnvSetReadDTC);
        strncpy(DTCValue,"",255);
        readTimeValue=0;
        putValue(EnvErrValueOutput,"");
        for (i=0;i<2048;i++) ErrValue[i]=0;
        write("***At %fs (timer=%ims) request= %s",timeNowFloat()/100000,CNTR_VALUE,readString);

        //start timer at first time
        setTimer(readDtcTimer,CNTR_VALUE);

    } //end if
    //putValue(EnvDirectSend,readString);

	//getValue(EnvSetReadDTC,readString);
	if( strlen(readString) == 0 )
	{
		//write("Variable neu initialisiert");
		//putValue(EnvSendBuffer_1,0);
	}
	else
	{
		strncpy(tempString, "0x",3);

		for(i=0; i<= requestSize-3; i+=2)
		{
			tempString[2] = readString[i];
			tempString[3] = readString[i+1];
			tempString[4] = 0;
			readRequest[i/2] = atol( tempString );
		}
		//putValue(EnvTxData_1, TransmitBuffer, length);
		//putValue(EnvTransfer, length);
		//putValue(EnvSendBuffer_1,1);

		TxLength = (requestSize - 1)/2;
        for (i=0; i<TxLength; i++) TxDataBuffer[i]=readRequest[i];
        TransmitTxBuffer();
	}

    putValue(EnvSetReadDTC,"");

}

on envVar EnvFuncRequest
{
	char buffer[201];
	char buffer2[201]="0x";
  	int size, length,i;
 

    switch (getvalue(EnvDiagFuncTxCANIDs))
    {
        case 0x18DBEFF1: 

        // Functional CanID 1 (CAN ID 1-13 For ECU supporting HDC_CAN)
        ConfigTP(0x18DBEFF1, 0x18DAF1B5);

        break;

        case 0x18DBEFF2: 

        // Functional CanID 2
        ConfigTP(0x18DBEFF2, 0x18DAF2B5);
        break;


        case 0x18DBEFF3: 

        // Functional CanID 3
        ConfigTP(0x18DBEFF3, 0x18DAF3B5);
        break;



        case 0x18DBEFF4: 

        // Functional CanID 4
        ConfigTP(0x18DBEFF4, 0x18DAF4B5);
        break;



        case 0x18DBEFF5: 

        // Functional CanID 5
        ConfigTP(0x18DBEFF5, 0x18DAF5B5);
        break;



        case 0x18DBEFF6: 

        // Functional CanID 6
        ConfigTP(0x18DBEFF6, 0x18DAF6B5);
        break;


        case 0x18DBEFF7: 

        // Functional CanID 7
        ConfigTP(0x18DBEFF7, 0x18DAF7B5);
        break;



        case 0x18DBEFF8: 

        // Functional CanID 8
        ConfigTP(0x18DBEFF8, 0x18DAF8B5);
        break;



        case 0x18DBEFF9: 

        // Functional CanID 9
        ConfigTP(0x18DBEFF9, 0x18DAF9B5);
        break;




        case 0x18DBEFFA: 

        // Functional CanID 10
        ConfigTP(0x18DBEFFA, 0x18DAFAB5);
        break;



        case 0x18DBEFFB: 

        // Functional CanID 11
        ConfigTP(0x18DBEFFB, 0x18DAFBB5);
        break;



        case 0x18DBEFFC: 

        // Functional CanID 12
        ConfigTP(0x18DBEFFC, 0x18DAFCB5);
        break;



        case 0x18DBEFFD: 

        // Functional CanID 13
        ConfigTP(0x18DBEFFD, 0x18DAFDB5);
        break;



        case 0x18DBBFF1: 

        // Functional CanID 14 (CAN ID 14-26 For ECU supporting HDC_CAN)
        ConfigTP(0x18DBBFF1, 0x18DAF1B5);

        break;

        case 0x18DBBFF2: 

        // Functional CanID 15
        ConfigTP(0x18DBBFF2, 0x18DAF2B5);
        break;


        case 0x18DBBFF3: 

        // Functional CanID 16
        ConfigTP(0x18DBBFF3, 0x18DAF3B5);
        break;



        case 0x18DBBFF4: 

        // Functional CanID 17
        ConfigTP(0x18DBBFF4, 0x18DAF4B5);
        break;



        case 0x18DBBFF5: 

        // Functional CanID 18
        ConfigTP(0x18DBBFF5, 0x18DAF5B5);
        break;



        case 0x18DBBFF6: 

        // Functional CanID 19
        ConfigTP(0x18DBBFF6, 0x18DAF6B5);
        break;


        case 0x18DBBFF7: 

        // Functional CanID 20
        ConfigTP(0x18DBBFF7, 0x18DAF7B5);
        break;



        case 0x18DBBFF8: 

        // Functional CanID 21
        ConfigTP(0x18DBBFF8, 0x18DAF8B5);
        break;



        case 0x18DBBFF9: 

        // Functional CanID 22
        ConfigTP(0x18DBBFF9, 0x18DAF9B5);
        break;




        case 0x18DBBFFA: 

        // Functional CanID 23
        ConfigTP(0x18DBBFFA, 0x18DAFAB5);
        break;



        case 0x18DBBFFB: 

        // Functional CanID 24
        ConfigTP(0x18DBBFFB, 0x18DAFBB5);
        break;



        case 0x18DBBFFC: 

        // Functional CanID 25
        ConfigTP(0x18DBBFFC, 0x18DAFCB5);
        break;



        case 0x18DBBFFD: 

        // Functional CanID 26
        ConfigTP(0x18DBBFFD, 0x18DAFDB5);
        break;



    }
  
  getValue( EnvFuncRequest, buffer);
  size=getValueSize( EnvFuncRequest );

    

   if (size >2)   // String not empty, 1Byte minimum
    {  
	    for(i=0; i<= size-3; i+=2)
	    {
		    buffer2[2] = buffer[i];
		    buffer2[3] = buffer[i+1];
		    buffer2[4] = 0;
		    //ReqDiagMsgGlobal.byte(1+i/2) = atol( buffer2 );
            TxDataBuffer[i/2] = atol( buffer2 );
       
	    }
	    TxLength = (size - 1)/2;
        OSEKTL_DataReq( TxDataBuffer, TxLength ); 
    
//	    ReqDiagMsgGlobal.byte(0)=length;
//	    output(ReqDiagMsgGlobal);
      putvalue (EnvFuncRequest,"");
    	putValue( EnvRxData_CAN,emptyString,0);
        putValue(EnvRxDataLen_CAN,0);
      write("MVBuffer delete:%s",MVbuffer);
      putvalue (EnvDirectReceive,""); // delete old value from receive   
 

    }

}

on envVar Env_Get_Signal
{

    char temp[255];
    char numChar[10];
    float value;

    getValue(this,temp);

    if (strlen(temp)>0) {

        //The getSignal(char[]) function needs CANoe7.1 or higher
        value=getSignal(temp);
        ltoa(value,numChar,10);

        putValue(Env_Get_Signal_Result,numChar);
        putValue(Env_Get_Signal,"");
    }


}

on envVar Env_Get_Signal_NotNull
{
	char temp[255];
    char numChar[10];
    float value;

    getValue(this,temp);

    if (strlen(temp) > 0) {

        //The 'getSignal(char[])' function works only with CANoe7.1 or higher
        value=getSignal(temp);
        
		if (0 != value)	{
			
			putValue(Env_Get_Signal_NotNull_Result,"1");
        }

		else {
		
			putValue(Env_Get_Signal_NotNull_Result,"0");
        }

		putValue(Env_Get_Signal_NotNull,"");
		
    }

}







on envVar Env_Compare_Signal_2
{

    char temp_1[255];
    char temp_2[255];
    char numChar[10];
    float value_1;
    float value_2;

    getValue(Env_Compare_Signal_1,temp_1);
    getValue(this,temp_2);

    //putValue(Env_Compare_Signal_Results,"Error");

    if ((strlen(temp_1)>0) && (strlen(temp_2)>0)) {

        //The getSignal(char[]) function needs CANoe7.1 or higher
        value_1=getSignal(temp_1);
        value_2=getSignal(temp_2);

        write( "%s = %f",temp_1, value_1 );
        write( "%s = %f",temp_2, value_2 );
        write("-------------------------");

        if( value_1 == value_2 )
        {
            putValue(Env_Compare_Signal_Results,"1");
        }
        else
        {
            putValue(Env_Compare_Signal_Results,"0");
        }

        putValue(Env_Compare_Signal_1,"");
        putValue(Env_Compare_Signal_2,"");
        
    }

}

on envVar Env_Get_Signal_Signum
{
    char signalname[255];
    float value = 0;

    if (getValue (this, signalname)) {
        value = getSignal (signalname);
        if (value < 0) {
            putValue (Env_Get_Signal_Signum_Result, "-");
            write ("INFO: Env_Get_Signal_Signum is negative.");
        }
        else if (value > 0)
        {
            putValue (Env_Get_Signal_Signum_Result, "+");
            write ("INFO: Env_Get_Signal_Signum is positive.");
        }
        else {
            putValue (Env_Get_Signal_Signum_Result, "Z");
            write ("INFO: Env_Get_Signal_Signum is zero.");
        }
    }
    putValue(Env_Get_Signal,"");
}

on envVar Env_Get_Signal_Float
{

    char temp[255];
    char numChar[10];
    float value;

    if (getValue(this,temp)) {

        //The getSignal(char[]) function needs CANoe7.1 or higher
        value=getSignal(temp);

        putValue(Env_Get_Signal_Float_Result,value);
        putValue(Env_Get_Signal_Float,"");
    }
}

on envVar Env_Get_Signal_Alter
{
    char signalname[255];
    float value1 = 0;
    float value2 = 0;

    if (getValue (this, signalname)) {
        value1 = getValue (Env_Get_Signal_Float_Result);
        value2 = getSignal (signalname);
        write ("INFO: Old value = %4.4f", value1);
        write ("INFO: New value = %4.4f", value2);

        if (value2 < value1) {
            putValue (Env_Get_Signal_Alter_Result, "-");
            write ("INFO: Alteration is negative.");
        }
        else if (value2 > value1)
        {
            putValue (Env_Get_Signal_Alter_Result, "+");
            write ("INFO: Alteration is positive.");
        }
        else {
            putValue (Env_Get_Signal_Alter_Result, "Z");
            write ("INFO: Alteration is zero.");
        }
    }
    putValue (this, "");
}



on envVar EnvMinicode_Plant
{


   if ( getValue (this) )
   {
        whichlogin=5;
        setTimer(FingerPrint,0);
     //  StartDiagService( MINICODEREQUEST );
       putvalue(this,0); // Reset Value for next use
   }
  
      
   

}

on envVar EnvMinicode_Dev
{


   if ( getValue (this) )
   {
        whichlogin=6;
        setTimer(FingerPrint,0);
       // StartDiagService( MINICODEREQUEST );
       putvalue(this,0); // Reset Value for next use
   }
  
      
   

}

CalculateKey (dword SeedValue,dword RBA_CBB_AKEY_VALUE, dword RBA_CBB_BKEY_VALUE, dword RBA_CBB_CKEY_VALUE, dword RBA_CBB_DKEY_VALUE)
{

        int      j;
        dword    keytemp;
      
        
        	keyReprogValue = SeedValue;

        	for(j = 0; j <8 ; j++)
        	{

            	keytemp = keyReprogValue ;
            	keyReprogValue = keyReprogValue + RBA_CBB_AKEY_VALUE;
	       		// write(" keytemp and keyReprogValue  for j value %i beginning loop: %lx, %lx ",j, keytemp, keyReprogValue );    
    
    			if((keyMaxReprogValue - RBA_CBB_AKEY_VALUE) < keytemp)
    			{
    	  		/* Rotate Right by 10 */
 	       			keyLowReprogValue = keyReprogValue & (0x000001FF);
 	    			keyUpperReprogValue = keyLowReprogValue << 23;
 	    			keyReprogValue = keyReprogValue >> 9;
 	    			keyReprogValue = keyReprogValue | keyUpperReprogValue;
       				keyReprogValue = keyReprogValue ^ RBA_CBB_BKEY_VALUE;

             	}
    			else
    			{
 	    		/* Rotate Left by 13 */
 	    		    keyUpperReprogValue = keyReprogValue & (0xFFF80000);
 			        keyLowReprogValue   = keyUpperReprogValue >> 19;
 			    	keyReprogValue      = keyReprogValue << 13;
		 	    	keyReprogValue      = keyReprogValue | keyLowReprogValue;
		       		keyReprogValue      = keyReprogValue ^ RBA_CBB_CKEY_VALUE;

                }
           }
 
           keyReprogValue = keyReprogValue - RBA_CBB_DKEY_VALUE;
              
           
            /* Key Algo end */
			 //   write(" final  keyReprogValue %lx",keyReprogValue ); 
}

on timer ActPMode
{
    StartDiagService( P_MODE_ACT_P2 );
}

on timer MinicodeReq
{
    StartDiagService( MINICODEREQUEST );
}



on envVar EnvLogInReprogWriteKey
{


   if ( getValue (this) )
   {
        whichlogin=3;
       StartDiagService( SEEDNKEYREPROGREQUESTWRITEKEY );
       putvalue(EnvLogInReprogWriteKey,0); // Reset Value for next use
   }
  
      
   

}
on envVar EnvActPMode_SP
{
      if ( getValue (this) )
    {
        StartDiagService( P_MODE_ACT_P1 ); //send part 1
        setTimer(ActPMode_SP,200); //wait and send part2
        
        Putvalue(EnvActPMode_SP,0); // Reset Value for next use
    }
}

on timer ActPMode_SP
{
    StartDiagService( P_MODE_ACT_P2 );
}

on timer Wait
{
//  WaitValue+=count_value;
//  write("WaitValue in timer=%d",WaitValue);
  write("in timer Wait");
    switch (seq)
	{
		case 0:
    
			putvalue(EnvDirectSend,"80B528C31EFD");
			setTimer(Wait,500); 
			seq++;
		break;
		case 1:
      
			putvalue(EnvDirectSend,"80B57C68");
			setTimer(Wait,500); 
			seq++;
		break;
		case 2:
     
			//putvalue(EnvRBEOL,1);
        putvalue(Env_Honda_EOL_unlock,1);
			setTimer(Wait,3000); 

			seq++;
		break;
        case 3:
       
       write("SP_EOLcode = %s",SP_EOLcode);
        strncat(SP_EOLcode,Series_Package,elcount(SP_EOLcode));
        write("SP_EOLcode=%s Series_Package=%s",SP_EOLcode,Series_Package);
			putvalue(EnvDirectSend,SP_EOLcode);
			setTimer(Wait,1000); 
			seq++;
		break;
        case 4:
      
			putvalue(EnvDirectSend,"232280030001");
			setTimer(Wait,1000); 
			seq++;
		break;
//        case 5:
//       
//			putvalue(EnvDirectSend,"1001");
//			setTimer(Wait,1000); 
//			seq++;
//		break;
		
}
// write("Counter Seq++ = %d",seq);
}


on timer code_variant
  {
    switch (seq1)
	{
    case 0:
        
			putvalue(EnvDirectSend,"1003");
			setTimer(code_variant,1000); 
			seq1++;
		break;
        case 1:
    
    whichlogin=4;
    StartDiagService( SEEDNKEYREQUESTUNLOCKFOUR );
    //putvalue(EnvLogInUnlockTypeFour,1);
    setTimer(code_variant, 400);
        seq1++;
    break;
        
    case 2:
   
    StartDiagService( ENGINEERING_SESSION_ON );
    setTimer(code_variant, 300);
        seq1++;
    break;
        case 3:
     //  write("SP_EOLcode = %s",SP_EOLcode);
        strncpy(Service_ID,"2e48F501",elcount(Service_ID));
       
       // strncpy(Coding_Variant,"2e48F501",elcount(Coding_Variant));
        strncat(Service_ID,Coding_Variant,elcount(Service_ID));
        write("Service_ID=%s Coding_Variant=%s",Service_ID,Coding_Variant);
        strncat(Service_ID,Zeros_Reserve,elcount(Service_ID));
        write("Final Service_ID=%s",Service_ID);
			  putvalue(EnvDirectSend,Service_ID);
			setTimer(code_variant,1000); 
			seq1++;
		break;
      
//		
//        case 4:
//        
//			putvalue(EnvDirectSend,"1001");
//			setTimer(code_variant,1000); 
//			seq1++;
//		break;
		
}
    
  }
  
  /////////////////////////////////////
  
  // For GEN 3 Sec unlock:
  on timer sectimer1
{
  putValue(Env_SecurityMode_Output,"");
  setTimer(sectimer2,500);
}

on timer sectimer2
{
  putValue(Env_SecurityMode_Output,"Click the button to enter dynamic Key");
  setTimer(sectimer1,1000);
}
 
  
  
  
  
  ////////////////////////////////
series_package()
{
//  write("WaitValue in function=%d",WaitValue);
//  if(WaitValue==6)
//  {
//    WaitValue=0;
//    cancelTimer(Wait);
//  }
//  WaitValue=0;
  setTimer(Wait,100);
  write("in series_package function");
  //cancelTimer(Wait);
}

on envVar EnvDiagPhyTxCANIDs
{


switch (getvalue(EnvDiagPhyTxCANIDs))
{
    case 0x18DAB5F1: 
    
    // Physical CanID 1
    ConfigTP(0x18DAB5F1, 0x18DAF1B5);
    
    break;

    case 0x18DAB5F2: 

    // Physical CanID 2
    ConfigTP(0x18DAB5F2, 0x18DAF2B5);
    break;


    case 0x18DAB5F3: 

    // Physical CanID 3
    ConfigTP(0x18DAB5F3, 0x18DAF3B5);
    break;


    
    case 0x18DAB5F4: 

    // Physical CanID 4
    ConfigTP(0x18DAB5F4, 0x18DAF4B5);
    break;



    case 0x18DAB5F5: 

    // Physical CanID 5
    ConfigTP(0x18DAB5F5, 0x18DAF5B5);
    break;

    

    case 0x18DAB5F6: 

    // Physical CanID 6
    ConfigTP(0x18DAB5F6, 0x18DAF6B5);
    break;

    
    case 0x18DAB5F7: 

    // Physical CanID 7
    ConfigTP(0x18DAB5F7, 0x18DAF7B5);
    break;


    
    case 0x18DAB5F8: 

    // Physical CanID 8
    ConfigTP(0x18DAB5F8, 0x18DAF8B5);
    break;

    

    case 0x18DAB5F9: 

    // Physical CanID 9
    ConfigTP(0x18DAB5F9, 0x18DAF9B5);
    break;




    case 0x18DAB5FA: 

    // Physical CanID 10
    ConfigTP(0x18DAB5FA, 0x18DAFAB5);
    break;



    case 0x18DAB5FB: 

    // Physical CanID 11
    ConfigTP(0x18DAB5FB, 0x18DAFBB5);
    break;



    case 0x18DAB5FC: 

    // Physical CanID 12
    ConfigTP(0x18DAB5FC, 0x18DAFCB5);
    break;



    case 0x18DAB5FD: 

    // Physical CanID 13
    ConfigTP(0x18DAB5FD, 0x18DAFDB5);
    break;



}


}
on envVar EnvDiagFuncTxCANIDs
{
 switch (getvalue(EnvDiagFuncTxCANIDs))
    {
        case 0x18DBEFF1: 

        // Functional CanID 1 (CAN ID 1-13 For ECU supporting HDC_CAN)
        ConfigTP(0x18DBEFF1, 0x18DAF1B5);

        break;

        case 0x18DBEFF2: 

        // Functional CanID 2
        ConfigTP(0x18DBEFF2, 0x18DAF2B5);
     
        break;


        case 0x18DBEFF3: 

        // Functional CanID 3
        ConfigTP(0x18DBEFF3, 0x18DAF3B5);
        break;



        case 0x18DBEFF4: 

        // Functional CanID 4
        ConfigTP(0x18DBEFF4, 0x18DAF4B5);
        break;



        case 0x18DBEFF5: 

        // Functional CanID 5
        ConfigTP(0x18DBEFF5, 0x18DAF5B5);
        break;



        case 0x18DBEFF6: 

        // Functional CanID 6
        ConfigTP(0x18DBEFF6, 0x18DAF6B5);
        break;


        case 0x18DBEFF7: 

        // Functional CanID 7
        ConfigTP(0x18DBEFF7, 0x18DAF7B5);
        break;



        case 0x18DBEFF8: 

        // Functional CanID 8
        ConfigTP(0x18DBEFF8, 0x18DAF8B5);
        break;



        case 0x18DBEFF9: 

        // Functional CanID 9
        ConfigTP(0x18DBEFF9, 0x18DAF9B5);
        break;




        case 0x18DBEFFA: 

        // Functional CanID 10
        ConfigTP(0x18DBEFFA, 0x18DAFAB5);
        break;



        case 0x18DBEFFB: 

        // Functional CanID 11
        ConfigTP(0x18DBEFFB, 0x18DAFBB5);
        break;



        case 0x18DBEFFC: 

        // Functional CanID 12
        ConfigTP(0x18DBEFFC, 0x18DAFCB5);
        break;



        case 0x18DBEFFD: 

        // Functional CanID 13
        ConfigTP(0x18DBEFFD, 0x18DAFDB5);
        break;



        case 0x18DBBFF1: 

        // Functional CanID 14 (CAN ID 14-26 For ECU supporting HDC_CAN)
        ConfigTP(0x18DBBFF1, 0x18DAF1B5);

        break;

        case 0x18DBBFF2: 

        // Functional CanID 15
        ConfigTP(0x18DBBFF2, 0x18DAF2B5);
        break;


        case 0x18DBBFF3: 

        // Functional CanID 16
        ConfigTP(0x18DBBFF3, 0x18DAF3B5);
        break;



        case 0x18DBBFF4: 

        // Functional CanID 17
        ConfigTP(0x18DBBFF4, 0x18DAF4B5);
        break;



        case 0x18DBBFF5: 

        // Functional CanID 18
        ConfigTP(0x18DBBFF5, 0x18DAF5B5);
        break;



        case 0x18DBBFF6: 

        // Functional CanID 19
        ConfigTP(0x18DBBFF6, 0x18DAF6B5);
        break;


        case 0x18DBBFF7: 

        // Functional CanID 20
        ConfigTP(0x18DBBFF7, 0x18DAF7B5);
        break;



        case 0x18DBBFF8: 

        // Functional CanID 21
        ConfigTP(0x18DBBFF8, 0x18DAF8B5);
        break;



        case 0x18DBBFF9: 

        // Functional CanID 22
        ConfigTP(0x18DBBFF9, 0x18DAF9B5);
        break;




        case 0x18DBBFFA: 

        // Functional CanID 23
        ConfigTP(0x18DBBFFA, 0x18DAFAB5);
        break;



        case 0x18DBBFFB: 

        // Functional CanID 24
        ConfigTP(0x18DBBFFB, 0x18DAFBB5);
        break;



        case 0x18DBBFFC: 

        // Functional CanID 25
        ConfigTP(0x18DBBFFC, 0x18DAFCB5);
        break;



        case 0x18DBBFFD: 

        // Functional CanID 26
        ConfigTP(0x18DBBFFD, 0x18DAFDB5);
        break;



    }
}
  

//For VAriants Series package Unlock
on envVar EnvLogInUnlockTypeOne
{

  switch(getValue(EnvLogInUnlockMy22PkgSelect))
  {
        
    case 0x00 :  
      SK1 = 0xD314;
      SK2 = 0xE09F;  //Default Package /CRV Package 0
      SK3 = 0xC516;
    
    break; 
      
      case 0x01 :     

  SK1 = 0x8CE6;
  SK2 = 0xD8C5;  //Series Package02
  SK3 = 0xB78D;

    break;
      
      case 0x02 :
  SK1 = 0x49FB;
  SK2 = 0x5611;  //Series Package03
  SK3 = 0x1CEF;
    
    break;
      
    case 0x03 :
  SK1 = 0xC0C7;
  SK2 = 0x12B1;  //Series Package04
  SK3 = 0x15D6;
    break;
      
    case 0x04 :      
  SK1 = 0x6D7C;
  SK2 = 0xED2D;  //Series Package05
  SK3 = 0xDBBC;
      
    break;
    
    case 0x05 :
  SK1 = 0x49A3;
  SK2 = 0x52E5;  //Series Package06
  SK3 = 0x1AD7;
      
    break;
      
    case 0x06 :  
  SK1 = 0x4793;
  SK2 = 0x402D;  //Series Package07
  SK3 = 0x1016;
    break;
    
    case 0x7 :  
  SK1 = 0x9E76;
  SK2 = 0x215D;  //Series Package11
  SK3 = 0x4592;
    
    break;
      
    case 0x8 :  
  SK1 = 0xE741;
  SK2 = 0x0E65;  //Series Package21
  SK3 = 0xCF43;
    
    break;
      
    case 0x9 :  
  SK1 = 0x03F2;
  SK2 = 0x90C4;  //Series Package31
  SK3 = 0x51DD;
    break;
      
    case 0xA :
  SK1 = 0x5637;
  SK2 = 0xD08F;  //Series Package32
  SK3 = 0xA9E8;
    break;
      
      case 0xB :  
  SK1 = 0xEB85;
  SK2 = 0x8AD7;  //Series Package33
  SK3 = 0x4B4C;
    
    break;
   
    case 0xC : 
  SK1 = 0x6DB5;
  SK2 = 0xF03A;  //Series Package41
  SK3 = 0xE16C;
    
    break;    
   
  case 0xD :  
  SK1 = 0xE597;
  SK2 = 0xDE77;  //Series Package01_MY24
  SK3 = 0xC152;
    
    break;  
   
   case 0xE :  
      
  SK1 = 0xC21B;
  SK2 = 0x32CE;  //Series Package11_MY24
  SK3 = 0xA152;
    
    break; 
      
       case 0xF :
  SK1 = 0x8C0A;
  SK2 = 0xC9AF;  //Series Package51_MY24
  SK3 = 0x9EE4;
    
    break;
      
      case 0x10 :
  SK1 = 0x59C4;
  SK2 = 0xF79D;  //Series Package21_MY24
  SK3 = 0xEF80;
    
    break;
      
           case 0x11 :
  SK1 = 0x1C92;
  SK2 = 0x3043;  //Series Package61_MY25
  SK3 = 0x9194;
    
    break;
      
           case 0x12 :
  SK1 = 0x3509;
  SK2 = 0xFCBA;  //Series Package62_MY25
  SK3 = 0xF97E;
    
    break;
      
        case 0x13 :
  SK1 = 0x32B7;
  SK2 = 0x0BFE;  //Series Package71_MY25
  SK3 = 0x8FE0;
    
    break;
    
       case 0x14 :
  SK1 = 0x9477;
  SK2 = 0x619C;  //Series Package72_MY25
  SK3 = 0x2537;
    
    break;
      
       case 0x15 :
  SK1 = 0x7924;
  SK2 = 0x9530;  //Series Package81_MY26
  SK3 = 0x56F0;
    
    break;
      case 0x16 :
  SK1 = 0x5C76;
  SK2 = 0x1650;  //Series Package41_MY26
  SK3 = 0x1F1E;
    
    break;
      case 0x17 :
  SK1 = 0x4BDF;
  SK2 = 0x67C6;  //Series Package91_MY26
  SK3 = 0x2A10;
    
    break;
      case 0x18 :
  SK1 = 0xA23C;
  SK2 = 0x6CFF;  //Series Package92_MY26
  SK3 = 0x2E68;

    break;
      case 0x19 :
  SK1 = 0xAF0E;
  SK2 = 0x7B42;  //Series Package93_MY26
  SK3 = 0x3B58;
    
    break;

    case 0x1A:
      SK1 = 0xD507;
      SK2 = 0x144A;  //Series PackageA0_MY28
      SK3 = 0x19BB;
    break;

    case 0x1B:
      SK1 = 0x0310;
      SK2 = 0x6100;  //Series PackageA1_MY28
      SK3 = 0x24C1;
    break;

    case 0x1C:
      SK1 = 0x2E22;
      SK2 = 0x503C;  //Series PackageA2_MY28
      SK3 = 0x1925;
    break;

    case 0x1D:
      SK1 = 0x0131;
      SK2 = 0x6B61;  //Series PackageA3_MY28
      SK3 = 0x2D0A;
    break;

  default :
     
      write("Default for the unknown packages");
  SK1 = 0x1111;
  SK2 = 0x2222;  //Default Package
  SK3 = 0x3333;
   break; 
  }

  
    if ( getValue (this) )
   {
     whichlogin=4;

  
  
   
     StartDiagService( SEEDNKEYREQUESTUNLOCKONE );
     //putvalue(EnvRBEOL,0); // Reset Value for next use
  
    }
   
}


//For VAriants Series package Unlock
on envVar EnvLogInSeriesPackageSelect
{
 

  
seq=0;
    strncpy(SP_EOLcode,"3D2280030001",elcount(SP_EOLcode));
  if(getValue(EnvLogInUnlockMy22SRSPkgSelect)==0x0)
  {
 
   strncpy(Series_Package,"00",elcount(Series_Package));
    write("Series_Package=%s",Series_Package);
    series_package();
    
  
  }
  else if(getValue(EnvLogInUnlockMy22SRSPkgSelect)==0x1)
  {
 
   strncpy(Series_Package,"02",elcount(Series_Package));
    write("Series_Package=%s",Series_Package);
    series_package();
    
  
  }
  else if(getValue(EnvLogInUnlockMy22SRSPkgSelect)==0x2)
  {
 
   strncpy(Series_Package,"03",elcount(Series_Package));
    write("Series_Package=%s",Series_Package);
    series_package();
    
  
  }
  else if(getValue(EnvLogInUnlockMy22SRSPkgSelect)==0x3)
  {
 
   strncpy(Series_Package,"04",elcount(Series_Package));
    write("Series_Package=%s",Series_Package);
    series_package();
    
  
  }
  else if(getValue(EnvLogInUnlockMy22SRSPkgSelect)==0x4)
  {
 
   strncpy(Series_Package,"05",elcount(Series_Package));
    write("Series_Package=%s",Series_Package);
    series_package();
    
  
  }
  else if(getValue(EnvLogInUnlockMy22SRSPkgSelect)==0x5)
  {
 
   strncpy(Series_Package,"06",elcount(Series_Package));
    write("Series_Package=%s",Series_Package);
    series_package();
    
  
  }
  else if(getValue(EnvLogInUnlockMy22SRSPkgSelect)==0x6)
  {
 
   strncpy(Series_Package,"07",elcount(Series_Package));
    write("Series_Package=%s",Series_Package);
    series_package();
    
  
  }
    else if(getValue(EnvLogInUnlockMy22SRSPkgSelect)==0x7)
  {
 
   strncpy(Series_Package,"11",elcount(Series_Package));
    write("Series_Package=%s",Series_Package);
    series_package();
    
  
  }
   else if(getValue(EnvLogInUnlockMy22SRSPkgSelect)==0x8)
  {
 
   strncpy(Series_Package,"21",elcount(Series_Package));
    write("Series_Package=%s",Series_Package);
    series_package();
    
  
  }
  
    else if(getValue(EnvLogInUnlockMy22SRSPkgSelect)==0x9)
   {
 
   strncpy(Series_Package,"31",elcount(Series_Package));
    write("Series_Package=%s",Series_Package);
    series_package();
    
  
  }
    else if(getValue(EnvLogInUnlockMy22SRSPkgSelect)==0xA)
   {
 
   strncpy(Series_Package,"32",elcount(Series_Package));
    write("Series_Package=%s",Series_Package);
    series_package();
    
  
  }
    else if(getValue(EnvLogInUnlockMy22SRSPkgSelect)==0xB)
   {
 
   strncpy(Series_Package,"33",elcount(Series_Package));
    write("Series_Package=%s",Series_Package);
    series_package();
    
  
  }
      else if(getValue(EnvLogInUnlockMy22SRSPkgSelect)==0xC)
   {
 
   strncpy(Series_Package,"41",elcount(Series_Package));
    write("Series_Package=%s",Series_Package);
    series_package();
    
  
  }

  else if(getValue(EnvLogInUnlockMy22SRSPkgSelect)==0xD)
   {
   strncpy(Series_Package,"01",elcount(Series_Package));
    write("Series_Package=%s",Series_Package);
    series_package();
  
  }
  
  else if(getValue(EnvLogInUnlockMy22SRSPkgSelect)==0xE)
   {
 
   strncpy(Series_Package,"11",elcount(Series_Package));
    write("Series_Package=%s",Series_Package);
    series_package();
   
  }
  
   else if(getValue(EnvLogInUnlockMy22SRSPkgSelect)==0xF)
   {
 
   strncpy(Series_Package,"51",elcount(Series_Package));
    write("Series_Package=%s",Series_Package);
    series_package();
   
  }
  
   else if(getValue(EnvLogInUnlockMy22SRSPkgSelect)==0x10)
   {
 
   strncpy(Series_Package,"21",elcount(Series_Package));
    write("Series_Package=%s",Series_Package);
    series_package();
   
  }
   else if(getValue(EnvLogInUnlockMy22SRSPkgSelect)==0x11)
   {
 
   strncpy(Series_Package,"61",elcount(Series_Package));
    write("Series_Package=%s",Series_Package);
    series_package();
   
  }
   else if(getValue(EnvLogInUnlockMy22SRSPkgSelect)==0x12)
   {
 
   strncpy(Series_Package,"62",elcount(Series_Package));
    write("Series_Package=%s",Series_Package);
    series_package();
   
  }

   else if(getValue(EnvLogInUnlockMy22SRSPkgSelect)==0x13)
   {
 
   strncpy(Series_Package,"71",elcount(Series_Package));
    write("Series_Package=%s",Series_Package);
    series_package();
   
  }
  
   else if(getValue(EnvLogInUnlockMy22SRSPkgSelect)==0x14)
   {
 
   strncpy(Series_Package,"72",elcount(Series_Package));
    write("Series_Package=%s",Series_Package);
    series_package();
   
  }
    else if(getValue(EnvLogInUnlockMy22SRSPkgSelect)==0x15)
   {
 
   strncpy(Series_Package,"81",elcount(Series_Package));
    write("Series_Package=%s",Series_Package);
    series_package();
   
  }
  
  else if(getValue(EnvLogInUnlockMy22SRSPkgSelect)==0x16)
   {
 
   strncpy(Series_Package,"41",elcount(Series_Package));
    write("Series_Package=%s",Series_Package);
    series_package();
   
  }
  else if(getValue(EnvLogInUnlockMy22SRSPkgSelect)==0x17)
   {
 
   strncpy(Series_Package,"91",elcount(Series_Package));
    write("Series_Package=%s",Series_Package);
    series_package();
   
  }
  else if(getValue(EnvLogInUnlockMy22SRSPkgSelect)==0x18)
   {
 
   strncpy(Series_Package,"92",elcount(Series_Package));
    write("Series_Package=%s",Series_Package);
    series_package();
   
  }
  else if(getValue(EnvLogInUnlockMy22SRSPkgSelect)==0x19)
   {
 
   strncpy(Series_Package,"93",elcount(Series_Package));
    write("Series_Package=%s",Series_Package);
    series_package();
  }
  else if(getValue(EnvLogInUnlockMy22SRSPkgSelect)==0x1A)
   {
 
   strncpy(Series_Package,"A0",elcount(Series_Package));
    write("Series_Package=%s",Series_Package);
    series_package();
  }
  else if(getValue(EnvLogInUnlockMy22SRSPkgSelect)==0x1B)
   {
 
   strncpy(Series_Package,"A1",elcount(Series_Package));
    write("Series_Package=%s",Series_Package);
    series_package();
  }
  else if(getValue(EnvLogInUnlockMy22SRSPkgSelect)==0x1C)
   {
 
   strncpy(Series_Package,"A2",elcount(Series_Package));
    write("Series_Package=%s",Series_Package);
    series_package();
  }
  else if(getValue(EnvLogInUnlockMy22SRSPkgSelect)==0x1D)
   {
 
   strncpy(Series_Package,"A3",elcount(Series_Package));
    write("Series_Package=%s",Series_Package);
    series_package();
  }
 else
 {
   putvalue(EnvReqStatus_CAN,"Wrong package for the release");
  }
   
   
}
on envVar EnvLogInUnlockTypeFour
{

    if ( getValue (this) )
   {
     whichlogin=4;
     StartDiagService( SEEDNKEYREQUESTUNLOCKFOUR );
     //putvalue(EnvRBEOL,0); // Reset Value for next use
  
    }
   
}

on envVar EnvLogInUnlockTypeFive
{

    if ( getValue (this) )
   {
     whichlogin=4;
     StartDiagService( SEEDNKEYREQUESTUNLOCKFIVE );
     //putvalue(EnvRBEOL,0); // Reset Value for next use
  
    }
   
}

//Read SW_infor
on envVar EnvReadSwInfo
{
  
  env_SW_Set = 1;
  putValue (EnvDiagSession, 1);
  setTimer(WaitForextendedsession,100);
  putValue (EnvLogInUnlockTypeFour, 1);
  setTimer(WaitForunlock,100);
  
}
on timer WaitForextendedsession
 {
  putvalue(EnvLogInUnlockTypeFour,1);   // step 2: send 27 41 after session is established
}
on timer WaitForunlock
 {
     putValue (EnvLogInUnlockTypeFour, 0);
  
                 ReqDiagMsgGlobal1.dlc = 0x08;
                 ReqDiagMsgGlobal1.byte(0) = 0x03;
                 ReqDiagMsgGlobal1.byte(1) = 0x22;
                 ReqDiagMsgGlobal1.byte(2) = 0xA8;
                 ReqDiagMsgGlobal1.byte(3) = 0xC2;
                 ReqDiagMsgGlobal1.byte(4) = 0x55;
                 ReqDiagMsgGlobal1.byte(5) = 0x55;
                 ReqDiagMsgGlobal1.byte(6) = 0x55;
                 ReqDiagMsgGlobal1.byte(7) = 0x55;
                 output (ReqDiagMsgGlobal1);
   setTimer(WaitForextendedsession,100);
  //getvalue(EnvDirectReceive,a8c2buffer);
   //write("A8C2 data:%s",a8c2buffer);
 
 }

//on timer WaitForUnlock
// {
//  write("inTimerSecurity");
//    putvalue(EnvDirectSend,"2762308203C28001018101019F2982010039F7A7AEBDA7DF966A44E1E4E3CEB500D470BFDDF9B116BF4994651D0B72ED643B9754A5B4C9025DC8DF0D6FE3896717E3B0D162DAD9FDDA37D82530829F3087DF1AC56AA23A4D8AC0534335B040BB0E1D9C564EED712BFF19FE7A79C276890B49A33A1E3620CA59552D3F547DB55D16F8C5A45E7939409D10A03C9539E42C940978C926613F58D1C4BA30500B2E41C5E384C9C9F4093A1C7C29CCAD0CD1D070E063E4C589D659724083F1A1A0AFFED8C64906676E702544B188E458DFD12D27F9310007794B3298A9F3C917A00F8DD8FED5EAB2163C01819E19CC1DF616CBD6A067F23E3BD1B8D3504AC027CA51E8DE50B49BAF729E483820BC8A90A77C6E0ABF2A8202B2048202AE7F218202A97F4E82019F5F290100421F52424131414253455350312F4F454D41313A434E3A44554D4D5930303030317F49820118060D2B06010401A94693481501090181820100A84281722368FD5F651E97832CBC25A7209D1DDEC8A0D49DF47EFD240B5660A84F20652159FD5780BDFBF2850DA7F2A585AA6DE6336A628B746CEC356B06BF1510776B9273C5B58CB91C332B7E0679E01EF3B97C4DAFCFEA8F6F50323B71B18ACD9282120EA249193B9A89223BA7CC96D6EC20BC33DC0309D33157430E37B59713612A77EEC1A1AADBD5A5BFEF73BE476639E3141B6689E01F0A7595BB3295163B3466E1A5606416A20096CB2F6EE14BCD428C1AEB51C2D6C7BF0F351D193DA806201B059EDBE840092E9F3A0FA72F8D4716A8D7D97BC75CC5FDB480CBB0AC4A489E03F004C80277F614C96621B909FA496484F5C94B96B5E6D512C693999D1F82030100015F202252424134434644373533364146354645303444423A504E3A44554D4D5930303030317F4C23060F2B06010401A94693481502016701015310000000000000007F10080000000000005F25060108000200085F24060200000200075F37820100594E2F425DA8A208AD2284FBA8B8D3E5CFC52D6896D46F6C7132AF5F9080166EA989EA9E805D7018A4B6E801F02097DF1E54C0ACEF7D2B28B5D5F8C5964C30094F211E4C5A7F93EDDC228CB10A30DAE4A934C03F4E7B5129045E95D4178AA72830401812066E4354576A7D8DC90ACF82C215423C7D99197731005B8952145C708565147C59336EAF068AD59FE319D54F9091DBBBF10DE78B12975D614F15D9717BCFEFEFF003E999042C65DD5FC5FB3E4D6A70CA20C7C0235670B1BC3D9BA31A15AD393A0E29D7E44A39D9786B321C8878ADBA68701462414C8D519782E3A62085B9A4C9B73F08699C5E8BFF9DD5112755588FB73E84DF66906EEAC927EF7055");
//
//   
// }
//
//
//on envVar Env_Honda_Prog_Unlock1
//{
//putvalue(EnvDirectSend,"2761");
//  setTimer(WaitForUnlock,80);
//  
//  
//}
//on stopMeasurement
//{ 
//    // putValue(voltage_input, 0); 
//  float fVoltageVal;
//  fVoltageVal = 0;
//  SetVoltage(fVoltageVal);
//  
//}

Display_DTC_MID_Name (dword error)
{

switch(error)
    {
	case 0xC41568:
        putValue (EnvDtcName_Display, "DTC_ABS_FAILURE");
		putValue (EnvMidName, "C_MID_FAULT_ABS_FAILURE_N");
	break;

    case 0x5BDC00:
        putValue (EnvDtcName_Display, "DTC_ACCEL_PEDAL_FAILURE");
		putValue (EnvMidName, "C_MID_FAULT_ACCEL_PEDAL_FAILURE_N");
	break;
    	
	case 0xD28000:
        putValue (EnvDtcName_Display, "DTC_BCAN_COMBI_FAILURE");
		putValue (EnvMidName, "C_MID_FAULT_BCAN_COMBI_FAILURE_N");
	break;
	
	case 0xD28100:
        putValue (EnvDtcName_Display, "DTC_BCAN_MICU_FAILURE");
		putValue (EnvMidName, "C_MID_FAULT_BCAN_MICU_FAILURE_N");
	break;
	
	case 0x5BE100:
        putValue (EnvDtcName_Display, "DTC_BCAN_WIPER_FAILURE");
		putValue (EnvMidName, "C_MID_FAULT_BCAN_WIPER_FAILURE_N");
	break;
	
	case 0x5BDB00:
        putValue (EnvDtcName_Display, "DTC_BRAKE_SWITCH_ABNORMAL");
		putValue (EnvMidName, "C_MID_FAULT_BRAKE_SWITCH_ABNORMAL_N");
	break;
	
	case 0xAA6054:
        putValue (EnvDtcName_Display, "DTC_CAMERA_AlignmentNotComplete");
		putValue (EnvMidName, "C_MID_CalibInitialOutOfRangeFailure_N,C_MID_CalibInitialTimeoutFailure_N,C_MID_CalibMissingFailure_N");
	break;
	
	case 0x5BEB00:
        putValue (EnvDtcName_Display, "DTC_CAMERA_CVT_NODE_FAULT");
		putValue (EnvMidName, "C_MID_ALV_CVT_191_N,C_MID_ALV_EAT_188_N,C_MID_ALV_TM_1A3_N,C_MID_CHK_CVT_191_N,C_MID_CHK_EAT_188_N,C_MID_CHK_TM_1A3_N,C_MID_TIMEOUT_CVT_191_N,C_MID_TIMEOUT_EAT_188_N,C_MID_TIMEOUT_TM_1A3_N");
	break;
	
	case 0x5BE370:
        putValue (EnvDtcName_Display, "DTC_CAMERA_DataSetFailure");
		putValue (EnvMidName, "C_MID_ruDatasetCorruptFailure_N,C_MID_ruDatasetImplausibleFailure_N,C_MID_ruDatasetUploadFailure_N,C_MID_suDatasetMissingFailure_N");
	break;
	
	case 0x5BF500:
        putValue (EnvDtcName_Display, "DTC_CAMERA_EBB_NODE_FAULT");
		putValue (EnvMidName, "C_MID_ALV_EBB_1BE_N,C_MID_CHK_EBB_1BE_N,C_MID_TIMEOUT_EBB_1BE_N");
	break;
	
	case 0x5BEA00:
        putValue (EnvDtcName_Display, "DTC_CAMERA_ENG_NODE_FAULT");
		putValue (EnvMidName, "C_MID_ALV_ENG_130_N,C_MID_ALV_ENG_13C_N,C_MID_ALV_ENG_17C_N,C_MID_ALV_ENG_1DD_N,C_MID_ALV_ENG_324_N,C_MID_ALV_ENG_328_N,C_MID_CHK_ENG_130_N,C_MID_CHK_ENG_13C_N,C_MID_CHK_ENG_17C_N,C_MID_CHK_ENG_1DD_N,C_MID_CHK_ENG_324_N,C_MID_CHK_ENG_328_N,C_MID_TIMEOUT_ENG_130_N,C_MID_TIMEOUT_ENG_13C_N,C_MID_TIMEOUT_ENG_17C_N,C_MID_TIMEOUT_ENG_1DD_N,C_MID_TIMEOUT_ENG_324_N,C_MID_TIMEOUT_ENG_328_N");
	break;
	
	case 0x5BF300:
        putValue (EnvDtcName_Display, "DTC_CAMERA_EPB_NODE_FAULT");
		putValue (EnvMidName, "C_MID_ALV_EPB_1C2_N,C_MID_CHK_EPB_1C2_N,C_MID_TIMEOUT_EPB_1C2_N");
	break;
	
	case 0x5BEE00:
        putValue (EnvDtcName_Display, "DTC_CAMERA_EPS_NODE_FAULT");
		putValue (EnvMidName, "C_MID_ALV_EPS_14A_N,C_MID_ALV_EPS_18F_N,C_MID_CHK_EPS_14A_N,C_MID_CHK_EPS_18F_N,C_MID_TIMEOUT_EPS_14A_N,C_MID_TIMEOUT_EPS_18F_N");
	break;
	
	case 0x5BF000:
        putValue (EnvDtcName_Display, "DTC_CAMERA_ESB_NODE_FAULT");
		putValue (EnvMidName, "C_MID_ALV_AHB_183_N,C_MID_ALV_ESB_184_N,C_MID_CHK_AHB_183_N,C_MID_CHK_ESB_184_N,C_MID_TIMEOUT_AHB_183_N,C_MID_TIMEOUT_ESB_184_N");
	break;
	
	case 0x5BE410:
        putValue (EnvDtcName_Display, "DTC_CAMERA_InternalFlLalWgFailure");
		putValue (EnvMidName, "C_MID_CAN_E_HW_ERROR_N,C_MID_CAN_E_RBA_CAN_TXQUEUE_N,C_MID_CAN_E_TIMEOUT_N,C_MID_FEE_E_LAYOUT_FAILED_N,C_MID_FLS_E_COMPARE_FAILED_N,C_MID_FLS_E_ERASE_FAILED_N,C_MID_FLS_E_READ_FAILED_N,C_MID_FLS_E_WRITE_FAILED_N,C_MID_NVM_E_INTEGRITY_FAILED_N,C_MID_NVM_E_REQ_FAILED_N,C_MID_PDUR_E_INIT_FAILED_N,C_MID_PDUR_E_PDU_INSTANCE_LOST_N,C_MID_WDGM_E_ALIVE_SUPERVISION_N,C_MID_WDGM_E_ALIVE_SUPERVISION_Z0_N,C_MID_lalifc0Axi0Failure_N,C_MID_lalifc0Axi1Failure_N,C_MID_lalifc0Axi2Failure_N,C_MID_lalifc0Axi3Failure_N,C_MID_lalifc0Axi4Failure_N,C_MID_lalifc0Axi5Failure_N,C_MID_lalifc0Cam0FillFailure_N,C_MID_lalifc0Cam0FullFailure_N,C_MID_lalifc0Cam0IFullFailure_N,C_MID_lalifc0Cam0RbFullFailure_N,C_MID_lalifc0CamComFailure_N,C_MID_lalifc0ConfigRamFailure_N,C_MID_lalifc0Dma0Chn00FifoFailure_N,C_MID_lalifc0Dma0Chn01FifoFailure_N,C_MID_lalifc0Dma0Chn02FifoFailure_N,C_MID_lalifc0Dma0Chn03FifoFailure_N,C_MID_lalifc0Dma0Chn04FifoFailure_N,C_MID_lalifc0Dma0Chn05FifoFailure_N,C_MID_lalifc0Dma0Chn06FifoFailure_N,C_MID_lalifc0Dma0Chn07FifoFailure_N,C_MID_lalifc0Dma0Chn08FifoFailure_N,C_MID_lalifc0Dma0Chn09FifoFailure_N,C_MID_lalifc0Dma0Chn10FifoFailure_N,C_MID_lalifc0Dma0Chn11FifoFailure_N,C_MID_lalifc0Dma0Chn12FifoFailure_N,C_MID_lalifc0Dma0Chn13FifoFailure_N,C_MID_lalifc0Dma0Chn14FifoFailure_N,C_MID_lalifc0Dma0Chn15FifoFailure_N,C_MID_lalifc0Dma2Chn00FifoFailure_N,C_MID_lalifc0Dma2Chn01FifoFailure_N,C_MID_lalifc0Dma2Chn02FifoFailure_N,C_MID_lalifc0Dma2Chn03FifoFailure_N,C_MID_lalifc0Dma2Chn04FifoFailure_N,C_MID_lalifc0Dma2Chn05FifoFailure_N,C_MID_lalifc0Dma2Chn06FifoFailure_N,C_MID_lalifc0Dma2Chn07FifoFailure_N,C_MID_lalifc0Dma2Chn08FifoFailure_N,C_MID_lalifc0Dma2Chn09FifoFailure_N,C_MID_lalifc0Dma2Chn10FifoFailure_N,C_MID_lalifc0Dma2Chn11FifoFailure_N,C_MID_lalifc0Dma2Chn12FifoFailure_N,C_MID_lalifc0Dma2Chn13FifoFailure_N,C_MID_lalifc0Dma2Chn14FifoFailure_N,C_MID_lalifc0Dma2Chn15FifoFailure_N,C_MID_lalifc0Img0NoConnectFailure_N,C_MID_lalifc0ImgABistFailure_N,C_MID_lalifc0ImgATimeStampFailure_N");
        putValue (EnvMidName, "C_MID_lalifc0PlLoadFailure_N,C_MID_lalifc0Warp0FullFailure_N,C_MID_lalifc0Warp0RespFailure_N,C_MID_ruDaddyZ0CRCFailure_N,C_MID_ruDaddyZ0DisconnectCommandFailure_N,C_MID_ruDaddyZ0InselSelectFailure_N,C_MID_ruDaddyZ0InvalidPointerFailure_N,C_MID_ruDaddyZ0InvalidSequenceNumberFailure_N,C_MID_ruDaddyZ0NoPoolFailure_N,C_MID_ruDaddyZ0PinNotConnectedFailure_N,C_MID_ruDaddyZ0PlacementReserveFailure_N,C_MID_ruDaddyZ0PoolFullFailure_N,C_MID_ruDaddyZ0RecorderOverflowFailure_N,C_MID_ruDaddyZ0SizeMismatchFailure_N,C_MID_ruDaddyZ0SubscriberOverflowFailure_N,C_MID_ruLadZynq0Failure_N,C_MID_ruZ0C0StackMonitorFailure_N,C_MID_ruZ0C1StackMonitorFailure_N,C_MID_ruZ0OSLimitFailure_N,C_MID_ruZ0ShutdownFailure_N,C_MID_suLadROIFailure_N");
	break;
	
	case 0x5BE330:
        putValue (EnvDtcName_Display, "DTC_CAMERA_InternalHWFailure");
		putValue (EnvMidName,"C_MID_RAMTST_E_RAM_FAILURE_N,C_MID_RAMTST_E_RAM_Z0_FAILURE_N,C_MID_WDGM_E_SET_MODE_N,C_MID_WDGM_E_SET_MODE_Z0_N,C_MID_exposureDecodingHeaderEmptyFailureImagerA_N,C_MID_exposureDecodingHeaderEmptyFailureImagerAZynq0_N,C_MID_exposureDecodingHeaderFormatFailureImagerA_N,C_MID_exposureDecodingHeaderFormatFailureImagerAZynq0_N,C_MID_exposureDecodingTrailerEmptyFailureImagerA_N,C_MID_exposureDecodingTrailerEmptyFailureImagerAZynq0_N,C_MID_exposureDecodingTrailerFormatFailureImagerA_N,C_MID_exposureDecodingTrailerFormatFailureImagerAZynq0_N,C_MID_exposureDeltaDarkFailureImagerA_N,C_MID_exposureHistogramFailureImagerA_N,C_MID_exposureHistogramFailureImagerAZynq0_N,C_MID_exposureImagerAliveFailureImagerA_N,C_MID_exposureRegisterVerificationFailureImagerA_N,C_MID_exposureRegisterVerificationFailureImagerAZynq0_N,C_MID_exposureStatusRegisterFailureImagerA_N,C_MID_exposureSyncInputFailureImagerA_N,C_MID_exposureSyncInputFailureImagerAZynq0_N,C_MID_exposureSyncTimingFailureImagerA_N,C_MID_exposureSyncTimingFailureImagerAZynq0_N,C_MID_exposureZebraRowsPatternFailureImagerA_N,C_MID_exposureZebraRowsValueFailureImagerA_N,C_MID_lalifc0BlockRamFailure_N,C_MID_lalifc0DistributedRamFailure_N,C_MID_ruZ0C0Task05msAliveFailure_N,C_MID_ruZ0C0Task10msAliveFailure_N,C_MID_ruZ0C0Task20msAliveFailure_N,C_MID_ruZ0C0TaskC2WAliveFailure_N,C_MID_ruZ0C0TaskCdetCascAliveFailure_N,C_MID_ruZ0C0TaskExpAliveFailure_N,C_MID_ruZ0C0TaskImageAliveFailure_N,C_MID_ruZ0C0TaskImagerMonAliveFailure_N,C_MID_ruZ0C0TaskIntImageAliveFailure_N,C_MID_ruZ0C0TaskLineDetAliveFailure_N,C_MID_ruZ0C0TaskModAliveFailure_N,C_MID_ruZ0C0TaskModCascAliveFailure_N,C_MID_ruZ0C0TaskPdetCascAliveFailure_N,C_MID_ruZ0C0TaskShcLadAliveFailure_N,C_MID_ruZ0C0TaskflowHandleAliveFailure_N,C_MID_ruZ0C1Task10msAliveFailure_N,C_MID_ruZ0C1TaskCacheSyncAliveFailure_N,C_MID_ruZ0C1TaskGinAliveFailure_N,C_MID_ruZ0C1TaskImageMonAliveFailure_N,C_MID_ruZ0C1TaskImagerMonAliveFailure_N,C_MID_ruZ0C1TaskOdetAliveFailure_N,C_MID_ruZ0C1TaskPdetAliveFailure_N");
        putValue (EnvMidName,"C_MID_ruZ0C1TaskProstAliveFailure_N,C_MID_ruZ0C1TaskRsrClassAliveFailure_N,C_MID_ruZ0C1TaskRsrTrackerAliveFailure_N,C_MID_ruZ0C1TaskShcAliveFailure_N,C_MID_ruZynq0AsyncUARTFailed_N,C_MID_ruZynq0CacheParityFailure_N,C_MID_ruZynq0Task18AliveFailure_N,C_MID_ruZynq0Task19AliveFailure_N,C_MID_suFpgaBistZynq0Failure_N,C_MID_suWatchdogResetTestFailure_N,C_MID_suZynq0BootloaderLoadingFailed_N,C_MID_suZynq0BootmanagerFlsTstConfigInvalid_N,C_MID_suZynq0BootmanagerFlsTstFailed_N,C_MID_suZynq0BootmanagerLoadingFailed_N,C_MID_suZynq0BootmanagerRamTestFailed_N,C_MID_suZynq0BootstrapFlsTstFailed_N,C_MID_suZynq0BootstrapLoadingFailed_N,C_MID_suZynq0BootstrapRamTestFailed_N,C_MID_suZynq0BswApplBlockHeaderInvalid_N,C_MID_suZynq0BswApplBlockHeaderLoadingFailed_N,C_MID_suZynq0BswApplFlsTstConfigInvalid_N,C_MID_suZynq0BswApplFlsTstConfigLoadingFailed_N,C_MID_suZynq0BswApplFlsTstFailed_N,C_MID_suZynq0BswApplLoadingFailed_N,C_MID_suZynq0BswApplRamTstBlocksOutOfLoadedFailed_N,C_MID_suZynq0BswApplRamTstConfigInvalid_N,C_MID_suZynq0BswApplRamTstFailed_N,C_MID_suZynq0DdrBitlinesFailed_N,C_MID_suZynq0DdrRefreshTaskStartFailed_N,C_MID_suZynq0OcmBitlinesFailed_N,C_MID_suZynq0RAMCAN0Failure_N,C_MID_suZynq0RAMCAN1Failure_N,C_MID_suZynq0RAMExternFailure_N,C_MID_suZynq0ROMTestApplFailure_N,C_MID_suZynq0ROMTestBLFailure_N,C_MID_suZynq0ROMTestBMFailure_N,C_MID_suZynq0StilLoadingFailed_N,C_MID_suZynq0StilTransmissionFailed_N,C_MID_suZynq0UARTInitFailed_N");
	break;
	
	case 0x5BE300:
        putValue (EnvDtcName_Display, "DTC_CAMERA_InternalHighVoltFailure");
		putValue (EnvMidName, "C_MID_ruVolt1V0HighFailure_N,C_MID_ruVolt1V2HighFailure_N,C_MID_ruVolt1V8DImagerHighFailure_N,C_MID_ruVolt1V8HighFailure_N,C_MID_ruVolt1V8IOImagerHighFailure_N,C_MID_ruVolt2V8AImagerHighFailure_N,C_MID_ruVolt3V3HighFailure_N,C_MID_ruVolt5V0HighFailure_N");
	break;
		
	case 0x5BE310:
        putValue (EnvDtcName_Display, "DTC_CAMERA_InternalLowVoltFailure");
		putValue (EnvMidName, "C_MID_ruVolt1V0LowFailure_N,C_MID_ruVolt1V2LowFailure_N,C_MID_ruVolt1V8DImagerLowFailure_N,C_MID_ruVolt1V8IOImagerLowFailure_N,C_MID_ruVolt1V8LowFailure_N,C_MID_ruVolt2V8AImagerLowFailure_N,C_MID_ruVolt3V3LowFailure_N,C_MID_ruVolt5V0LowFailure_N");
	break;
	
    case 0x5BED00:
        putValue (EnvDtcName_Display, "DTC_CAMERA_METER_NODE_FAULT");
		putValue (EnvMidName, "C_MID_ALV_METER_296_N,C_MID_ALV_METER_309_N,C_MID_ALV_METER_326_N,C_MID_ALV_METER_374_N,C_MID_ALV_METER_37B_N,C_MID_ALV_METER_3A1_N,C_MID_ALV_METER_516_N,C_MID_CHK_METER_296_N,C_MID_CHK_METER_309_N,C_MID_CHK_METER_326_N,C_MID_CHK_METER_374_N,C_MID_CHK_METER_37B_N,C_MID_CHK_METER_3A1_N,C_MID_CHK_METER_516_N,C_MID_TIMEOUT_METER_296_N,C_MID_TIMEOUT_METER_309_N,C_MID_TIMEOUT_METER_326_N,C_MID_TIMEOUT_METER_374_N,C_MID_TIMEOUT_METER_37B_N,C_MID_TIMEOUT_METER_3A1_N,C_MID_TIMEOUT_METER_516_N");
	break;
	
	case 0xAA6097:
        putValue (EnvDtcName_Display, "DTC_CAMERA_OBSTRUCATED");
		putValue (EnvMidName, "C_MID_blindnessPixelLoss_N");
	break;
	
	case 0x5BE200:
        putValue (EnvDtcName_Display, "DTC_CAMERA_PermanentFailure");
		putValue (EnvMidName, "C_MID_CalibIntrinsicMissingFailure_N,C_MID_RAMTST_E_RAM_ECU_DEFECT_Z0_FAILURE_N,C_MID_ruClockMonitoringFailure_N,C_MID_ruTempSensExt0StuckFailure_N,C_MID_ruTempSensImagerStuckFailure_N,C_MID_ruVolt1V0HighImplausibleFailure_N,C_MID_ruVolt1V0LowImplausibleFailure_N,C_MID_ruVolt1V2HighImplausibleFailure_N,C_MID_ruVolt1V2LowImplausibleFailure_N,C_MID_ruVolt1V8HighImplausibleFailure_N,C_MID_ruVolt1V8LowImplausibleFailure_N,C_MID_ruVolt3V3HighImplausibleFailure_N,C_MID_ruVolt3V3LowImplausibleFailure_N,C_MID_ruVolt5V0HighImplausibleFailure_N,C_MID_ruVolt5V0LowImplausibleFailure_N,C_MID_ruVoltBatLowImplausibleFailure_N,C_MID_suPortTestAdcFailure_N,C_MID_suPortTestCAN0Failure_N,C_MID_suPortTestCAN1Failure_N,C_MID_suPortTestIicFailure_N,C_MID_suZynq0RAMCAN0DefectFailure_N,C_MID_suZynq0RAMCAN1DefectFailure_N");
	break;
	
	case 0x5BF400:
        putValue (EnvDtcName_Display, "DTC_CAMERA_RTC_NODE_FAULT");
		putValue (EnvMidName, "C_MID_ALV_RTC_1E9_N,C_MID_CHK_RTC_1E9_N,C_MID_TIMEOUT_RTC_1E9_N");
	break;
    
    case 0x5BF200:
        putValue (EnvDtcName_Display, "DTC_CAMERA_SRS_NODE_FAULT");
		putValue (EnvMidName, "C_MID_ALV_SRS_039_N,C_MID_ALV_SRS_094_N,C_MID_ALV_SRS_305_N,C_MID_CHK_SRS_039_N,C_MID_CHK_SRS_094_N,C_MID_CHK_SRS_305_N,C_MID_TIMEOUT_SRS_039_N,C_MID_TIMEOUT_SRS_094_N,C_MID_TIMEOUT_SRS_305_N");
	break;
	
	case 0x5BF100:
        putValue (EnvDtcName_Display, "DTC_CAMERA_STR_NODE_FAULT");
		putValue (EnvMidName, "C_MID_ALV_STR_156_N,C_MID_CHK_STR_156_N,C_MID_TIMEOUT_STR_156_N");
	break;

    case 0x5BE400:
        putValue (EnvDtcName_Display, "DTC_CAMERA_TemperatureFailure");
		putValue (EnvMidName, "C_MID_exposureNonEmbeddedRegisterWriteFailureImagerA_N,C_MID_exposureRegisterWriteFailuresImagerA_N,C_MID_exposureTemperatureFailureImagerA_N,C_MID_ruTempSensExt0AccessFailure_N,C_MID_ruTempSensImager0AccessFailure_N,C_MID_ruTempSensImagerHighFailure_N,C_MID_ruTempSensImagerLowFailure_N,C_MID_suPortTestTempSensorFailure_N");
	break;
    
    case 0x5BE800:
        putValue (EnvDtcName_Display, "DTC_CAMERA_VIDEO_FCAN_ABNORMAL");
		putValue (EnvMidName, "C_MID_A_CAN0_BUSOFF_NETWORK_N");
	break;

    case 0x5BE900:
        putValue (EnvDtcName_Display, "DTC_CAMERA_VIDEO_SFCAN_ABNORMAL");
		putValue (EnvMidName, "C_MID_A_CAN1_BUSOFF_NETWORK_N");
	break;

    case 0x5BEC00:
        putValue (EnvDtcName_Display, "DTC_CAMERA_VSA_NODE_FAULT");
		putValue (EnvMidName, "C_MID_ALV_VSA_1A4_N,C_MID_ALV_VSA_1B0_N,C_MID_CHK_VSA_1A4_N,C_MID_CHK_VSA_1B0_N,C_MID_CHK_VSA_1D0_N,C_MID_TIMEOUT_VSA_1A4_N,C_MID_TIMEOUT_VSA_1B0_N,C_MID_TIMEOUT_VSA_1D0_N");
	break;
    
    case 0x5BE700:
        putValue (EnvDtcName_Display, "DTC_CAMERA_VairantCodingFailure");
		putValue (EnvMidName, "C_MID_CodingMissingFailure_N,C_MID_CodingVariantFailure_N");
	break;
	
    case 0x5BE500:
        putValue (EnvDtcName_Display, "DTC_CAMERA_VoltHighFailure");
		putValue (EnvMidName, "C_MID_ruVoltBatHighPermanentFailure_N,C_MID_ruVoltBatHighSporadicFailure_N,C_MID_ruVoltBatVeryHighHWProtFailure_N");
	break;

    case 0x5BE600:
        putValue (EnvDtcName_Display, "DTC_CAMERA_VoltLowFailure");
		putValue (EnvMidName, "C_MID_ruVoltBatLowPermanentFailure_N,C_MID_ruVoltBatLowSporadicFailure_N");
	break;

    case 0x5BD800:
        putValue (EnvDtcName_Display, "DTC_ENG_IDAS_FAIL");
		putValue (EnvMidName, "C_MID_FAULT_ENG_IDAS_FAIL_N");
	break;

    case 0xC41768:
        putValue (EnvDtcName_Display, "DTC_EPB_REFUSE_ACT");
		putValue (EnvMidName, "C_MID_FAULT_EPB_REFUSE_ACT_FAILURE_N");
	break;

    case 0xC4204A:
        putValue (EnvDtcName_Display, "DTC_EPS_SDF_MISMATCH");
		putValue (EnvMidName, "C_MID_FAULT_EPS_SDF_MISMATCH_N");
	break;

    case 0xC42068:
        putValue (EnvDtcName_Display, "DTC_EPS_UNIT_FAILURE");
		putValue (EnvMidName, "C_MID_FAULT_EPS_FAILURE_N");
	break;

    case 0x5BD700:
        putValue (EnvDtcName_Display, "DTC_ESB_BRAKE_RELAY_CIRCUIT");
		putValue (EnvMidName, "C_MID_FAULT_ESB_BRAKE_RELAY_CIRCUIT_N");
	break;

    case 0x4BDA00:
        putValue (EnvDtcName_Display, "DTC_ESB_STROKE_SENSOR_FAILURE");
		putValue (EnvMidName, "C_MID_FAULT_ESB_STROKE_SENSOR_FAILURE_N");
	break;

    case 0x403162:
        putValue (EnvDtcName_Display, "DTC_FL_WSS");
		putValue (EnvMidName, "C_MID_FAULT_FL_WSS_N");
	break;

    case 0x403462:
        putValue (EnvDtcName_Display, "DTC_FR_WSS");
		putValue (EnvMidName, "C_MID_FAULT_FR_WSS_N");
	break;

    case 0x4BD900:
        putValue (EnvDtcName_Display, "DTC_LAT_G_FAILURE");
		putValue (EnvMidName, "C_MID_FAULT_LAT_G_FAILURE_N");
	break;

    case 0xAA7012:
        putValue (EnvDtcName_Display, "DTC_LDW_SW_OPEN");
		putValue (EnvMidName, "C_MID_FAULT_LDW_SW_OPEN_N");
	break;

    case 0xAA7014:
        putValue (EnvDtcName_Display, "DTC_LDW_SW_SHORT");
		putValue (EnvMidName, "C_MID_FAULT_LDW_SW_SHORT_N");
	break;

    case 0x056415:
        putValue (EnvDtcName_Display, "DTC_LKAS_SW_OPEN");
		putValue (EnvMidName, "C_MID_FAULT_LKAS_SW_OPEN_N");
	break;

    case 0x056411:
        putValue (EnvDtcName_Display, "DTC_LKAS_SW_SHORT");
		putValue (EnvMidName, "C_MID_FAULT_LKAS_SW_SHORT_N");
	break;

    case 0x5062F0:
        putValue (EnvDtcName_Display, "DTC_LONG_G_FAILURE");
		putValue (EnvMidName, "C_MID_FAULT_LONG_ACCEL_SENSOR_FAILURE_N");
	break;

    case 0x058915:
        putValue (EnvDtcName_Display, "DTC_MAIN_SW_OPEN");
		putValue (EnvMidName, "C_MID_FAULT_MAIN_SW_OPEN_N");
	break;

    case 0x058911:
        putValue (EnvDtcName_Display, "DTC_MAIN_SW_SHORT");
		putValue (EnvMidName, "C_MID_FAULT_MAIN_SW_SHORT_N");
	break;

    case 0x5044F0:
        putValue (EnvDtcName_Display, "DTC_MC_PRESSURE_SENSOR");
		putValue (EnvMidName, "C_MID_FAULT_MC_PRESSURE_SENSOR_N");
	break;

    case 0xC42368:
        putValue (EnvDtcName_Display, "DTC_METER_INDICATOR_FAILURE");
		putValue (EnvMidName, "C_MID_FAULT_ACC_INDICATOR_FAILURE_N,C_MID_FAULT_BCAN_FAIL_CODE_N,C_MID_FAULT_CMBS_INDICATOR_FAILURE_N,C_MID_FAULT_LDW_INDICATOR_FAILURE_N");
	break;

    case 0xC15500:
        putValue (EnvDtcName_Display, "DTC_METER_UNIT_FAULT");
		putValue (EnvMidName, "C_MID_FAULT_METER_DATAFAIL_ACCIND_N,C_MID_FAULT_METER_DATAFAIL_ASL_N,C_MID_FAULT_METER_DATAFAIL_CVRSIND_N,C_MID_FAULT_METER_DATAFAIL_FCWIND_N,C_MID_FAULT_METER_DATAFAIL_LDWIND_N");
	break;

    case 0xC40268:
        putValue (EnvDtcName_Display, "DTC_PCM_FAILURE");
		putValue (EnvMidName, "C_MID_FAULT_CVT_FAILURE_N,C_MID_FAULT_EAT_FAILURE_N,C_MID_FAULT_TM_FAILURE_N");
	break;

    case 0x403762:
        putValue (EnvDtcName_Display, "DTC_RL_WSS");
		putValue (EnvMidName, "C_MID_FAULT_RL_WSS_N");
	break;

    case 0x403A62:
        putValue (EnvDtcName_Display, "DTC_RR_WSS");
		putValue (EnvMidName, "C_MID_FAULT_RR_WSS_N");
	break;

    case 0xD48268:
        putValue (EnvDtcName_Display, "DTC_RTC_FAILURE");
		putValue (EnvMidName, "C_MID_FAULT_RTC_FAILURE_N");
	break;

    case 0x405154:
        putValue (EnvDtcName_Display, "DTC_SAS_NOT_CALIBRATED");
		putValue (EnvMidName, "C_MID_FAULT_SAS_EPS_NOT_CALIBRATED_N,C_MID_FAULT_SAS_STR_NOT_CALIBRATED_N");
	break;

    case 0x405196:
        putValue (EnvDtcName_Display, "DTC_STEERING_ANGLE_SENSOR");
		putValue (EnvMidName, "C_MID_FAULT_STEERING_ANGLE_SENSOR_N,C_MID_FAULT_STEERING_ANGLE_SENSOR_EPS_N");
	break;

    case 0x072062:
        putValue (EnvDtcName_Display, "DTC_TRANS_SPEED_SENSOR_FAILURE");
		putValue (EnvMidName, "C_MID_FAULT_TRANS_SPEED_SENSOR_FAILURE_N");
	break;

    case 0xC41668:
        putValue (EnvDtcName_Display, "DTC_VSA_ACC_FAILURE");
		putValue (EnvMidName, "C_MID_FAULT_VSA_ACC_FAILURE_N");
	break;

    case 0xAA1014:
        putValue (EnvDtcName_Display, "DTC_VSA_BRAKE_RELAY_CIRCUIT");
		putValue (EnvMidName, "C_MID_FAULT_VSA_BRAKE_RELAY_CIRCUIT_N");
	break;

    case 0x5BD600:
        putValue (EnvDtcName_Display, "DTC_YAWRATE_SENSOR_FAILURE");
		putValue (EnvMidName, "C_MID_FAULT_YAWRATE_SENSOR_FAILURE_N");
	break;
    
    case 0xAA6112:
        putValue (EnvDtcName_Display, "DTC_CAMERA_WSCH_Open_Circuit");
		putValue (EnvMidName, "C_MID_FAULT_wsch_IBS_SuC_WindscreenHeaterOpenCircuitFailure");
	break;
	
	default:
        putValue (EnvDtcName_Display, "N/A");
		putValue (EnvMidName, "N/A");
    break;
   
}
} 

